ASAP2_VERSION 1 31
/begin PROJECT ProjectName "Project Comment Goes Here"
/begin HEADER "Header Comments go here" /end HEADER
/begin MODULE ModuleName "Module Comment Goes Here"
/begin MOD_COMMON "Mod Common Comment Here" BYTE_ORDER MSB_LAST /end MOD_COMMON
/begin RECORD_LAYOUT Lookup1D_X_FLOAT64_IEEE AXIS_PTS_X 1 FLOAT64_IEEE INDEX_INCR DIRECT /end RECORD_LAYOUT
/begin RECORD_LAYOUT Lookup2D_BOOLEAN FNC_VALUES 1 UBYTE COLUMN_DIR DIRECT /end RECORD_LAYOUT
/begin RECORD_LAYOUT Lookup2D_X_BOOLEAN AXIS_PTS_X 1 UBYTE INDEX_INCR DIRECT /end RECORD_LAYOUT
/begin RECORD_LAYOUT Lookup2D_UBYTE FNC_VALUES 1 UBYTE COLUMN_DIR DIRECT /end RECORD_LAYOUT
/begin RECORD_LAYOUT Lookup2D_X_UBYTE AXIS_PTS_X 1 UBYTE INDEX_INCR DIRECT /end RECORD_LAYOUT
/begin RECORD_LAYOUT Lookup2D_BYTE FNC_VALUES 1 SBYTE COLUMN_DIR DIRECT /end RECORD_LAYOUT
/begin RECORD_LAYOUT Lookup2D_X_BYTE AXIS_PTS_X 1 SBYTE INDEX_INCR DIRECT /end RECORD_LAYOUT
/begin RECORD_LAYOUT Lookup2D_UWORD FNC_VALUES 1 UWORD COLUMN_DIR DIRECT /end RECORD_LAYOUT
/begin RECORD_LAYOUT Lookup2D_X_UWORD AXIS_PTS_X 1 UWORD INDEX_INCR DIRECT /end RECORD_LAYOUT
/begin RECORD_LAYOUT Lookup2D_WORD FNC_VALUES 1 SWORD COLUMN_DIR DIRECT /end RECORD_LAYOUT
/begin RECORD_LAYOUT Lookup2D_X_WORD AXIS_PTS_X 1 SWORD INDEX_INCR DIRECT /end RECORD_LAYOUT
/begin RECORD_LAYOUT Lookup2D_ULONG FNC_VALUES 1 ULONG COLUMN_DIR DIRECT /end RECORD_LAYOUT
/begin RECORD_LAYOUT Lookup2D_X_ULONG AXIS_PTS_X 1 ULONG INDEX_INCR DIRECT /end RECORD_LAYOUT
/begin RECORD_LAYOUT Lookup2D_LONG FNC_VALUES 1 SLONG COLUMN_DIR DIRECT /end RECORD_LAYOUT
/begin RECORD_LAYOUT Lookup2D_X_LONG AXIS_PTS_X 1 SLONG INDEX_INCR DIRECT /end RECORD_LAYOUT
/begin RECORD_LAYOUT Lookup2D_FLOAT32_IEEE FNC_VALUES 1 FLOAT32_IEEE COLUMN_DIR DIRECT /end RECORD_LAYOUT
/begin RECORD_LAYOUT Lookup2D_X_FLOAT32_IEEE AXIS_PTS_X 1 FLOAT32_IEEE INDEX_INCR DIRECT /end RECORD_LAYOUT
/begin RECORD_LAYOUT Lookup2D_FLOAT64_IEEE FNC_VALUES 1 FLOAT64_IEEE COLUMN_DIR DIRECT /end RECORD_LAYOUT
/begin RECORD_LAYOUT Lookup2D_X_FLOAT64_IEEE AXIS_PTS_X 1 FLOAT64_IEEE INDEX_INCR DIRECT /end RECORD_LAYOUT
/begin MEASUREMENT sensor_inport.HALSensors.HAL_ultrasound_SI.HAL_list_echo.tab_echo[24].begin_echo_index "" UWORD flightControlSystem_CM_uint16 0 0 0 65535 ECU_ADDRESS 0x0000 /* @ECU_Address@sensor_inport.HALSensors.HAL_ultrasound_SI.HAL_list_echo.tab_echo[24].begin_echo_index@ */ /end MEASUREMENT
/begin MEASUREMENT sensor_inport.HALSensors.HAL_ultrasound_SI.HAL_list_echo.tab_echo[24].end_echo_index "" UWORD flightControlSystem_CM_uint16 0 0 0 65535 ECU_ADDRESS 0x0000 /* @ECU_Address@sensor_inport.HALSensors.HAL_ultrasound_SI.HAL_list_echo.tab_echo[24].end_echo_index@ */ /end MEASUREMENT
/begin MEASUREMENT sensor_inport.HALSensors.HAL_ultrasound_SI.HAL_list_echo.tab_echo[24].max_value_index "" SWORD flightControlSystem_CM_int16 0 0 -32768 32767 ECU_ADDRESS 0x0000 /* @ECU_Address@sensor_inport.HALSensors.HAL_ultrasound_SI.HAL_list_echo.tab_echo[24].max_value_index@ */ /end MEASUREMENT
/begin MEASUREMENT sensor_inport.HALSensors.HAL_ultrasound_SI.HAL_list_echo.tab_echo[24].max_value "" SLONG flightControlSystem_CM_int32 0 0 -2147483648 2147483647 ECU_ADDRESS 0x0000 /* @ECU_Address@sensor_inport.HALSensors.HAL_ultrasound_SI.HAL_list_echo.tab_echo[24].max_value@ */ /end MEASUREMENT
/begin MEASUREMENT sensor_inport.HALSensors.HAL_ultrasound_SI.HAL_list_echo.tab_echo[24].precedent "" UWORD flightControlSystem_CM_uint16 0 0 0 65535 ECU_ADDRESS 0x0000 /* @ECU_Address@sensor_inport.HALSensors.HAL_ultrasound_SI.HAL_list_echo.tab_echo[24].precedent@ */ /end MEASUREMENT
/begin MEASUREMENT sensor_inport.HALSensors.HAL_ultrasound_SI.HAL_list_echo.tab_echo[24].d_echo "" SWORD flightControlSystem_CM_int16 0 0 -32768 32767 ECU_ADDRESS 0x0000 /* @ECU_Address@sensor_inport.HALSensors.HAL_ultrasound_SI.HAL_list_echo.tab_echo[24].d_echo@ */ /end MEASUREMENT
/begin MEASUREMENT sensor_inport.HALSensors.HAL_ultrasound_SI.HAL_list_echo.tab_echo[24].pre_max_index "" UWORD flightControlSystem_CM_uint16 0 0 0 65535 ECU_ADDRESS 0x0000 /* @ECU_Address@sensor_inport.HALSensors.HAL_ultrasound_SI.HAL_list_echo.tab_echo[24].pre_max_index@ */ /end MEASUREMENT
/begin MEASUREMENT sensor_inport.HALSensors.HAL_ultrasound_SI.HAL_list_echo.tab_echo[25].begin_echo_index "" UWORD flightControlSystem_CM_uint16 0 0 0 65535 ECU_ADDRESS 0x0000 /* @ECU_Address@sensor_inport.HALSensors.HAL_ultrasound_SI.HAL_list_echo.tab_echo[25].begin_echo_index@ */ /end MEASUREMENT
/begin MEASUREMENT sensor_inport.HALSensors.HAL_ultrasound_SI.HAL_list_echo.tab_echo[25].end_echo_index "" UWORD flightControlSystem_CM_uint16 0 0 0 65535 ECU_ADDRESS 0x0000 /* @ECU_Address@sensor_inport.HALSensors.HAL_ultrasound_SI.HAL_list_echo.tab_echo[25].end_echo_index@ */ /end MEASUREMENT
/begin MEASUREMENT sensor_inport.HALSensors.HAL_ultrasound_SI.HAL_list_echo.tab_echo[25].max_value_index "" SWORD flightControlSystem_CM_int16 0 0 -32768 32767 ECU_ADDRESS 0x0000 /* @ECU_Address@sensor_inport.HALSensors.HAL_ultrasound_SI.HAL_list_echo.tab_echo[25].max_value_index@ */ /end MEASUREMENT
/begin MEASUREMENT sensor_inport.HALSensors.HAL_ultrasound_SI.HAL_list_echo.tab_echo[25].max_value "" SLONG flightControlSystem_CM_int32 0 0 -2147483648 2147483647 ECU_ADDRESS 0x0000 /* @ECU_Address@sensor_inport.HALSensors.HAL_ultrasound_SI.HAL_list_echo.tab_echo[25].max_value@ */ /end MEASUREMENT
/begin MEASUREMENT sensor_inport.HALSensors.HAL_ultrasound_SI.HAL_list_echo.tab_echo[25].precedent "" UWORD flightControlSystem_CM_uint16 0 0 0 65535 ECU_ADDRESS 0x0000 /* @ECU_Address@sensor_inport.HALSensors.HAL_ultrasound_SI.HAL_list_echo.tab_echo[25].precedent@ */ /end MEASUREMENT
/begin MEASUREMENT sensor_inport.HALSensors.HAL_ultrasound_SI.HAL_list_echo.tab_echo[25].d_echo "" SWORD flightControlSystem_CM_int16 0 0 -32768 32767 ECU_ADDRESS 0x0000 /* @ECU_Address@sensor_inport.HALSensors.HAL_ultrasound_SI.HAL_list_echo.tab_echo[25].d_echo@ */ /end MEASUREMENT
/begin MEASUREMENT sensor_inport.HALSensors.HAL_ultrasound_SI.HAL_list_echo.tab_echo[25].pre_max_index "" UWORD flightControlSystem_CM_uint16 0 0 0 65535 ECU_ADDRESS 0x0000 /* @ECU_Address@sensor_inport.HALSensors.HAL_ultrasound_SI.HAL_list_echo.tab_echo[25].pre_max_index@ */ /end MEASUREMENT
/begin MEASUREMENT sensor_inport.HALSensors.HAL_ultrasound_SI.HAL_list_echo.tab_echo[26].begin_echo_index "" UWORD flightControlSystem_CM_uint16 0 0 0 65535 ECU_ADDRESS 0x0000 /* @ECU_Address@sensor_inport.HALSensors.HAL_ultrasound_SI.HAL_list_echo.tab_echo[26].begin_echo_index@ */ /end MEASUREMENT
/begin MEASUREMENT sensor_inport.HALSensors.HAL_ultrasound_SI.HAL_list_echo.tab_echo[26].end_echo_index "" UWORD flightControlSystem_CM_uint16 0 0 0 65535 ECU_ADDRESS 0x0000 /* @ECU_Address@sensor_inport.HALSensors.HAL_ultrasound_SI.HAL_list_echo.tab_echo[26].end_echo_index@ */ /end MEASUREMENT
/begin MEASUREMENT sensor_inport.HALSensors.HAL_ultrasound_SI.HAL_list_echo.tab_echo[26].max_value_index "" SWORD flightControlSystem_CM_int16 0 0 -32768 32767 ECU_ADDRESS 0x0000 /* @ECU_Address@sensor_inport.HALSensors.HAL_ultrasound_SI.HAL_list_echo.tab_echo[26].max_value_index@ */ /end MEASUREMENT
/begin MEASUREMENT sensor_inport.HALSensors.HAL_ultrasound_SI.HAL_list_echo.tab_echo[26].max_value "" SLONG flightControlSystem_CM_int32 0 0 -2147483648 2147483647 ECU_ADDRESS 0x0000 /* @ECU_Address@sensor_inport.HALSensors.HAL_ultrasound_SI.HAL_list_echo.tab_echo[26].max_value@ */ /end MEASUREMENT
/begin MEASUREMENT sensor_inport.HALSensors.HAL_ultrasound_SI.HAL_list_echo.tab_echo[26].precedent "" UWORD flightControlSystem_CM_uint16 0 0 0 65535 ECU_ADDRESS 0x0000 /* @ECU_Address@sensor_inport.HALSensors.HAL_ultrasound_SI.HAL_list_echo.tab_echo[26].precedent@ */ /end MEASUREMENT
/begin MEASUREMENT sensor_inport.HALSensors.HAL_ultrasound_SI.HAL_list_echo.tab_echo[26].d_echo "" SWORD flightControlSystem_CM_int16 0 0 -32768 32767 ECU_ADDRESS 0x0000 /* @ECU_Address@sensor_inport.HALSensors.HAL_ultrasound_SI.HAL_list_echo.tab_echo[26].d_echo@ */ /end MEASUREMENT
/begin MEASUREMENT sensor_inport.HALSensors.HAL_ultrasound_SI.HAL_list_echo.tab_echo[26].pre_max_index "" UWORD flightControlSystem_CM_uint16 0 0 0 65535 ECU_ADDRESS 0x0000 /* @ECU_Address@sensor_inport.HALSensors.HAL_ultrasound_SI.HAL_list_echo.tab_echo[26].pre_max_index@ */ /end MEASUREMENT
/begin MEASUREMENT sensor_inport.HALSensors.HAL_ultrasound_SI.HAL_list_echo.tab_echo[27].begin_echo_index "" UWORD flightControlSystem_CM_uint16 0 0 0 65535 ECU_ADDRESS 0x0000 /* @ECU_Address@sensor_inport.HALSensors.HAL_ultrasound_SI.HAL_list_echo.tab_echo[27].begin_echo_index@ */ /end MEASUREMENT
/begin MEASUREMENT sensor_inport.HALSensors.HAL_ultrasound_SI.HAL_list_echo.tab_echo[27].end_echo_index "" UWORD flightControlSystem_CM_uint16 0 0 0 65535 ECU_ADDRESS 0x0000 /* @ECU_Address@sensor_inport.HALSensors.HAL_ultrasound_SI.HAL_list_echo.tab_echo[27].end_echo_index@ */ /end MEASUREMENT
/begin MEASUREMENT sensor_inport.HALSensors.HAL_ultrasound_SI.HAL_list_echo.tab_echo[27].max_value_index "" SWORD flightControlSystem_CM_int16 0 0 -32768 32767 ECU_ADDRESS 0x0000 /* @ECU_Address@sensor_inport.HALSensors.HAL_ultrasound_SI.HAL_list_echo.tab_echo[27].max_value_index@ */ /end MEASUREMENT
/begin MEASUREMENT sensor_inport.HALSensors.HAL_ultrasound_SI.HAL_list_echo.tab_echo[27].max_value "" SLONG flightControlSystem_CM_int32 0 0 -2147483648 2147483647 ECU_ADDRESS 0x0000 /* @ECU_Address@sensor_inport.HALSensors.HAL_ultrasound_SI.HAL_list_echo.tab_echo[27].max_value@ */ /end MEASUREMENT
/begin MEASUREMENT sensor_inport.HALSensors.HAL_ultrasound_SI.HAL_list_echo.tab_echo[27].precedent "" UWORD flightControlSystem_CM_uint16 0 0 0 65535 ECU_ADDRESS 0x0000 /* @ECU_Address@sensor_inport.HALSensors.HAL_ultrasound_SI.HAL_list_echo.tab_echo[27].precedent@ */ /end MEASUREMENT
/begin MEASUREMENT sensor_inport.HALSensors.HAL_ultrasound_SI.HAL_list_echo.tab_echo[27].d_echo "" SWORD flightControlSystem_CM_int16 0 0 -32768 32767 ECU_ADDRESS 0x0000 /* @ECU_Address@sensor_inport.HALSensors.HAL_ultrasound_SI.HAL_list_echo.tab_echo[27].d_echo@ */ /end MEASUREMENT
/begin MEASUREMENT sensor_inport.HALSensors.HAL_ultrasound_SI.HAL_list_echo.tab_echo[27].pre_max_index "" UWORD flightControlSystem_CM_uint16 0 0 0 65535 ECU_ADDRESS 0x0000 /* @ECU_Address@sensor_inport.HALSensors.HAL_ultrasound_SI.HAL_list_echo.tab_echo[27].pre_max_index@ */ /end MEASUREMENT
/begin MEASUREMENT sensor_inport.HALSensors.HAL_ultrasound_SI.HAL_list_echo.tab_echo[28].begin_echo_index "" UWORD flightControlSystem_CM_uint16 0 0 0 65535 ECU_ADDRESS 0x0000 /* @ECU_Address@sensor_inport.HALSensors.HAL_ultrasound_SI.HAL_list_echo.tab_echo[28].begin_echo_index@ */ /end MEASUREMENT
/begin MEASUREMENT sensor_inport.HALSensors.HAL_ultrasound_SI.HAL_list_echo.tab_echo[28].end_echo_index "" UWORD flightControlSystem_CM_uint16 0 0 0 65535 ECU_ADDRESS 0x0000 /* @ECU_Address@sensor_inport.HALSensors.HAL_ultrasound_SI.HAL_list_echo.tab_echo[28].end_echo_index@ */ /end MEASUREMENT
/begin MEASUREMENT sensor_inport.HALSensors.HAL_ultrasound_SI.HAL_list_echo.tab_echo[28].max_value_index "" SWORD flightControlSystem_CM_int16 0 0 -32768 32767 ECU_ADDRESS 0x0000 /* @ECU_Address@sensor_inport.HALSensors.HAL_ultrasound_SI.HAL_list_echo.tab_echo[28].max_value_index@ */ /end MEASUREMENT
/begin MEASUREMENT sensor_inport.HALSensors.HAL_ultrasound_SI.HAL_list_echo.tab_echo[28].max_value "" SLONG flightControlSystem_CM_int32 0 0 -2147483648 2147483647 ECU_ADDRESS 0x0000 /* @ECU_Address@sensor_inport.HALSensors.HAL_ultrasound_SI.HAL_list_echo.tab_echo[28].max_value@ */ /end MEASUREMENT
/begin MEASUREMENT sensor_inport.HALSensors.HAL_ultrasound_SI.HAL_list_echo.tab_echo[28].precedent "" UWORD flightControlSystem_CM_uint16 0 0 0 65535 ECU_ADDRESS 0x0000 /* @ECU_Address@sensor_inport.HALSensors.HAL_ultrasound_SI.HAL_list_echo.tab_echo[28].precedent@ */ /end MEASUREMENT
/begin MEASUREMENT sensor_inport.HALSensors.HAL_ultrasound_SI.HAL_list_echo.tab_echo[28].d_echo "" SWORD flightControlSystem_CM_int16 0 0 -32768 32767 ECU_ADDRESS 0x0000 /* @ECU_Address@sensor_inport.HALSensors.HAL_ultrasound_SI.HAL_list_echo.tab_echo[28].d_echo@ */ /end MEASUREMENT
/begin MEASUREMENT sensor_inport.HALSensors.HAL_ultrasound_SI.HAL_list_echo.tab_echo[28].pre_max_index "" UWORD flightControlSystem_CM_uint16 0 0 0 65535 ECU_ADDRESS 0x0000 /* @ECU_Address@sensor_inport.HALSensors.HAL_ultrasound_SI.HAL_list_echo.tab_echo[28].pre_max_index@ */ /end MEASUREMENT
/begin MEASUREMENT sensor_inport.HALSensors.HAL_ultrasound_SI.HAL_list_echo.tab_echo[29].begin_echo_index "" UWORD flightControlSystem_CM_uint16 0 0 0 65535 ECU_ADDRESS 0x0000 /* @ECU_Address@sensor_inport.HALSensors.HAL_ultrasound_SI.HAL_list_echo.tab_echo[29].begin_echo_index@ */ /end MEASUREMENT
/begin MEASUREMENT sensor_inport.HALSensors.HAL_ultrasound_SI.HAL_list_echo.tab_echo[29].end_echo_index "" UWORD flightControlSystem_CM_uint16 0 0 0 65535 ECU_ADDRESS 0x0000 /* @ECU_Address@sensor_inport.HALSensors.HAL_ultrasound_SI.HAL_list_echo.tab_echo[29].end_echo_index@ */ /end MEASUREMENT
/begin MEASUREMENT sensor_inport.HALSensors.HAL_ultrasound_SI.HAL_list_echo.tab_echo[29].max_value_index "" SWORD flightControlSystem_CM_int16 0 0 -32768 32767 ECU_ADDRESS 0x0000 /* @ECU_Address@sensor_inport.HALSensors.HAL_ultrasound_SI.HAL_list_echo.tab_echo[29].max_value_index@ */ /end MEASUREMENT
/begin MEASUREMENT sensor_inport.HALSensors.HAL_ultrasound_SI.HAL_list_echo.tab_echo[29].max_value "" SLONG flightControlSystem_CM_int32 0 0 -2147483648 2147483647 ECU_ADDRESS 0x0000 /* @ECU_Address@sensor_inport.HALSensors.HAL_ultrasound_SI.HAL_list_echo.tab_echo[29].max_value@ */ /end MEASUREMENT
/begin MEASUREMENT sensor_inport.HALSensors.HAL_ultrasound_SI.HAL_list_echo.tab_echo[29].precedent "" UWORD flightControlSystem_CM_uint16 0 0 0 65535 ECU_ADDRESS 0x0000 /* @ECU_Address@sensor_inport.HALSensors.HAL_ultrasound_SI.HAL_list_echo.tab_echo[29].precedent@ */ /end MEASUREMENT
/begin MEASUREMENT sensor_inport.HALSensors.HAL_ultrasound_SI.HAL_list_echo.tab_echo[29].d_echo "" SWORD flightControlSystem_CM_int16 0 0 -32768 32767 ECU_ADDRESS 0x0000 /* @ECU_Address@sensor_inport.HALSensors.HAL_ultrasound_SI.HAL_list_echo.tab_echo[29].d_echo@ */ /end MEASUREMENT
/begin MEASUREMENT sensor_inport.HALSensors.HAL_ultrasound_SI.HAL_list_echo.tab_echo[29].pre_max_index "" UWORD flightControlSystem_CM_uint16 0 0 0 65535 ECU_ADDRESS 0x0000 /* @ECU_Address@sensor_inport.HALSensors.HAL_ultrasound_SI.HAL_list_echo.tab_echo[29].pre_max_index@ */ /end MEASUREMENT
/begin MEASUREMENT sensor_inport.HALSensors.HAL_ultrasound_SI.HAL_list_echo_p.tab_echo[0].begin_echo_index "" UWORD flightControlSystem_CM_uint16 0 0 0 65535 ECU_ADDRESS 0x0000 /* @ECU_Address@sensor_inport.HALSensors.HAL_ultrasound_SI.HAL_list_echo_p.tab_echo[0].begin_echo_index@ */ /end MEASUREMENT
/begin MEASUREMENT sensor_inport.HALSensors.HAL_ultrasound_SI.HAL_list_echo_p.tab_echo[0].end_echo_index "" UWORD flightControlSystem_CM_uint16 0 0 0 65535 ECU_ADDRESS 0x0000 /* @ECU_Address@sensor_inport.HALSensors.HAL_ultrasound_SI.HAL_list_echo_p.tab_echo[0].end_echo_index@ */ /end MEASUREMENT
/begin MEASUREMENT sensor_inport.HALSensors.HAL_ultrasound_SI.HAL_list_echo_p.tab_echo[0].max_value_index "" SWORD flightControlSystem_CM_int16 0 0 -32768 32767 ECU_ADDRESS 0x0000 /* @ECU_Address@sensor_inport.HALSensors.HAL_ultrasound_SI.HAL_list_echo_p.tab_echo[0].max_value_index@ */ /end MEASUREMENT
/begin MEASUREMENT sensor_inport.HALSensors.HAL_ultrasound_SI.HAL_list_echo_p.tab_echo[0].max_value "" SLONG flightControlSystem_CM_int32 0 0 -2147483648 2147483647 ECU_ADDRESS 0x0000 /* @ECU_Address@sensor_inport.HALSensors.HAL_ultrasound_SI.HAL_list_echo_p.tab_echo[0].max_value@ */ /end MEASUREMENT
/begin MEASUREMENT sensor_inport.HALSensors.HAL_ultrasound_SI.HAL_list_echo_p.tab_echo[0].precedent "" UWORD flightControlSystem_CM_uint16 0 0 0 65535 ECU_ADDRESS 0x0000 /* @ECU_Address@sensor_inport.HALSensors.HAL_ultrasound_SI.HAL_list_echo_p.tab_echo[0].precedent@ */ /end MEASUREMENT
/begin MEASUREMENT sensor_inport.HALSensors.HAL_ultrasound_SI.HAL_list_echo_p.tab_echo[0].d_echo "" SWORD flightControlSystem_CM_int16 0 0 -32768 32767 ECU_ADDRESS 0x0000 /* @ECU_Address@sensor_inport.HALSensors.HAL_ultrasound_SI.HAL_list_echo_p.tab_echo[0].d_echo@ */ /end MEASUREMENT
/begin MEASUREMENT sensor_inport.HALSensors.HAL_ultrasound_SI.HAL_list_echo_p.tab_echo[0].pre_max_index "" UWORD flightControlSystem_CM_uint16 0 0 0 65535 ECU_ADDRESS 0x0000 /* @ECU_Address@sensor_inport.HALSensors.HAL_ultrasound_SI.HAL_list_echo_p.tab_echo[0].pre_max_index@ */ /end MEASUREMENT
/begin MEASUREMENT sensor_inport.HALSensors.HAL_ultrasound_SI.HAL_list_echo_p.tab_echo[1].begin_echo_index "" UWORD flightControlSystem_CM_uint16 0 0 0 65535 ECU_ADDRESS 0x0000 /* @ECU_Address@sensor_inport.HALSensors.HAL_ultrasound_SI.HAL_list_echo_p.tab_echo[1].begin_echo_index@ */ /end MEASUREMENT
/begin MEASUREMENT sensor_inport.HALSensors.HAL_ultrasound_SI.HAL_list_echo_p.tab_echo[1].end_echo_index "" UWORD flightControlSystem_CM_uint16 0 0 0 65535 ECU_ADDRESS 0x0000 /* @ECU_Address@sensor_inport.HALSensors.HAL_ultrasound_SI.HAL_list_echo_p.tab_echo[1].end_echo_index@ */ /end MEASUREMENT
/begin MEASUREMENT sensor_inport.HALSensors.HAL_ultrasound_SI.HAL_list_echo_p.tab_echo[1].max_value_index "" SWORD flightControlSystem_CM_int16 0 0 -32768 32767 ECU_ADDRESS 0x0000 /* @ECU_Address@sensor_inport.HALSensors.HAL_ultrasound_SI.HAL_list_echo_p.tab_echo[1].max_value_index@ */ /end MEASUREMENT
/begin MEASUREMENT sensor_inport.HALSensors.HAL_ultrasound_SI.HAL_list_echo_p.tab_echo[1].max_value "" SLONG flightControlSystem_CM_int32 0 0 -2147483648 2147483647 ECU_ADDRESS 0x0000 /* @ECU_Address@sensor_inport.HALSensors.HAL_ultrasound_SI.HAL_list_echo_p.tab_echo[1].max_value@ */ /end MEASUREMENT
/begin MEASUREMENT sensor_inport.HALSensors.HAL_ultrasound_SI.HAL_list_echo_p.tab_echo[1].precedent "" UWORD flightControlSystem_CM_uint16 0 0 0 65535 ECU_ADDRESS 0x0000 /* @ECU_Address@sensor_inport.HALSensors.HAL_ultrasound_SI.HAL_list_echo_p.tab_echo[1].precedent@ */ /end MEASUREMENT
/begin MEASUREMENT sensor_inport.HALSensors.HAL_ultrasound_SI.HAL_list_echo_p.tab_echo[1].d_echo "" SWORD flightControlSystem_CM_int16 0 0 -32768 32767 ECU_ADDRESS 0x0000 /* @ECU_Address@sensor_inport.HALSensors.HAL_ultrasound_SI.HAL_list_echo_p.tab_echo[1].d_echo@ */ /end MEASUREMENT
/begin MEASUREMENT sensor_inport.HALSensors.HAL_ultrasound_SI.HAL_list_echo_p.tab_echo[1].pre_max_index "" UWORD flightControlSystem_CM_uint16 0 0 0 65535 ECU_ADDRESS 0x0000 /* @ECU_Address@sensor_inport.HALSensors.HAL_ultrasound_SI.HAL_list_echo_p.tab_echo[1].pre_max_index@ */ /end MEASUREMENT
/begin MEASUREMENT sensor_inport.HALSensors.HAL_ultrasound_SI.HAL_list_echo_p.tab_echo[2].begin_echo_index "" UWORD flightControlSystem_CM_uint16 0 0 0 65535 ECU_ADDRESS 0x0000 /* @ECU_Address@sensor_inport.HALSensors.HAL_ultrasound_SI.HAL_list_echo_p.tab_echo[2].begin_echo_index@ */ /end MEASUREMENT
/begin MEASUREMENT sensor_inport.HALSensors.HAL_ultrasound_SI.HAL_list_echo_p.tab_echo[2].end_echo_index "" UWORD flightControlSystem_CM_uint16 0 0 0 65535 ECU_ADDRESS 0x0000 /* @ECU_Address@sensor_inport.HALSensors.HAL_ultrasound_SI.HAL_list_echo_p.tab_echo[2].end_echo_index@ */ /end MEASUREMENT
/begin MEASUREMENT sensor_inport.HALSensors.HAL_ultrasound_SI.HAL_list_echo_p.tab_echo[2].max_value_index "" SWORD flightControlSystem_CM_int16 0 0 -32768 32767 ECU_ADDRESS 0x0000 /* @ECU_Address@sensor_inport.HALSensors.HAL_ultrasound_SI.HAL_list_echo_p.tab_echo[2].max_value_index@ */ /end MEASUREMENT
/begin MEASUREMENT sensor_inport.HALSensors.HAL_ultrasound_SI.HAL_list_echo_p.tab_echo[2].max_value "" SLONG flightControlSystem_CM_int32 0 0 -2147483648 2147483647 ECU_ADDRESS 0x0000 /* @ECU_Address@sensor_inport.HALSensors.HAL_ultrasound_SI.HAL_list_echo_p.tab_echo[2].max_value@ */ /end MEASUREMENT
/begin MEASUREMENT sensor_inport.HALSensors.HAL_ultrasound_SI.HAL_list_echo_p.tab_echo[2].precedent "" UWORD flightControlSystem_CM_uint16 0 0 0 65535 ECU_ADDRESS 0x0000 /* @ECU_Address@sensor_inport.HALSensors.HAL_ultrasound_SI.HAL_list_echo_p.tab_echo[2].precedent@ */ /end MEASUREMENT
/begin MEASUREMENT sensor_inport.HALSensors.HAL_ultrasound_SI.HAL_list_echo_p.tab_echo[2].d_echo "" SWORD flightControlSystem_CM_int16 0 0 -32768 32767 ECU_ADDRESS 0x0000 /* @ECU_Address@sensor_inport.HALSensors.HAL_ultrasound_SI.HAL_list_echo_p.tab_echo[2].d_echo@ */ /end MEASUREMENT
/begin MEASUREMENT sensor_inport.HALSensors.HAL_ultrasound_SI.HAL_list_echo_p.tab_echo[2].pre_max_index "" UWORD flightControlSystem_CM_uint16 0 0 0 65535 ECU_ADDRESS 0x0000 /* @ECU_Address@sensor_inport.HALSensors.HAL_ultrasound_SI.HAL_list_echo_p.tab_echo[2].pre_max_index@ */ /end MEASUREMENT
/begin MEASUREMENT sensor_inport.HALSensors.HAL_ultrasound_SI.HAL_list_echo_p.tab_echo[3].begin_echo_index "" UWORD flightControlSystem_CM_uint16 0 0 0 65535 ECU_ADDRESS 0x0000 /* @ECU_Address@sensor_inport.HALSensors.HAL_ultrasound_SI.HAL_list_echo_p.tab_echo[3].begin_echo_index@ */ /end MEASUREMENT
/begin MEASUREMENT sensor_inport.HALSensors.HAL_ultrasound_SI.HAL_list_echo_p.tab_echo[3].end_echo_index "" UWORD flightControlSystem_CM_uint16 0 0 0 65535 ECU_ADDRESS 0x0000 /* @ECU_Address@sensor_inport.HALSensors.HAL_ultrasound_SI.HAL_list_echo_p.tab_echo[3].end_echo_index@ */ /end MEASUREMENT
/begin MEASUREMENT sensor_inport.HALSensors.HAL_ultrasound_SI.HAL_list_echo_p.tab_echo[3].max_value_index "" SWORD flightControlSystem_CM_int16 0 0 -32768 32767 ECU_ADDRESS 0x0000 /* @ECU_Address@sensor_inport.HALSensors.HAL_ultrasound_SI.HAL_list_echo_p.tab_echo[3].max_value_index@ */ /end MEASUREMENT
/begin MEASUREMENT sensor_inport.HALSensors.HAL_ultrasound_SI.HAL_list_echo_p.tab_echo[3].max_value "" SLONG flightControlSystem_CM_int32 0 0 -2147483648 2147483647 ECU_ADDRESS 0x0000 /* @ECU_Address@sensor_inport.HALSensors.HAL_ultrasound_SI.HAL_list_echo_p.tab_echo[3].max_value@ */ /end MEASUREMENT
/begin MEASUREMENT sensor_inport.HALSensors.HAL_ultrasound_SI.HAL_list_echo_p.tab_echo[3].precedent "" UWORD flightControlSystem_CM_uint16 0 0 0 65535 ECU_ADDRESS 0x0000 /* @ECU_Address@sensor_inport.HALSensors.HAL_ultrasound_SI.HAL_list_echo_p.tab_echo[3].precedent@ */ /end MEASUREMENT
/begin MEASUREMENT sensor_inport.HALSensors.HAL_ultrasound_SI.HAL_list_echo_p.tab_echo[3].d_echo "" SWORD flightControlSystem_CM_int16 0 0 -32768 32767 ECU_ADDRESS 0x0000 /* @ECU_Address@sensor_inport.HALSensors.HAL_ultrasound_SI.HAL_list_echo_p.tab_echo[3].d_echo@ */ /end MEASUREMENT
/begin MEASUREMENT sensor_inport.HALSensors.HAL_ultrasound_SI.HAL_list_echo_p.tab_echo[3].pre_max_index "" UWORD flightControlSystem_CM_uint16 0 0 0 65535 ECU_ADDRESS 0x0000 /* @ECU_Address@sensor_inport.HALSensors.HAL_ultrasound_SI.HAL_list_echo_p.tab_echo[3].pre_max_index@ */ /end MEASUREMENT
/begin MEASUREMENT sensor_inport.HALSensors.HAL_ultrasound_SI.HAL_list_echo_p.tab_echo[4].begin_echo_index "" UWORD flightControlSystem_CM_uint16 0 0 0 65535 ECU_ADDRESS 0x0000 /* @ECU_Address@sensor_inport.HALSensors.HAL_ultrasound_SI.HAL_list_echo_p.tab_echo[4].begin_echo_index@ */ /end MEASUREMENT
/begin MEASUREMENT sensor_inport.HALSensors.HAL_ultrasound_SI.HAL_list_echo_p.tab_echo[4].end_echo_index "" UWORD flightControlSystem_CM_uint16 0 0 0 65535 ECU_ADDRESS 0x0000 /* @ECU_Address@sensor_inport.HALSensors.HAL_ultrasound_SI.HAL_list_echo_p.tab_echo[4].end_echo_index@ */ /end MEASUREMENT
/begin MEASUREMENT sensor_inport.HALSensors.HAL_ultrasound_SI.HAL_list_echo_p.tab_echo[4].max_value_index "" SWORD flightControlSystem_CM_int16 0 0 -32768 32767 ECU_ADDRESS 0x0000 /* @ECU_Address@sensor_inport.HALSensors.HAL_ultrasound_SI.HAL_list_echo_p.tab_echo[4].max_value_index@ */ /end MEASUREMENT
/begin MEASUREMENT sensor_inport.HALSensors.HAL_ultrasound_SI.HAL_list_echo_p.tab_echo[4].max_value "" SLONG flightControlSystem_CM_int32 0 0 -2147483648 2147483647 ECU_ADDRESS 0x0000 /* @ECU_Address@sensor_inport.HALSensors.HAL_ultrasound_SI.HAL_list_echo_p.tab_echo[4].max_value@ */ /end MEASUREMENT
/begin MEASUREMENT sensor_inport.HALSensors.HAL_ultrasound_SI.HAL_list_echo_p.tab_echo[4].precedent "" UWORD flightControlSystem_CM_uint16 0 0 0 65535 ECU_ADDRESS 0x0000 /* @ECU_Address@sensor_inport.HALSensors.HAL_ultrasound_SI.HAL_list_echo_p.tab_echo[4].precedent@ */ /end MEASUREMENT
/begin MEASUREMENT sensor_inport.HALSensors.HAL_ultrasound_SI.HAL_list_echo_p.tab_echo[4].d_echo "" SWORD flightControlSystem_CM_int16 0 0 -32768 32767 ECU_ADDRESS 0x0000 /* @ECU_Address@sensor_inport.HALSensors.HAL_ultrasound_SI.HAL_list_echo_p.tab_echo[4].d_echo@ */ /end MEASUREMENT
/begin MEASUREMENT sensor_inport.HALSensors.HAL_ultrasound_SI.HAL_list_echo_p.tab_echo[4].pre_max_index "" UWORD flightControlSystem_CM_uint16 0 0 0 65535 ECU_ADDRESS 0x0000 /* @ECU_Address@sensor_inport.HALSensors.HAL_ultrasound_SI.HAL_list_echo_p.tab_echo[4].pre_max_index@ */ /end MEASUREMENT
/begin MEASUREMENT sensor_inport.HALSensors.HAL_ultrasound_SI.HAL_list_echo_p.tab_echo[5].begin_echo_index "" UWORD flightControlSystem_CM_uint16 0 0 0 65535 ECU_ADDRESS 0x0000 /* @ECU_Address@sensor_inport.HALSensors.HAL_ultrasound_SI.HAL_list_echo_p.tab_echo[5].begin_echo_index@ */ /end MEASUREMENT
/begin MEASUREMENT sensor_inport.HALSensors.HAL_ultrasound_SI.HAL_list_echo_p.tab_echo[5].end_echo_index "" UWORD flightControlSystem_CM_uint16 0 0 0 65535 ECU_ADDRESS 0x0000 /* @ECU_Address@sensor_inport.HALSensors.HAL_ultrasound_SI.HAL_list_echo_p.tab_echo[5].end_echo_index@ */ /end MEASUREMENT
/begin MEASUREMENT sensor_inport.HALSensors.HAL_ultrasound_SI.HAL_list_echo_p.tab_echo[5].max_value_index "" SWORD flightControlSystem_CM_int16 0 0 -32768 32767 ECU_ADDRESS 0x0000 /* @ECU_Address@sensor_inport.HALSensors.HAL_ultrasound_SI.HAL_list_echo_p.tab_echo[5].max_value_index@ */ /end MEASUREMENT
/begin MEASUREMENT sensor_inport.HALSensors.HAL_ultrasound_SI.HAL_list_echo_p.tab_echo[5].max_value "" SLONG flightControlSystem_CM_int32 0 0 -2147483648 2147483647 ECU_ADDRESS 0x0000 /* @ECU_Address@sensor_inport.HALSensors.HAL_ultrasound_SI.HAL_list_echo_p.tab_echo[5].max_value@ */ /end MEASUREMENT
/begin MEASUREMENT sensor_inport.HALSensors.HAL_ultrasound_SI.HAL_list_echo_p.tab_echo[5].precedent "" UWORD flightControlSystem_CM_uint16 0 0 0 65535 ECU_ADDRESS 0x0000 /* @ECU_Address@sensor_inport.HALSensors.HAL_ultrasound_SI.HAL_list_echo_p.tab_echo[5].precedent@ */ /end MEASUREMENT
/begin MEASUREMENT sensor_inport.HALSensors.HAL_ultrasound_SI.HAL_list_echo_p.tab_echo[5].d_echo "" SWORD flightControlSystem_CM_int16 0 0 -32768 32767 ECU_ADDRESS 0x0000 /* @ECU_Address@sensor_inport.HALSensors.HAL_ultrasound_SI.HAL_list_echo_p.tab_echo[5].d_echo@ */ /end MEASUREMENT
/begin MEASUREMENT sensor_inport.HALSensors.HAL_ultrasound_SI.HAL_list_echo_p.tab_echo[5].pre_max_index "" UWORD flightControlSystem_CM_uint16 0 0 0 65535 ECU_ADDRESS 0x0000 /* @ECU_Address@sensor_inport.HALSensors.HAL_ultrasound_SI.HAL_list_echo_p.tab_echo[5].pre_max_index@ */ /end MEASUREMENT
/begin MEASUREMENT sensor_inport.HALSensors.HAL_ultrasound_SI.HAL_list_echo_p.tab_echo[6].begin_echo_index "" UWORD flightControlSystem_CM_uint16 0 0 0 65535 ECU_ADDRESS 0x0000 /* @ECU_Address@sensor_inport.HALSensors.HAL_ultrasound_SI.HAL_list_echo_p.tab_echo[6].begin_echo_index@ */ /end MEASUREMENT
/begin MEASUREMENT sensor_inport.HALSensors.HAL_ultrasound_SI.HAL_list_echo_p.tab_echo[6].end_echo_index "" UWORD flightControlSystem_CM_uint16 0 0 0 65535 ECU_ADDRESS 0x0000 /* @ECU_Address@sensor_inport.HALSensors.HAL_ultrasound_SI.HAL_list_echo_p.tab_echo[6].end_echo_index@ */ /end MEASUREMENT
/begin MEASUREMENT sensor_inport.HALSensors.HAL_ultrasound_SI.HAL_list_echo_p.tab_echo[6].max_value_index "" SWORD flightControlSystem_CM_int16 0 0 -32768 32767 ECU_ADDRESS 0x0000 /* @ECU_Address@sensor_inport.HALSensors.HAL_ultrasound_SI.HAL_list_echo_p.tab_echo[6].max_value_index@ */ /end MEASUREMENT
/begin MEASUREMENT sensor_inport.HALSensors.HAL_ultrasound_SI.HAL_list_echo_p.tab_echo[6].max_value "" SLONG flightControlSystem_CM_int32 0 0 -2147483648 2147483647 ECU_ADDRESS 0x0000 /* @ECU_Address@sensor_inport.HALSensors.HAL_ultrasound_SI.HAL_list_echo_p.tab_echo[6].max_value@ */ /end MEASUREMENT
/begin MEASUREMENT sensor_inport.HALSensors.HAL_ultrasound_SI.HAL_list_echo_p.tab_echo[6].precedent "" UWORD flightControlSystem_CM_uint16 0 0 0 65535 ECU_ADDRESS 0x0000 /* @ECU_Address@sensor_inport.HALSensors.HAL_ultrasound_SI.HAL_list_echo_p.tab_echo[6].precedent@ */ /end MEASUREMENT
/begin MEASUREMENT sensor_inport.HALSensors.HAL_ultrasound_SI.HAL_list_echo_p.tab_echo[6].d_echo "" SWORD flightControlSystem_CM_int16 0 0 -32768 32767 ECU_ADDRESS 0x0000 /* @ECU_Address@sensor_inport.HALSensors.HAL_ultrasound_SI.HAL_list_echo_p.tab_echo[6].d_echo@ */ /end MEASUREMENT
/begin MEASUREMENT sensor_inport.HALSensors.HAL_ultrasound_SI.HAL_list_echo_p.tab_echo[6].pre_max_index "" UWORD flightControlSystem_CM_uint16 0 0 0 65535 ECU_ADDRESS 0x0000 /* @ECU_Address@sensor_inport.HALSensors.HAL_ultrasound_SI.HAL_list_echo_p.tab_echo[6].pre_max_index@ */ /end MEASUREMENT
/begin MEASUREMENT sensor_inport.HALSensors.HAL_ultrasound_SI.HAL_list_echo_p.tab_echo[7].begin_echo_index "" UWORD flightControlSystem_CM_uint16 0 0 0 65535 ECU_ADDRESS 0x0000 /* @ECU_Address@sensor_inport.HALSensors.HAL_ultrasound_SI.HAL_list_echo_p.tab_echo[7].begin_echo_index@ */ /end MEASUREMENT
/begin MEASUREMENT sensor_inport.HALSensors.HAL_ultrasound_SI.HAL_list_echo_p.tab_echo[7].end_echo_index "" UWORD flightControlSystem_CM_uint16 0 0 0 65535 ECU_ADDRESS 0x0000 /* @ECU_Address@sensor_inport.HALSensors.HAL_ultrasound_SI.HAL_list_echo_p.tab_echo[7].end_echo_index@ */ /end MEASUREMENT
/begin MEASUREMENT sensor_inport.HALSensors.HAL_ultrasound_SI.HAL_list_echo_p.tab_echo[7].max_value_index "" SWORD flightControlSystem_CM_int16 0 0 -32768 32767 ECU_ADDRESS 0x0000 /* @ECU_Address@sensor_inport.HALSensors.HAL_ultrasound_SI.HAL_list_echo_p.tab_echo[7].max_value_index@ */ /end MEASUREMENT
/begin MEASUREMENT sensor_inport.HALSensors.HAL_ultrasound_SI.HAL_list_echo_p.tab_echo[7].max_value "" SLONG flightControlSystem_CM_int32 0 0 -2147483648 2147483647 ECU_ADDRESS 0x0000 /* @ECU_Address@sensor_inport.HALSensors.HAL_ultrasound_SI.HAL_list_echo_p.tab_echo[7].max_value@ */ /end MEASUREMENT
/begin MEASUREMENT sensor_inport.HALSensors.HAL_ultrasound_SI.HAL_list_echo_p.tab_echo[7].precedent "" UWORD flightControlSystem_CM_uint16 0 0 0 65535 ECU_ADDRESS 0x0000 /* @ECU_Address@sensor_inport.HALSensors.HAL_ultrasound_SI.HAL_list_echo_p.tab_echo[7].precedent@ */ /end MEASUREMENT
/begin MEASUREMENT sensor_inport.HALSensors.HAL_ultrasound_SI.HAL_list_echo_p.tab_echo[7].d_echo "" SWORD flightControlSystem_CM_int16 0 0 -32768 32767 ECU_ADDRESS 0x0000 /* @ECU_Address@sensor_inport.HALSensors.HAL_ultrasound_SI.HAL_list_echo_p.tab_echo[7].d_echo@ */ /end MEASUREMENT
/begin MEASUREMENT sensor_inport.HALSensors.HAL_ultrasound_SI.HAL_list_echo_p.tab_echo[7].pre_max_index "" UWORD flightControlSystem_CM_uint16 0 0 0 65535 ECU_ADDRESS 0x0000 /* @ECU_Address@sensor_inport.HALSensors.HAL_ultrasound_SI.HAL_list_echo_p.tab_echo[7].pre_max_index@ */ /end MEASUREMENT
/begin MEASUREMENT sensor_inport.HALSensors.HAL_ultrasound_SI.HAL_list_echo_p.tab_echo[8].begin_echo_index "" UWORD flightControlSystem_CM_uint16 0 0 0 65535 ECU_ADDRESS 0x0000 /* @ECU_Address@sensor_inport.HALSensors.HAL_ultrasound_SI.HAL_list_echo_p.tab_echo[8].begin_echo_index@ */ /end MEASUREMENT
/begin MEASUREMENT sensor_inport.HALSensors.HAL_ultrasound_SI.HAL_list_echo_p.tab_echo[8].end_echo_index "" UWORD flightControlSystem_CM_uint16 0 0 0 65535 ECU_ADDRESS 0x0000 /* @ECU_Address@sensor_inport.HALSensors.HAL_ultrasound_SI.HAL_list_echo_p.tab_echo[8].end_echo_index@ */ /end MEASUREMENT
/begin MEASUREMENT sensor_inport.HALSensors.HAL_ultrasound_SI.HAL_list_echo_p.tab_echo[8].max_value_index "" SWORD flightControlSystem_CM_int16 0 0 -32768 32767 ECU_ADDRESS 0x0000 /* @ECU_Address@sensor_inport.HALSensors.HAL_ultrasound_SI.HAL_list_echo_p.tab_echo[8].max_value_index@ */ /end MEASUREMENT
/begin MEASUREMENT sensor_inport.HALSensors.HAL_ultrasound_SI.HAL_list_echo_p.tab_echo[8].max_value "" SLONG flightControlSystem_CM_int32 0 0 -2147483648 2147483647 ECU_ADDRESS 0x0000 /* @ECU_Address@sensor_inport.HALSensors.HAL_ultrasound_SI.HAL_list_echo_p.tab_echo[8].max_value@ */ /end MEASUREMENT
/begin MEASUREMENT sensor_inport.HALSensors.HAL_ultrasound_SI.HAL_list_echo_p.tab_echo[8].precedent "" UWORD flightControlSystem_CM_uint16 0 0 0 65535 ECU_ADDRESS 0x0000 /* @ECU_Address@sensor_inport.HALSensors.HAL_ultrasound_SI.HAL_list_echo_p.tab_echo[8].precedent@ */ /end MEASUREMENT
/begin MEASUREMENT sensor_inport.HALSensors.HAL_ultrasound_SI.HAL_list_echo_p.tab_echo[8].d_echo "" SWORD flightControlSystem_CM_int16 0 0 -32768 32767 ECU_ADDRESS 0x0000 /* @ECU_Address@sensor_inport.HALSensors.HAL_ultrasound_SI.HAL_list_echo_p.tab_echo[8].d_echo@ */ /end MEASUREMENT
/begin MEASUREMENT sensor_inport.HALSensors.HAL_ultrasound_SI.HAL_list_echo_p.tab_echo[8].pre_max_index "" UWORD flightControlSystem_CM_uint16 0 0 0 65535 ECU_ADDRESS 0x0000 /* @ECU_Address@sensor_inport.HALSensors.HAL_ultrasound_SI.HAL_list_echo_p.tab_echo[8].pre_max_index@ */ /end MEASUREMENT
/begin MEASUREMENT sensor_inport.HALSensors.HAL_ultrasound_SI.HAL_list_echo_p.tab_echo[9].begin_echo_index "" UWORD flightControlSystem_CM_uint16 0 0 0 65535 ECU_ADDRESS 0x0000 /* @ECU_Address@sensor_inport.HALSensors.HAL_ultrasound_SI.HAL_list_echo_p.tab_echo[9].begin_echo_index@ */ /end MEASUREMENT
/begin MEASUREMENT sensor_inport.HALSensors.HAL_ultrasound_SI.HAL_list_echo_p.tab_echo[9].end_echo_index "" UWORD flightControlSystem_CM_uint16 0 0 0 65535 ECU_ADDRESS 0x0000 /* @ECU_Address@sensor_inport.HALSensors.HAL_ultrasound_SI.HAL_list_echo_p.tab_echo[9].end_echo_index@ */ /end MEASUREMENT
/begin MEASUREMENT sensor_inport.HALSensors.HAL_ultrasound_SI.HAL_list_echo_p.tab_echo[9].max_value_index "" SWORD flightControlSystem_CM_int16 0 0 -32768 32767 ECU_ADDRESS 0x0000 /* @ECU_Address@sensor_inport.HALSensors.HAL_ultrasound_SI.HAL_list_echo_p.tab_echo[9].max_value_index@ */ /end MEASUREMENT
/begin MEASUREMENT sensor_inport.HALSensors.HAL_ultrasound_SI.HAL_list_echo_p.tab_echo[9].max_value "" SLONG flightControlSystem_CM_int32 0 0 -2147483648 2147483647 ECU_ADDRESS 0x0000 /* @ECU_Address@sensor_inport.HALSensors.HAL_ultrasound_SI.HAL_list_echo_p.tab_echo[9].max_value@ */ /end MEASUREMENT
/begin MEASUREMENT sensor_inport.HALSensors.HAL_ultrasound_SI.HAL_list_echo_p.tab_echo[9].precedent "" UWORD flightControlSystem_CM_uint16 0 0 0 65535 ECU_ADDRESS 0x0000 /* @ECU_Address@sensor_inport.HALSensors.HAL_ultrasound_SI.HAL_list_echo_p.tab_echo[9].precedent@ */ /end MEASUREMENT
/begin MEASUREMENT sensor_inport.HALSensors.HAL_ultrasound_SI.HAL_list_echo_p.tab_echo[9].d_echo "" SWORD flightControlSystem_CM_int16 0 0 -32768 32767 ECU_ADDRESS 0x0000 /* @ECU_Address@sensor_inport.HALSensors.HAL_ultrasound_SI.HAL_list_echo_p.tab_echo[9].d_echo@ */ /end MEASUREMENT
/begin MEASUREMENT sensor_inport.HALSensors.HAL_ultrasound_SI.HAL_list_echo_p.tab_echo[9].pre_max_index "" UWORD flightControlSystem_CM_uint16 0 0 0 65535 ECU_ADDRESS 0x0000 /* @ECU_Address@sensor_inport.HALSensors.HAL_ultrasound_SI.HAL_list_echo_p.tab_echo[9].pre_max_index@ */ /end MEASUREMENT
/begin MEASUREMENT sensor_inport.HALSensors.HAL_ultrasound_SI.HAL_list_echo_p.tab_echo[10].begin_echo_index "" UWORD flightControlSystem_CM_uint16 0 0 0 65535 ECU_ADDRESS 0x0000 /* @ECU_Address@sensor_inport.HALSensors.HAL_ultrasound_SI.HAL_list_echo_p.tab_echo[10].begin_echo_index@ */ /end MEASUREMENT
/begin MEASUREMENT sensor_inport.HALSensors.HAL_ultrasound_SI.HAL_list_echo_p.tab_echo[10].end_echo_index "" UWORD flightControlSystem_CM_uint16 0 0 0 65535 ECU_ADDRESS 0x0000 /* @ECU_Address@sensor_inport.HALSensors.HAL_ultrasound_SI.HAL_list_echo_p.tab_echo[10].end_echo_index@ */ /end MEASUREMENT
/begin MEASUREMENT sensor_inport.HALSensors.HAL_ultrasound_SI.HAL_list_echo_p.tab_echo[10].max_value_index "" SWORD flightControlSystem_CM_int16 0 0 -32768 32767 ECU_ADDRESS 0x0000 /* @ECU_Address@sensor_inport.HALSensors.HAL_ultrasound_SI.HAL_list_echo_p.tab_echo[10].max_value_index@ */ /end MEASUREMENT
/begin MEASUREMENT sensor_inport.HALSensors.HAL_ultrasound_SI.HAL_list_echo_p.tab_echo[10].max_value "" SLONG flightControlSystem_CM_int32 0 0 -2147483648 2147483647 ECU_ADDRESS 0x0000 /* @ECU_Address@sensor_inport.HALSensors.HAL_ultrasound_SI.HAL_list_echo_p.tab_echo[10].max_value@ */ /end MEASUREMENT
/begin MEASUREMENT sensor_inport.HALSensors.HAL_ultrasound_SI.HAL_list_echo_p.tab_echo[10].precedent "" UWORD flightControlSystem_CM_uint16 0 0 0 65535 ECU_ADDRESS 0x0000 /* @ECU_Address@sensor_inport.HALSensors.HAL_ultrasound_SI.HAL_list_echo_p.tab_echo[10].precedent@ */ /end MEASUREMENT
/begin MEASUREMENT sensor_inport.HALSensors.HAL_ultrasound_SI.HAL_list_echo_p.tab_echo[10].d_echo "" SWORD flightControlSystem_CM_int16 0 0 -32768 32767 ECU_ADDRESS 0x0000 /* @ECU_Address@sensor_inport.HALSensors.HAL_ultrasound_SI.HAL_list_echo_p.tab_echo[10].d_echo@ */ /end MEASUREMENT
/begin MEASUREMENT sensor_inport.HALSensors.HAL_ultrasound_SI.HAL_list_echo_p.tab_echo[10].pre_max_index "" UWORD flightControlSystem_CM_uint16 0 0 0 65535 ECU_ADDRESS 0x0000 /* @ECU_Address@sensor_inport.HALSensors.HAL_ultrasound_SI.HAL_list_echo_p.tab_echo[10].pre_max_index@ */ /end MEASUREMENT
/begin MEASUREMENT sensor_inport.HALSensors.HAL_ultrasound_SI.HAL_list_echo_p.tab_echo[11].begin_echo_index "" UWORD flightControlSystem_CM_uint16 0 0 0 65535 ECU_ADDRESS 0x0000 /* @ECU_Address@sensor_inport.HALSensors.HAL_ultrasound_SI.HAL_list_echo_p.tab_echo[11].begin_echo_index@ */ /end MEASUREMENT
/begin MEASUREMENT sensor_inport.HALSensors.HAL_ultrasound_SI.HAL_list_echo_p.tab_echo[11].end_echo_index "" UWORD flightControlSystem_CM_uint16 0 0 0 65535 ECU_ADDRESS 0x0000 /* @ECU_Address@sensor_inport.HALSensors.HAL_ultrasound_SI.HAL_list_echo_p.tab_echo[11].end_echo_index@ */ /end MEASUREMENT
/begin MEASUREMENT sensor_inport.HALSensors.HAL_ultrasound_SI.HAL_list_echo_p.tab_echo[11].max_value_index "" SWORD flightControlSystem_CM_int16 0 0 -32768 32767 ECU_ADDRESS 0x0000 /* @ECU_Address@sensor_inport.HALSensors.HAL_ultrasound_SI.HAL_list_echo_p.tab_echo[11].max_value_index@ */ /end MEASUREMENT
/begin MEASUREMENT sensor_inport.HALSensors.HAL_ultrasound_SI.HAL_list_echo_p.tab_echo[11].max_value "" SLONG flightControlSystem_CM_int32 0 0 -2147483648 2147483647 ECU_ADDRESS 0x0000 /* @ECU_Address@sensor_inport.HALSensors.HAL_ultrasound_SI.HAL_list_echo_p.tab_echo[11].max_value@ */ /end MEASUREMENT
/begin MEASUREMENT sensor_inport.HALSensors.HAL_ultrasound_SI.HAL_list_echo_p.tab_echo[11].precedent "" UWORD flightControlSystem_CM_uint16 0 0 0 65535 ECU_ADDRESS 0x0000 /* @ECU_Address@sensor_inport.HALSensors.HAL_ultrasound_SI.HAL_list_echo_p.tab_echo[11].precedent@ */ /end MEASUREMENT
/begin MEASUREMENT sensor_inport.HALSensors.HAL_ultrasound_SI.HAL_list_echo_p.tab_echo[11].d_echo "" SWORD flightControlSystem_CM_int16 0 0 -32768 32767 ECU_ADDRESS 0x0000 /* @ECU_Address@sensor_inport.HALSensors.HAL_ultrasound_SI.HAL_list_echo_p.tab_echo[11].d_echo@ */ /end MEASUREMENT
/begin MEASUREMENT sensor_inport.HALSensors.HAL_ultrasound_SI.HAL_list_echo_p.tab_echo[11].pre_max_index "" UWORD flightControlSystem_CM_uint16 0 0 0 65535 ECU_ADDRESS 0x0000 /* @ECU_Address@sensor_inport.HALSensors.HAL_ultrasound_SI.HAL_list_echo_p.tab_echo[11].pre_max_index@ */ /end MEASUREMENT
/begin MEASUREMENT sensor_inport.HALSensors.HAL_ultrasound_SI.HAL_list_echo_p.tab_echo[12].begin_echo_index "" UWORD flightControlSystem_CM_uint16 0 0 0 65535 ECU_ADDRESS 0x0000 /* @ECU_Address@sensor_inport.HALSensors.HAL_ultrasound_SI.HAL_list_echo_p.tab_echo[12].begin_echo_index@ */ /end MEASUREMENT
/begin MEASUREMENT sensor_inport.HALSensors.HAL_ultrasound_SI.HAL_list_echo_p.tab_echo[12].end_echo_index "" UWORD flightControlSystem_CM_uint16 0 0 0 65535 ECU_ADDRESS 0x0000 /* @ECU_Address@sensor_inport.HALSensors.HAL_ultrasound_SI.HAL_list_echo_p.tab_echo[12].end_echo_index@ */ /end MEASUREMENT
/begin MEASUREMENT sensor_inport.HALSensors.HAL_ultrasound_SI.HAL_list_echo_p.tab_echo[12].max_value_index "" SWORD flightControlSystem_CM_int16 0 0 -32768 32767 ECU_ADDRESS 0x0000 /* @ECU_Address@sensor_inport.HALSensors.HAL_ultrasound_SI.HAL_list_echo_p.tab_echo[12].max_value_index@ */ /end MEASUREMENT
/begin MEASUREMENT sensor_inport.HALSensors.HAL_ultrasound_SI.HAL_list_echo_p.tab_echo[12].max_value "" SLONG flightControlSystem_CM_int32 0 0 -2147483648 2147483647 ECU_ADDRESS 0x0000 /* @ECU_Address@sensor_inport.HALSensors.HAL_ultrasound_SI.HAL_list_echo_p.tab_echo[12].max_value@ */ /end MEASUREMENT
/begin MEASUREMENT sensor_inport.HALSensors.HAL_ultrasound_SI.HAL_list_echo_p.tab_echo[12].precedent "" UWORD flightControlSystem_CM_uint16 0 0 0 65535 ECU_ADDRESS 0x0000 /* @ECU_Address@sensor_inport.HALSensors.HAL_ultrasound_SI.HAL_list_echo_p.tab_echo[12].precedent@ */ /end MEASUREMENT
/begin MEASUREMENT sensor_inport.HALSensors.HAL_ultrasound_SI.HAL_list_echo_p.tab_echo[12].d_echo "" SWORD flightControlSystem_CM_int16 0 0 -32768 32767 ECU_ADDRESS 0x0000 /* @ECU_Address@sensor_inport.HALSensors.HAL_ultrasound_SI.HAL_list_echo_p.tab_echo[12].d_echo@ */ /end MEASUREMENT
/begin MEASUREMENT sensor_inport.HALSensors.HAL_ultrasound_SI.HAL_list_echo_p.tab_echo[12].pre_max_index "" UWORD flightControlSystem_CM_uint16 0 0 0 65535 ECU_ADDRESS 0x0000 /* @ECU_Address@sensor_inport.HALSensors.HAL_ultrasound_SI.HAL_list_echo_p.tab_echo[12].pre_max_index@ */ /end MEASUREMENT
/begin MEASUREMENT sensor_inport.HALSensors.HAL_ultrasound_SI.HAL_list_echo_p.tab_echo[13].begin_echo_index "" UWORD flightControlSystem_CM_uint16 0 0 0 65535 ECU_ADDRESS 0x0000 /* @ECU_Address@sensor_inport.HALSensors.HAL_ultrasound_SI.HAL_list_echo_p.tab_echo[13].begin_echo_index@ */ /end MEASUREMENT
/begin MEASUREMENT sensor_inport.HALSensors.HAL_ultrasound_SI.HAL_list_echo_p.tab_echo[13].end_echo_index "" UWORD flightControlSystem_CM_uint16 0 0 0 65535 ECU_ADDRESS 0x0000 /* @ECU_Address@sensor_inport.HALSensors.HAL_ultrasound_SI.HAL_list_echo_p.tab_echo[13].end_echo_index@ */ /end MEASUREMENT
/begin MEASUREMENT sensor_inport.HALSensors.HAL_ultrasound_SI.HAL_list_echo_p.tab_echo[13].max_value_index "" SWORD flightControlSystem_CM_int16 0 0 -32768 32767 ECU_ADDRESS 0x0000 /* @ECU_Address@sensor_inport.HALSensors.HAL_ultrasound_SI.HAL_list_echo_p.tab_echo[13].max_value_index@ */ /end MEASUREMENT
/begin MEASUREMENT sensor_inport.HALSensors.HAL_ultrasound_SI.HAL_list_echo_p.tab_echo[13].max_value "" SLONG flightControlSystem_CM_int32 0 0 -2147483648 2147483647 ECU_ADDRESS 0x0000 /* @ECU_Address@sensor_inport.HALSensors.HAL_ultrasound_SI.HAL_list_echo_p.tab_echo[13].max_value@ */ /end MEASUREMENT
/begin MEASUREMENT sensor_inport.HALSensors.HAL_ultrasound_SI.HAL_list_echo_p.tab_echo[13].precedent "" UWORD flightControlSystem_CM_uint16 0 0 0 65535 ECU_ADDRESS 0x0000 /* @ECU_Address@sensor_inport.HALSensors.HAL_ultrasound_SI.HAL_list_echo_p.tab_echo[13].precedent@ */ /end MEASUREMENT
/begin MEASUREMENT sensor_inport.HALSensors.HAL_ultrasound_SI.HAL_list_echo_p.tab_echo[13].d_echo "" SWORD flightControlSystem_CM_int16 0 0 -32768 32767 ECU_ADDRESS 0x0000 /* @ECU_Address@sensor_inport.HALSensors.HAL_ultrasound_SI.HAL_list_echo_p.tab_echo[13].d_echo@ */ /end MEASUREMENT
/begin MEASUREMENT sensor_inport.HALSensors.HAL_ultrasound_SI.HAL_list_echo_p.tab_echo[13].pre_max_index "" UWORD flightControlSystem_CM_uint16 0 0 0 65535 ECU_ADDRESS 0x0000 /* @ECU_Address@sensor_inport.HALSensors.HAL_ultrasound_SI.HAL_list_echo_p.tab_echo[13].pre_max_index@ */ /end MEASUREMENT
/begin MEASUREMENT sensor_inport.HALSensors.HAL_ultrasound_SI.HAL_list_echo_p.tab_echo[14].begin_echo_index "" UWORD flightControlSystem_CM_uint16 0 0 0 65535 ECU_ADDRESS 0x0000 /* @ECU_Address@sensor_inport.HALSensors.HAL_ultrasound_SI.HAL_list_echo_p.tab_echo[14].begin_echo_index@ */ /end MEASUREMENT
/begin MEASUREMENT sensor_inport.HALSensors.HAL_ultrasound_SI.HAL_list_echo_p.tab_echo[14].end_echo_index "" UWORD flightControlSystem_CM_uint16 0 0 0 65535 ECU_ADDRESS 0x0000 /* @ECU_Address@sensor_inport.HALSensors.HAL_ultrasound_SI.HAL_list_echo_p.tab_echo[14].end_echo_index@ */ /end MEASUREMENT
/begin MEASUREMENT sensor_inport.HALSensors.HAL_ultrasound_SI.HAL_list_echo_p.tab_echo[14].max_value_index "" SWORD flightControlSystem_CM_int16 0 0 -32768 32767 ECU_ADDRESS 0x0000 /* @ECU_Address@sensor_inport.HALSensors.HAL_ultrasound_SI.HAL_list_echo_p.tab_echo[14].max_value_index@ */ /end MEASUREMENT
/begin MEASUREMENT sensor_inport.HALSensors.HAL_ultrasound_SI.HAL_list_echo_p.tab_echo[14].max_value "" SLONG flightControlSystem_CM_int32 0 0 -2147483648 2147483647 ECU_ADDRESS 0x0000 /* @ECU_Address@sensor_inport.HALSensors.HAL_ultrasound_SI.HAL_list_echo_p.tab_echo[14].max_value@ */ /end MEASUREMENT
/begin MEASUREMENT sensor_inport.HALSensors.HAL_ultrasound_SI.HAL_list_echo_p.tab_echo[14].precedent "" UWORD flightControlSystem_CM_uint16 0 0 0 65535 ECU_ADDRESS 0x0000 /* @ECU_Address@sensor_inport.HALSensors.HAL_ultrasound_SI.HAL_list_echo_p.tab_echo[14].precedent@ */ /end MEASUREMENT
/begin MEASUREMENT sensor_inport.HALSensors.HAL_ultrasound_SI.HAL_list_echo_p.tab_echo[14].d_echo "" SWORD flightControlSystem_CM_int16 0 0 -32768 32767 ECU_ADDRESS 0x0000 /* @ECU_Address@sensor_inport.HALSensors.HAL_ultrasound_SI.HAL_list_echo_p.tab_echo[14].d_echo@ */ /end MEASUREMENT
/begin MEASUREMENT sensor_inport.HALSensors.HAL_ultrasound_SI.HAL_list_echo_p.tab_echo[14].pre_max_index "" UWORD flightControlSystem_CM_uint16 0 0 0 65535 ECU_ADDRESS 0x0000 /* @ECU_Address@sensor_inport.HALSensors.HAL_ultrasound_SI.HAL_list_echo_p.tab_echo[14].pre_max_index@ */ /end MEASUREMENT
/begin MEASUREMENT sensor_inport.HALSensors.HAL_ultrasound_SI.HAL_list_echo_p.tab_echo[15].begin_echo_index "" UWORD flightControlSystem_CM_uint16 0 0 0 65535 ECU_ADDRESS 0x0000 /* @ECU_Address@sensor_inport.HALSensors.HAL_ultrasound_SI.HAL_list_echo_p.tab_echo[15].begin_echo_index@ */ /end MEASUREMENT
/begin MEASUREMENT sensor_inport.HALSensors.HAL_ultrasound_SI.HAL_list_echo_p.tab_echo[15].end_echo_index "" UWORD flightControlSystem_CM_uint16 0 0 0 65535 ECU_ADDRESS 0x0000 /* @ECU_Address@sensor_inport.HALSensors.HAL_ultrasound_SI.HAL_list_echo_p.tab_echo[15].end_echo_index@ */ /end MEASUREMENT
/begin MEASUREMENT sensor_inport.HALSensors.HAL_ultrasound_SI.HAL_list_echo_p.tab_echo[15].max_value_index "" SWORD flightControlSystem_CM_int16 0 0 -32768 32767 ECU_ADDRESS 0x0000 /* @ECU_Address@sensor_inport.HALSensors.HAL_ultrasound_SI.HAL_list_echo_p.tab_echo[15].max_value_index@ */ /end MEASUREMENT
/begin MEASUREMENT sensor_inport.HALSensors.HAL_ultrasound_SI.HAL_list_echo_p.tab_echo[15].max_value "" SLONG flightControlSystem_CM_int32 0 0 -2147483648 2147483647 ECU_ADDRESS 0x0000 /* @ECU_Address@sensor_inport.HALSensors.HAL_ultrasound_SI.HAL_list_echo_p.tab_echo[15].max_value@ */ /end MEASUREMENT
/begin MEASUREMENT sensor_inport.HALSensors.HAL_ultrasound_SI.HAL_list_echo_p.tab_echo[15].precedent "" UWORD flightControlSystem_CM_uint16 0 0 0 65535 ECU_ADDRESS 0x0000 /* @ECU_Address@sensor_inport.HALSensors.HAL_ultrasound_SI.HAL_list_echo_p.tab_echo[15].precedent@ */ /end MEASUREMENT
/begin MEASUREMENT sensor_inport.HALSensors.HAL_ultrasound_SI.HAL_list_echo_p.tab_echo[15].d_echo "" SWORD flightControlSystem_CM_int16 0 0 -32768 32767 ECU_ADDRESS 0x0000 /* @ECU_Address@sensor_inport.HALSensors.HAL_ultrasound_SI.HAL_list_echo_p.tab_echo[15].d_echo@ */ /end MEASUREMENT
/begin MEASUREMENT sensor_inport.HALSensors.HAL_ultrasound_SI.HAL_list_echo_p.tab_echo[15].pre_max_index "" UWORD flightControlSystem_CM_uint16 0 0 0 65535 ECU_ADDRESS 0x0000 /* @ECU_Address@sensor_inport.HALSensors.HAL_ultrasound_SI.HAL_list_echo_p.tab_echo[15].pre_max_index@ */ /end MEASUREMENT
/begin MEASUREMENT sensor_inport.HALSensors.HAL_ultrasound_SI.HAL_list_echo_p.tab_echo[16].begin_echo_index "" UWORD flightControlSystem_CM_uint16 0 0 0 65535 ECU_ADDRESS 0x0000 /* @ECU_Address@sensor_inport.HALSensors.HAL_ultrasound_SI.HAL_list_echo_p.tab_echo[16].begin_echo_index@ */ /end MEASUREMENT
/begin MEASUREMENT sensor_inport.HALSensors.HAL_ultrasound_SI.HAL_list_echo_p.tab_echo[16].end_echo_index "" UWORD flightControlSystem_CM_uint16 0 0 0 65535 ECU_ADDRESS 0x0000 /* @ECU_Address@sensor_inport.HALSensors.HAL_ultrasound_SI.HAL_list_echo_p.tab_echo[16].end_echo_index@ */ /end MEASUREMENT
/begin MEASUREMENT sensor_inport.HALSensors.HAL_ultrasound_SI.HAL_list_echo_p.tab_echo[16].max_value_index "" SWORD flightControlSystem_CM_int16 0 0 -32768 32767 ECU_ADDRESS 0x0000 /* @ECU_Address@sensor_inport.HALSensors.HAL_ultrasound_SI.HAL_list_echo_p.tab_echo[16].max_value_index@ */ /end MEASUREMENT
/begin MEASUREMENT sensor_inport.HALSensors.HAL_ultrasound_SI.HAL_list_echo_p.tab_echo[16].max_value "" SLONG flightControlSystem_CM_int32 0 0 -2147483648 2147483647 ECU_ADDRESS 0x0000 /* @ECU_Address@sensor_inport.HALSensors.HAL_ultrasound_SI.HAL_list_echo_p.tab_echo[16].max_value@ */ /end MEASUREMENT
/begin MEASUREMENT sensor_inport.HALSensors.HAL_ultrasound_SI.HAL_list_echo_p.tab_echo[16].precedent "" UWORD flightControlSystem_CM_uint16 0 0 0 65535 ECU_ADDRESS 0x0000 /* @ECU_Address@sensor_inport.HALSensors.HAL_ultrasound_SI.HAL_list_echo_p.tab_echo[16].precedent@ */ /end MEASUREMENT
/begin MEASUREMENT sensor_inport.HALSensors.HAL_ultrasound_SI.HAL_list_echo_p.tab_echo[16].d_echo "" SWORD flightControlSystem_CM_int16 0 0 -32768 32767 ECU_ADDRESS 0x0000 /* @ECU_Address@sensor_inport.HALSensors.HAL_ultrasound_SI.HAL_list_echo_p.tab_echo[16].d_echo@ */ /end MEASUREMENT
/begin MEASUREMENT sensor_inport.HALSensors.HAL_ultrasound_SI.HAL_list_echo_p.tab_echo[16].pre_max_index "" UWORD flightControlSystem_CM_uint16 0 0 0 65535 ECU_ADDRESS 0x0000 /* @ECU_Address@sensor_inport.HALSensors.HAL_ultrasound_SI.HAL_list_echo_p.tab_echo[16].pre_max_index@ */ /end MEASUREMENT
/begin MEASUREMENT sensor_inport.HALSensors.HAL_ultrasound_SI.HAL_list_echo_p.tab_echo[17].begin_echo_index "" UWORD flightControlSystem_CM_uint16 0 0 0 65535 ECU_ADDRESS 0x0000 /* @ECU_Address@sensor_inport.HALSensors.HAL_ultrasound_SI.HAL_list_echo_p.tab_echo[17].begin_echo_index@ */ /end MEASUREMENT
/begin MEASUREMENT sensor_inport.HALSensors.HAL_ultrasound_SI.HAL_list_echo_p.tab_echo[17].end_echo_index "" UWORD flightControlSystem_CM_uint16 0 0 0 65535 ECU_ADDRESS 0x0000 /* @ECU_Address@sensor_inport.HALSensors.HAL_ultrasound_SI.HAL_list_echo_p.tab_echo[17].end_echo_index@ */ /end MEASUREMENT
/begin MEASUREMENT sensor_inport.HALSensors.HAL_ultrasound_SI.HAL_list_echo_p.tab_echo[17].max_value_index "" SWORD flightControlSystem_CM_int16 0 0 -32768 32767 ECU_ADDRESS 0x0000 /* @ECU_Address@sensor_inport.HALSensors.HAL_ultrasound_SI.HAL_list_echo_p.tab_echo[17].max_value_index@ */ /end MEASUREMENT
/begin MEASUREMENT sensor_inport.HALSensors.HAL_ultrasound_SI.HAL_list_echo_p.tab_echo[17].max_value "" SLONG flightControlSystem_CM_int32 0 0 -2147483648 2147483647 ECU_ADDRESS 0x0000 /* @ECU_Address@sensor_inport.HALSensors.HAL_ultrasound_SI.HAL_list_echo_p.tab_echo[17].max_value@ */ /end MEASUREMENT
/begin MEASUREMENT sensor_inport.HALSensors.HAL_ultrasound_SI.HAL_list_echo_p.tab_echo[17].precedent "" UWORD flightControlSystem_CM_uint16 0 0 0 65535 ECU_ADDRESS 0x0000 /* @ECU_Address@sensor_inport.HALSensors.HAL_ultrasound_SI.HAL_list_echo_p.tab_echo[17].precedent@ */ /end MEASUREMENT
/begin MEASUREMENT sensor_inport.HALSensors.HAL_ultrasound_SI.HAL_list_echo_p.tab_echo[17].d_echo "" SWORD flightControlSystem_CM_int16 0 0 -32768 32767 ECU_ADDRESS 0x0000 /* @ECU_Address@sensor_inport.HALSensors.HAL_ultrasound_SI.HAL_list_echo_p.tab_echo[17].d_echo@ */ /end MEASUREMENT
/begin MEASUREMENT sensor_inport.HALSensors.HAL_ultrasound_SI.HAL_list_echo_p.tab_echo[17].pre_max_index "" UWORD flightControlSystem_CM_uint16 0 0 0 65535 ECU_ADDRESS 0x0000 /* @ECU_Address@sensor_inport.HALSensors.HAL_ultrasound_SI.HAL_list_echo_p.tab_echo[17].pre_max_index@ */ /end MEASUREMENT
/begin MEASUREMENT sensor_inport.HALSensors.HAL_ultrasound_SI.HAL_list_echo_p.tab_echo[18].begin_echo_index "" UWORD flightControlSystem_CM_uint16 0 0 0 65535 ECU_ADDRESS 0x0000 /* @ECU_Address@sensor_inport.HALSensors.HAL_ultrasound_SI.HAL_list_echo_p.tab_echo[18].begin_echo_index@ */ /end MEASUREMENT
/begin MEASUREMENT sensor_inport.HALSensors.HAL_ultrasound_SI.HAL_list_echo_p.tab_echo[18].end_echo_index "" UWORD flightControlSystem_CM_uint16 0 0 0 65535 ECU_ADDRESS 0x0000 /* @ECU_Address@sensor_inport.HALSensors.HAL_ultrasound_SI.HAL_list_echo_p.tab_echo[18].end_echo_index@ */ /end MEASUREMENT
/begin MEASUREMENT sensor_inport.HALSensors.HAL_ultrasound_SI.HAL_list_echo_p.tab_echo[18].max_value_index "" SWORD flightControlSystem_CM_int16 0 0 -32768 32767 ECU_ADDRESS 0x0000 /* @ECU_Address@sensor_inport.HALSensors.HAL_ultrasound_SI.HAL_list_echo_p.tab_echo[18].max_value_index@ */ /end MEASUREMENT
/begin MEASUREMENT sensor_inport.HALSensors.HAL_ultrasound_SI.HAL_list_echo_p.tab_echo[18].max_value "" SLONG flightControlSystem_CM_int32 0 0 -2147483648 2147483647 ECU_ADDRESS 0x0000 /* @ECU_Address@sensor_inport.HALSensors.HAL_ultrasound_SI.HAL_list_echo_p.tab_echo[18].max_value@ */ /end MEASUREMENT
/begin MEASUREMENT sensor_inport.HALSensors.HAL_ultrasound_SI.HAL_list_echo_p.tab_echo[18].precedent "" UWORD flightControlSystem_CM_uint16 0 0 0 65535 ECU_ADDRESS 0x0000 /* @ECU_Address@sensor_inport.HALSensors.HAL_ultrasound_SI.HAL_list_echo_p.tab_echo[18].precedent@ */ /end MEASUREMENT
/begin MEASUREMENT sensor_inport.HALSensors.HAL_ultrasound_SI.HAL_list_echo_p.tab_echo[18].d_echo "" SWORD flightControlSystem_CM_int16 0 0 -32768 32767 ECU_ADDRESS 0x0000 /* @ECU_Address@sensor_inport.HALSensors.HAL_ultrasound_SI.HAL_list_echo_p.tab_echo[18].d_echo@ */ /end MEASUREMENT
/begin MEASUREMENT sensor_inport.HALSensors.HAL_ultrasound_SI.HAL_list_echo_p.tab_echo[18].pre_max_index "" UWORD flightControlSystem_CM_uint16 0 0 0 65535 ECU_ADDRESS 0x0000 /* @ECU_Address@sensor_inport.HALSensors.HAL_ultrasound_SI.HAL_list_echo_p.tab_echo[18].pre_max_index@ */ /end MEASUREMENT
/begin MEASUREMENT sensor_inport.HALSensors.HAL_ultrasound_SI.HAL_list_echo_p.tab_echo[19].begin_echo_index "" UWORD flightControlSystem_CM_uint16 0 0 0 65535 ECU_ADDRESS 0x0000 /* @ECU_Address@sensor_inport.HALSensors.HAL_ultrasound_SI.HAL_list_echo_p.tab_echo[19].begin_echo_index@ */ /end MEASUREMENT
/begin MEASUREMENT sensor_inport.HALSensors.HAL_ultrasound_SI.HAL_list_echo_p.tab_echo[19].end_echo_index "" UWORD flightControlSystem_CM_uint16 0 0 0 65535 ECU_ADDRESS 0x0000 /* @ECU_Address@sensor_inport.HALSensors.HAL_ultrasound_SI.HAL_list_echo_p.tab_echo[19].end_echo_index@ */ /end MEASUREMENT
/begin MEASUREMENT sensor_inport.HALSensors.HAL_ultrasound_SI.HAL_list_echo_p.tab_echo[19].max_value_index "" SWORD flightControlSystem_CM_int16 0 0 -32768 32767 ECU_ADDRESS 0x0000 /* @ECU_Address@sensor_inport.HALSensors.HAL_ultrasound_SI.HAL_list_echo_p.tab_echo[19].max_value_index@ */ /end MEASUREMENT
/begin MEASUREMENT sensor_inport.HALSensors.HAL_ultrasound_SI.HAL_list_echo_p.tab_echo[19].max_value "" SLONG flightControlSystem_CM_int32 0 0 -2147483648 2147483647 ECU_ADDRESS 0x0000 /* @ECU_Address@sensor_inport.HALSensors.HAL_ultrasound_SI.HAL_list_echo_p.tab_echo[19].max_value@ */ /end MEASUREMENT
/begin MEASUREMENT sensor_inport.HALSensors.HAL_ultrasound_SI.HAL_list_echo_p.tab_echo[19].precedent "" UWORD flightControlSystem_CM_uint16 0 0 0 65535 ECU_ADDRESS 0x0000 /* @ECU_Address@sensor_inport.HALSensors.HAL_ultrasound_SI.HAL_list_echo_p.tab_echo[19].precedent@ */ /end MEASUREMENT
/begin MEASUREMENT sensor_inport.HALSensors.HAL_ultrasound_SI.HAL_list_echo_p.tab_echo[19].d_echo "" SWORD flightControlSystem_CM_int16 0 0 -32768 32767 ECU_ADDRESS 0x0000 /* @ECU_Address@sensor_inport.HALSensors.HAL_ultrasound_SI.HAL_list_echo_p.tab_echo[19].d_echo@ */ /end MEASUREMENT
/begin MEASUREMENT sensor_inport.HALSensors.HAL_ultrasound_SI.HAL_list_echo_p.tab_echo[19].pre_max_index "" UWORD flightControlSystem_CM_uint16 0 0 0 65535 ECU_ADDRESS 0x0000 /* @ECU_Address@sensor_inport.HALSensors.HAL_ultrasound_SI.HAL_list_echo_p.tab_echo[19].pre_max_index@ */ /end MEASUREMENT
/begin MEASUREMENT sensor_inport.HALSensors.HAL_ultrasound_SI.HAL_list_echo_p.tab_echo[20].begin_echo_index "" UWORD flightControlSystem_CM_uint16 0 0 0 65535 ECU_ADDRESS 0x0000 /* @ECU_Address@sensor_inport.HALSensors.HAL_ultrasound_SI.HAL_list_echo_p.tab_echo[20].begin_echo_index@ */ /end MEASUREMENT
/begin MEASUREMENT sensor_inport.HALSensors.HAL_ultrasound_SI.HAL_list_echo_p.tab_echo[20].end_echo_index "" UWORD flightControlSystem_CM_uint16 0 0 0 65535 ECU_ADDRESS 0x0000 /* @ECU_Address@sensor_inport.HALSensors.HAL_ultrasound_SI.HAL_list_echo_p.tab_echo[20].end_echo_index@ */ /end MEASUREMENT
/begin MEASUREMENT sensor_inport.HALSensors.HAL_ultrasound_SI.HAL_list_echo_p.tab_echo[20].max_value_index "" SWORD flightControlSystem_CM_int16 0 0 -32768 32767 ECU_ADDRESS 0x0000 /* @ECU_Address@sensor_inport.HALSensors.HAL_ultrasound_SI.HAL_list_echo_p.tab_echo[20].max_value_index@ */ /end MEASUREMENT
/begin MEASUREMENT sensor_inport.HALSensors.HAL_ultrasound_SI.HAL_list_echo_p.tab_echo[20].max_value "" SLONG flightControlSystem_CM_int32 0 0 -2147483648 2147483647 ECU_ADDRESS 0x0000 /* @ECU_Address@sensor_inport.HALSensors.HAL_ultrasound_SI.HAL_list_echo_p.tab_echo[20].max_value@ */ /end MEASUREMENT
/begin MEASUREMENT sensor_inport.HALSensors.HAL_ultrasound_SI.HAL_list_echo_p.tab_echo[20].precedent "" UWORD flightControlSystem_CM_uint16 0 0 0 65535 ECU_ADDRESS 0x0000 /* @ECU_Address@sensor_inport.HALSensors.HAL_ultrasound_SI.HAL_list_echo_p.tab_echo[20].precedent@ */ /end MEASUREMENT
/begin MEASUREMENT sensor_inport.HALSensors.HAL_ultrasound_SI.HAL_list_echo_p.tab_echo[20].d_echo "" SWORD flightControlSystem_CM_int16 0 0 -32768 32767 ECU_ADDRESS 0x0000 /* @ECU_Address@sensor_inport.HALSensors.HAL_ultrasound_SI.HAL_list_echo_p.tab_echo[20].d_echo@ */ /end MEASUREMENT
/begin MEASUREMENT sensor_inport.HALSensors.HAL_ultrasound_SI.HAL_list_echo_p.tab_echo[20].pre_max_index "" UWORD flightControlSystem_CM_uint16 0 0 0 65535 ECU_ADDRESS 0x0000 /* @ECU_Address@sensor_inport.HALSensors.HAL_ultrasound_SI.HAL_list_echo_p.tab_echo[20].pre_max_index@ */ /end MEASUREMENT
/begin MEASUREMENT sensor_inport.HALSensors.HAL_ultrasound_SI.HAL_list_echo_p.tab_echo[21].begin_echo_index "" UWORD flightControlSystem_CM_uint16 0 0 0 65535 ECU_ADDRESS 0x0000 /* @ECU_Address@sensor_inport.HALSensors.HAL_ultrasound_SI.HAL_list_echo_p.tab_echo[21].begin_echo_index@ */ /end MEASUREMENT
/begin MEASUREMENT sensor_inport.HALSensors.HAL_ultrasound_SI.HAL_list_echo_p.tab_echo[21].end_echo_index "" UWORD flightControlSystem_CM_uint16 0 0 0 65535 ECU_ADDRESS 0x0000 /* @ECU_Address@sensor_inport.HALSensors.HAL_ultrasound_SI.HAL_list_echo_p.tab_echo[21].end_echo_index@ */ /end MEASUREMENT
/begin MEASUREMENT sensor_inport.HALSensors.HAL_ultrasound_SI.HAL_list_echo_p.tab_echo[21].max_value_index "" SWORD flightControlSystem_CM_int16 0 0 -32768 32767 ECU_ADDRESS 0x0000 /* @ECU_Address@sensor_inport.HALSensors.HAL_ultrasound_SI.HAL_list_echo_p.tab_echo[21].max_value_index@ */ /end MEASUREMENT
/begin MEASUREMENT sensor_inport.HALSensors.HAL_ultrasound_SI.HAL_list_echo_p.tab_echo[21].max_value "" SLONG flightControlSystem_CM_int32 0 0 -2147483648 2147483647 ECU_ADDRESS 0x0000 /* @ECU_Address@sensor_inport.HALSensors.HAL_ultrasound_SI.HAL_list_echo_p.tab_echo[21].max_value@ */ /end MEASUREMENT
/begin MEASUREMENT sensor_inport.HALSensors.HAL_ultrasound_SI.HAL_list_echo_p.tab_echo[21].precedent "" UWORD flightControlSystem_CM_uint16 0 0 0 65535 ECU_ADDRESS 0x0000 /* @ECU_Address@sensor_inport.HALSensors.HAL_ultrasound_SI.HAL_list_echo_p.tab_echo[21].precedent@ */ /end MEASUREMENT
/begin MEASUREMENT sensor_inport.HALSensors.HAL_ultrasound_SI.HAL_list_echo_p.tab_echo[21].d_echo "" SWORD flightControlSystem_CM_int16 0 0 -32768 32767 ECU_ADDRESS 0x0000 /* @ECU_Address@sensor_inport.HALSensors.HAL_ultrasound_SI.HAL_list_echo_p.tab_echo[21].d_echo@ */ /end MEASUREMENT
/begin MEASUREMENT sensor_inport.HALSensors.HAL_ultrasound_SI.HAL_list_echo_p.tab_echo[21].pre_max_index "" UWORD flightControlSystem_CM_uint16 0 0 0 65535 ECU_ADDRESS 0x0000 /* @ECU_Address@sensor_inport.HALSensors.HAL_ultrasound_SI.HAL_list_echo_p.tab_echo[21].pre_max_index@ */ /end MEASUREMENT
/begin MEASUREMENT sensor_inport.HALSensors.HAL_ultrasound_SI.HAL_list_echo_p.tab_echo[22].begin_echo_index "" UWORD flightControlSystem_CM_uint16 0 0 0 65535 ECU_ADDRESS 0x0000 /* @ECU_Address@sensor_inport.HALSensors.HAL_ultrasound_SI.HAL_list_echo_p.tab_echo[22].begin_echo_index@ */ /end MEASUREMENT
/begin MEASUREMENT sensor_inport.HALSensors.HAL_ultrasound_SI.HAL_list_echo_p.tab_echo[22].end_echo_index "" UWORD flightControlSystem_CM_uint16 0 0 0 65535 ECU_ADDRESS 0x0000 /* @ECU_Address@sensor_inport.HALSensors.HAL_ultrasound_SI.HAL_list_echo_p.tab_echo[22].end_echo_index@ */ /end MEASUREMENT
/begin MEASUREMENT sensor_inport.HALSensors.HAL_ultrasound_SI.HAL_list_echo_p.tab_echo[22].max_value_index "" SWORD flightControlSystem_CM_int16 0 0 -32768 32767 ECU_ADDRESS 0x0000 /* @ECU_Address@sensor_inport.HALSensors.HAL_ultrasound_SI.HAL_list_echo_p.tab_echo[22].max_value_index@ */ /end MEASUREMENT
/begin MEASUREMENT sensor_inport.HALSensors.HAL_ultrasound_SI.HAL_list_echo_p.tab_echo[22].max_value "" SLONG flightControlSystem_CM_int32 0 0 -2147483648 2147483647 ECU_ADDRESS 0x0000 /* @ECU_Address@sensor_inport.HALSensors.HAL_ultrasound_SI.HAL_list_echo_p.tab_echo[22].max_value@ */ /end MEASUREMENT
/begin MEASUREMENT sensor_inport.HALSensors.HAL_ultrasound_SI.HAL_list_echo_p.tab_echo[22].precedent "" UWORD flightControlSystem_CM_uint16 0 0 0 65535 ECU_ADDRESS 0x0000 /* @ECU_Address@sensor_inport.HALSensors.HAL_ultrasound_SI.HAL_list_echo_p.tab_echo[22].precedent@ */ /end MEASUREMENT
/begin MEASUREMENT sensor_inport.HALSensors.HAL_ultrasound_SI.HAL_list_echo_p.tab_echo[22].d_echo "" SWORD flightControlSystem_CM_int16 0 0 -32768 32767 ECU_ADDRESS 0x0000 /* @ECU_Address@sensor_inport.HALSensors.HAL_ultrasound_SI.HAL_list_echo_p.tab_echo[22].d_echo@ */ /end MEASUREMENT
/begin MEASUREMENT sensor_inport.HALSensors.HAL_ultrasound_SI.HAL_list_echo_p.tab_echo[22].pre_max_index "" UWORD flightControlSystem_CM_uint16 0 0 0 65535 ECU_ADDRESS 0x0000 /* @ECU_Address@sensor_inport.HALSensors.HAL_ultrasound_SI.HAL_list_echo_p.tab_echo[22].pre_max_index@ */ /end MEASUREMENT
/begin MEASUREMENT sensor_inport.HALSensors.HAL_ultrasound_SI.HAL_list_echo_p.tab_echo[23].begin_echo_index "" UWORD flightControlSystem_CM_uint16 0 0 0 65535 ECU_ADDRESS 0x0000 /* @ECU_Address@sensor_inport.HALSensors.HAL_ultrasound_SI.HAL_list_echo_p.tab_echo[23].begin_echo_index@ */ /end MEASUREMENT
/begin MEASUREMENT sensor_inport.HALSensors.HAL_ultrasound_SI.HAL_list_echo_p.tab_echo[23].end_echo_index "" UWORD flightControlSystem_CM_uint16 0 0 0 65535 ECU_ADDRESS 0x0000 /* @ECU_Address@sensor_inport.HALSensors.HAL_ultrasound_SI.HAL_list_echo_p.tab_echo[23].end_echo_index@ */ /end MEASUREMENT
/begin MEASUREMENT sensor_inport.HALSensors.HAL_ultrasound_SI.HAL_list_echo_p.tab_echo[23].max_value_index "" SWORD flightControlSystem_CM_int16 0 0 -32768 32767 ECU_ADDRESS 0x0000 /* @ECU_Address@sensor_inport.HALSensors.HAL_ultrasound_SI.HAL_list_echo_p.tab_echo[23].max_value_index@ */ /end MEASUREMENT
/begin MEASUREMENT sensor_inport.HALSensors.HAL_ultrasound_SI.HAL_list_echo_p.tab_echo[23].max_value "" SLONG flightControlSystem_CM_int32 0 0 -2147483648 2147483647 ECU_ADDRESS 0x0000 /* @ECU_Address@sensor_inport.HALSensors.HAL_ultrasound_SI.HAL_list_echo_p.tab_echo[23].max_value@ */ /end MEASUREMENT
/begin MEASUREMENT sensor_inport.HALSensors.HAL_ultrasound_SI.HAL_list_echo_p.tab_echo[23].precedent "" UWORD flightControlSystem_CM_uint16 0 0 0 65535 ECU_ADDRESS 0x0000 /* @ECU_Address@sensor_inport.HALSensors.HAL_ultrasound_SI.HAL_list_echo_p.tab_echo[23].precedent@ */ /end MEASUREMENT
/begin MEASUREMENT sensor_inport.HALSensors.HAL_ultrasound_SI.HAL_list_echo_p.tab_echo[23].d_echo "" SWORD flightControlSystem_CM_int16 0 0 -32768 32767 ECU_ADDRESS 0x0000 /* @ECU_Address@sensor_inport.HALSensors.HAL_ultrasound_SI.HAL_list_echo_p.tab_echo[23].d_echo@ */ /end MEASUREMENT
/begin MEASUREMENT sensor_inport.HALSensors.HAL_ultrasound_SI.HAL_list_echo_p.tab_echo[23].pre_max_index "" UWORD flightControlSystem_CM_uint16 0 0 0 65535 ECU_ADDRESS 0x0000 /* @ECU_Address@sensor_inport.HALSensors.HAL_ultrasound_SI.HAL_list_echo_p.tab_echo[23].pre_max_index@ */ /end MEASUREMENT
/begin MEASUREMENT sensor_inport.HALSensors.HAL_ultrasound_SI.HAL_list_echo_p.tab_echo[24].begin_echo_index "" UWORD flightControlSystem_CM_uint16 0 0 0 65535 ECU_ADDRESS 0x0000 /* @ECU_Address@sensor_inport.HALSensors.HAL_ultrasound_SI.HAL_list_echo_p.tab_echo[24].begin_echo_index@ */ /end MEASUREMENT
/begin MEASUREMENT sensor_inport.HALSensors.HAL_ultrasound_SI.HAL_list_echo_p.tab_echo[24].end_echo_index "" UWORD flightControlSystem_CM_uint16 0 0 0 65535 ECU_ADDRESS 0x0000 /* @ECU_Address@sensor_inport.HALSensors.HAL_ultrasound_SI.HAL_list_echo_p.tab_echo[24].end_echo_index@ */ /end MEASUREMENT
/begin MEASUREMENT sensor_inport.HALSensors.HAL_ultrasound_SI.HAL_list_echo_p.tab_echo[24].max_value_index "" SWORD flightControlSystem_CM_int16 0 0 -32768 32767 ECU_ADDRESS 0x0000 /* @ECU_Address@sensor_inport.HALSensors.HAL_ultrasound_SI.HAL_list_echo_p.tab_echo[24].max_value_index@ */ /end MEASUREMENT
/begin MEASUREMENT sensor_inport.HALSensors.HAL_ultrasound_SI.HAL_list_echo_p.tab_echo[24].max_value "" SLONG flightControlSystem_CM_int32 0 0 -2147483648 2147483647 ECU_ADDRESS 0x0000 /* @ECU_Address@sensor_inport.HALSensors.HAL_ultrasound_SI.HAL_list_echo_p.tab_echo[24].max_value@ */ /end MEASUREMENT
/begin MEASUREMENT sensor_inport.HALSensors.HAL_ultrasound_SI.HAL_list_echo_p.tab_echo[24].precedent "" UWORD flightControlSystem_CM_uint16 0 0 0 65535 ECU_ADDRESS 0x0000 /* @ECU_Address@sensor_inport.HALSensors.HAL_ultrasound_SI.HAL_list_echo_p.tab_echo[24].precedent@ */ /end MEASUREMENT
/begin MEASUREMENT sensor_inport.HALSensors.HAL_ultrasound_SI.HAL_list_echo_p.tab_echo[24].d_echo "" SWORD flightControlSystem_CM_int16 0 0 -32768 32767 ECU_ADDRESS 0x0000 /* @ECU_Address@sensor_inport.HALSensors.HAL_ultrasound_SI.HAL_list_echo_p.tab_echo[24].d_echo@ */ /end MEASUREMENT
/begin MEASUREMENT sensor_inport.HALSensors.HAL_ultrasound_SI.HAL_list_echo_p.tab_echo[24].pre_max_index "" UWORD flightControlSystem_CM_uint16 0 0 0 65535 ECU_ADDRESS 0x0000 /* @ECU_Address@sensor_inport.HALSensors.HAL_ultrasound_SI.HAL_list_echo_p.tab_echo[24].pre_max_index@ */ /end MEASUREMENT
/begin MEASUREMENT sensor_inport.HALSensors.HAL_ultrasound_SI.HAL_list_echo_p.tab_echo[25].begin_echo_index "" UWORD flightControlSystem_CM_uint16 0 0 0 65535 ECU_ADDRESS 0x0000 /* @ECU_Address@sensor_inport.HALSensors.HAL_ultrasound_SI.HAL_list_echo_p.tab_echo[25].begin_echo_index@ */ /end MEASUREMENT
/begin MEASUREMENT sensor_inport.HALSensors.HAL_ultrasound_SI.HAL_list_echo_p.tab_echo[25].end_echo_index "" UWORD flightControlSystem_CM_uint16 0 0 0 65535 ECU_ADDRESS 0x0000 /* @ECU_Address@sensor_inport.HALSensors.HAL_ultrasound_SI.HAL_list_echo_p.tab_echo[25].end_echo_index@ */ /end MEASUREMENT
/begin MEASUREMENT sensor_inport.HALSensors.HAL_ultrasound_SI.HAL_list_echo_p.tab_echo[25].max_value_index "" SWORD flightControlSystem_CM_int16 0 0 -32768 32767 ECU_ADDRESS 0x0000 /* @ECU_Address@sensor_inport.HALSensors.HAL_ultrasound_SI.HAL_list_echo_p.tab_echo[25].max_value_index@ */ /end MEASUREMENT
/begin MEASUREMENT sensor_inport.HALSensors.HAL_ultrasound_SI.HAL_list_echo_p.tab_echo[25].max_value "" SLONG flightControlSystem_CM_int32 0 0 -2147483648 2147483647 ECU_ADDRESS 0x0000 /* @ECU_Address@sensor_inport.HALSensors.HAL_ultrasound_SI.HAL_list_echo_p.tab_echo[25].max_value@ */ /end MEASUREMENT
/begin MEASUREMENT sensor_inport.HALSensors.HAL_ultrasound_SI.HAL_list_echo_p.tab_echo[25].precedent "" UWORD flightControlSystem_CM_uint16 0 0 0 65535 ECU_ADDRESS 0x0000 /* @ECU_Address@sensor_inport.HALSensors.HAL_ultrasound_SI.HAL_list_echo_p.tab_echo[25].precedent@ */ /end MEASUREMENT
/begin MEASUREMENT sensor_inport.HALSensors.HAL_ultrasound_SI.HAL_list_echo_p.tab_echo[25].d_echo "" SWORD flightControlSystem_CM_int16 0 0 -32768 32767 ECU_ADDRESS 0x0000 /* @ECU_Address@sensor_inport.HALSensors.HAL_ultrasound_SI.HAL_list_echo_p.tab_echo[25].d_echo@ */ /end MEASUREMENT
/begin MEASUREMENT sensor_inport.HALSensors.HAL_ultrasound_SI.HAL_list_echo_p.tab_echo[25].pre_max_index "" UWORD flightControlSystem_CM_uint16 0 0 0 65535 ECU_ADDRESS 0x0000 /* @ECU_Address@sensor_inport.HALSensors.HAL_ultrasound_SI.HAL_list_echo_p.tab_echo[25].pre_max_index@ */ /end MEASUREMENT
/begin MEASUREMENT sensor_inport.HALSensors.HAL_ultrasound_SI.HAL_list_echo_p.tab_echo[26].begin_echo_index "" UWORD flightControlSystem_CM_uint16 0 0 0 65535 ECU_ADDRESS 0x0000 /* @ECU_Address@sensor_inport.HALSensors.HAL_ultrasound_SI.HAL_list_echo_p.tab_echo[26].begin_echo_index@ */ /end MEASUREMENT
/begin MEASUREMENT sensor_inport.HALSensors.HAL_ultrasound_SI.HAL_list_echo_p.tab_echo[26].end_echo_index "" UWORD flightControlSystem_CM_uint16 0 0 0 65535 ECU_ADDRESS 0x0000 /* @ECU_Address@sensor_inport.HALSensors.HAL_ultrasound_SI.HAL_list_echo_p.tab_echo[26].end_echo_index@ */ /end MEASUREMENT
/begin MEASUREMENT sensor_inport.HALSensors.HAL_ultrasound_SI.HAL_list_echo_p.tab_echo[26].max_value_index "" SWORD flightControlSystem_CM_int16 0 0 -32768 32767 ECU_ADDRESS 0x0000 /* @ECU_Address@sensor_inport.HALSensors.HAL_ultrasound_SI.HAL_list_echo_p.tab_echo[26].max_value_index@ */ /end MEASUREMENT
/begin MEASUREMENT sensor_inport.HALSensors.HAL_ultrasound_SI.HAL_list_echo_p.tab_echo[26].max_value "" SLONG flightControlSystem_CM_int32 0 0 -2147483648 2147483647 ECU_ADDRESS 0x0000 /* @ECU_Address@sensor_inport.HALSensors.HAL_ultrasound_SI.HAL_list_echo_p.tab_echo[26].max_value@ */ /end MEASUREMENT
/begin MEASUREMENT sensor_inport.HALSensors.HAL_ultrasound_SI.HAL_list_echo_p.tab_echo[26].precedent "" UWORD flightControlSystem_CM_uint16 0 0 0 65535 ECU_ADDRESS 0x0000 /* @ECU_Address@sensor_inport.HALSensors.HAL_ultrasound_SI.HAL_list_echo_p.tab_echo[26].precedent@ */ /end MEASUREMENT
/begin MEASUREMENT sensor_inport.HALSensors.HAL_ultrasound_SI.HAL_list_echo_p.tab_echo[26].d_echo "" SWORD flightControlSystem_CM_int16 0 0 -32768 32767 ECU_ADDRESS 0x0000 /* @ECU_Address@sensor_inport.HALSensors.HAL_ultrasound_SI.HAL_list_echo_p.tab_echo[26].d_echo@ */ /end MEASUREMENT
/begin MEASUREMENT sensor_inport.HALSensors.HAL_ultrasound_SI.HAL_list_echo_p.tab_echo[26].pre_max_index "" UWORD flightControlSystem_CM_uint16 0 0 0 65535 ECU_ADDRESS 0x0000 /* @ECU_Address@sensor_inport.HALSensors.HAL_ultrasound_SI.HAL_list_echo_p.tab_echo[26].pre_max_index@ */ /end MEASUREMENT
/begin MEASUREMENT sensor_inport.HALSensors.HAL_ultrasound_SI.HAL_list_echo_p.tab_echo[27].begin_echo_index "" UWORD flightControlSystem_CM_uint16 0 0 0 65535 ECU_ADDRESS 0x0000 /* @ECU_Address@sensor_inport.HALSensors.HAL_ultrasound_SI.HAL_list_echo_p.tab_echo[27].begin_echo_index@ */ /end MEASUREMENT
/begin MEASUREMENT sensor_inport.HALSensors.HAL_ultrasound_SI.HAL_list_echo_p.tab_echo[27].end_echo_index "" UWORD flightControlSystem_CM_uint16 0 0 0 65535 ECU_ADDRESS 0x0000 /* @ECU_Address@sensor_inport.HALSensors.HAL_ultrasound_SI.HAL_list_echo_p.tab_echo[27].end_echo_index@ */ /end MEASUREMENT
/begin MEASUREMENT sensor_inport.HALSensors.HAL_ultrasound_SI.HAL_list_echo_p.tab_echo[27].max_value_index "" SWORD flightControlSystem_CM_int16 0 0 -32768 32767 ECU_ADDRESS 0x0000 /* @ECU_Address@sensor_inport.HALSensors.HAL_ultrasound_SI.HAL_list_echo_p.tab_echo[27].max_value_index@ */ /end MEASUREMENT
/begin MEASUREMENT sensor_inport.HALSensors.HAL_ultrasound_SI.HAL_list_echo_p.tab_echo[27].max_value "" SLONG flightControlSystem_CM_int32 0 0 -2147483648 2147483647 ECU_ADDRESS 0x0000 /* @ECU_Address@sensor_inport.HALSensors.HAL_ultrasound_SI.HAL_list_echo_p.tab_echo[27].max_value@ */ /end MEASUREMENT
/begin MEASUREMENT sensor_inport.HALSensors.HAL_ultrasound_SI.HAL_list_echo_p.tab_echo[27].precedent "" UWORD flightControlSystem_CM_uint16 0 0 0 65535 ECU_ADDRESS 0x0000 /* @ECU_Address@sensor_inport.HALSensors.HAL_ultrasound_SI.HAL_list_echo_p.tab_echo[27].precedent@ */ /end MEASUREMENT
/begin MEASUREMENT sensor_inport.HALSensors.HAL_ultrasound_SI.HAL_list_echo_p.tab_echo[27].d_echo "" SWORD flightControlSystem_CM_int16 0 0 -32768 32767 ECU_ADDRESS 0x0000 /* @ECU_Address@sensor_inport.HALSensors.HAL_ultrasound_SI.HAL_list_echo_p.tab_echo[27].d_echo@ */ /end MEASUREMENT
/begin MEASUREMENT sensor_inport.HALSensors.HAL_ultrasound_SI.HAL_list_echo_p.tab_echo[27].pre_max_index "" UWORD flightControlSystem_CM_uint16 0 0 0 65535 ECU_ADDRESS 0x0000 /* @ECU_Address@sensor_inport.HALSensors.HAL_ultrasound_SI.HAL_list_echo_p.tab_echo[27].pre_max_index@ */ /end MEASUREMENT
/begin MEASUREMENT sensor_inport.HALSensors.HAL_ultrasound_SI.HAL_list_echo_p.tab_echo[28].begin_echo_index "" UWORD flightControlSystem_CM_uint16 0 0 0 65535 ECU_ADDRESS 0x0000 /* @ECU_Address@sensor_inport.HALSensors.HAL_ultrasound_SI.HAL_list_echo_p.tab_echo[28].begin_echo_index@ */ /end MEASUREMENT
/begin MEASUREMENT sensor_inport.HALSensors.HAL_ultrasound_SI.HAL_list_echo_p.tab_echo[28].end_echo_index "" UWORD flightControlSystem_CM_uint16 0 0 0 65535 ECU_ADDRESS 0x0000 /* @ECU_Address@sensor_inport.HALSensors.HAL_ultrasound_SI.HAL_list_echo_p.tab_echo[28].end_echo_index@ */ /end MEASUREMENT
/begin MEASUREMENT sensor_inport.HALSensors.HAL_ultrasound_SI.HAL_list_echo_p.tab_echo[28].max_value_index "" SWORD flightControlSystem_CM_int16 0 0 -32768 32767 ECU_ADDRESS 0x0000 /* @ECU_Address@sensor_inport.HALSensors.HAL_ultrasound_SI.HAL_list_echo_p.tab_echo[28].max_value_index@ */ /end MEASUREMENT
/begin MEASUREMENT sensor_inport.HALSensors.HAL_ultrasound_SI.HAL_list_echo_p.tab_echo[28].max_value "" SLONG flightControlSystem_CM_int32 0 0 -2147483648 2147483647 ECU_ADDRESS 0x0000 /* @ECU_Address@sensor_inport.HALSensors.HAL_ultrasound_SI.HAL_list_echo_p.tab_echo[28].max_value@ */ /end MEASUREMENT
/begin MEASUREMENT sensor_inport.HALSensors.HAL_ultrasound_SI.HAL_list_echo_p.tab_echo[28].precedent "" UWORD flightControlSystem_CM_uint16 0 0 0 65535 ECU_ADDRESS 0x0000 /* @ECU_Address@sensor_inport.HALSensors.HAL_ultrasound_SI.HAL_list_echo_p.tab_echo[28].precedent@ */ /end MEASUREMENT
/begin MEASUREMENT sensor_inport.HALSensors.HAL_ultrasound_SI.HAL_list_echo_p.tab_echo[28].d_echo "" SWORD flightControlSystem_CM_int16 0 0 -32768 32767 ECU_ADDRESS 0x0000 /* @ECU_Address@sensor_inport.HALSensors.HAL_ultrasound_SI.HAL_list_echo_p.tab_echo[28].d_echo@ */ /end MEASUREMENT
/begin MEASUREMENT sensor_inport.HALSensors.HAL_ultrasound_SI.HAL_list_echo_p.tab_echo[28].pre_max_index "" UWORD flightControlSystem_CM_uint16 0 0 0 65535 ECU_ADDRESS 0x0000 /* @ECU_Address@sensor_inport.HALSensors.HAL_ultrasound_SI.HAL_list_echo_p.tab_echo[28].pre_max_index@ */ /end MEASUREMENT
/begin MEASUREMENT sensor_inport.HALSensors.HAL_ultrasound_SI.HAL_list_echo_p.tab_echo[29].begin_echo_index "" UWORD flightControlSystem_CM_uint16 0 0 0 65535 ECU_ADDRESS 0x0000 /* @ECU_Address@sensor_inport.HALSensors.HAL_ultrasound_SI.HAL_list_echo_p.tab_echo[29].begin_echo_index@ */ /end MEASUREMENT
/begin MEASUREMENT sensor_inport.HALSensors.HAL_ultrasound_SI.HAL_list_echo_p.tab_echo[29].end_echo_index "" UWORD flightControlSystem_CM_uint16 0 0 0 65535 ECU_ADDRESS 0x0000 /* @ECU_Address@sensor_inport.HALSensors.HAL_ultrasound_SI.HAL_list_echo_p.tab_echo[29].end_echo_index@ */ /end MEASUREMENT
/begin MEASUREMENT sensor_inport.HALSensors.HAL_ultrasound_SI.HAL_list_echo_p.tab_echo[29].max_value_index "" SWORD flightControlSystem_CM_int16 0 0 -32768 32767 ECU_ADDRESS 0x0000 /* @ECU_Address@sensor_inport.HALSensors.HAL_ultrasound_SI.HAL_list_echo_p.tab_echo[29].max_value_index@ */ /end MEASUREMENT
/begin MEASUREMENT sensor_inport.HALSensors.HAL_ultrasound_SI.HAL_list_echo_p.tab_echo[29].max_value "" SLONG flightControlSystem_CM_int32 0 0 -2147483648 2147483647 ECU_ADDRESS 0x0000 /* @ECU_Address@sensor_inport.HALSensors.HAL_ultrasound_SI.HAL_list_echo_p.tab_echo[29].max_value@ */ /end MEASUREMENT
/begin MEASUREMENT sensor_inport.HALSensors.HAL_ultrasound_SI.HAL_list_echo_p.tab_echo[29].precedent "" UWORD flightControlSystem_CM_uint16 0 0 0 65535 ECU_ADDRESS 0x0000 /* @ECU_Address@sensor_inport.HALSensors.HAL_ultrasound_SI.HAL_list_echo_p.tab_echo[29].precedent@ */ /end MEASUREMENT
/begin MEASUREMENT sensor_inport.HALSensors.HAL_ultrasound_SI.HAL_list_echo_p.tab_echo[29].d_echo "" SWORD flightControlSystem_CM_int16 0 0 -32768 32767 ECU_ADDRESS 0x0000 /* @ECU_Address@sensor_inport.HALSensors.HAL_ultrasound_SI.HAL_list_echo_p.tab_echo[29].d_echo@ */ /end MEASUREMENT
/begin MEASUREMENT sensor_inport.HALSensors.HAL_ultrasound_SI.HAL_list_echo_p.tab_echo[29].pre_max_index "" UWORD flightControlSystem_CM_uint16 0 0 0 65535 ECU_ADDRESS 0x0000 /* @ECU_Address@sensor_inport.HALSensors.HAL_ultrasound_SI.HAL_list_echo_p.tab_echo[29].pre_max_index@ */ /end MEASUREMENT
/begin MEASUREMENT sensor_inport.HALSensors.HAL_ultrasound_SI.HAL_list_echo_p.number_of_echoes "" UBYTE flightControlSystem_CM_uint8 0 0 0 255 ECU_ADDRESS 0x0000 /* @ECU_Address@sensor_inport.HALSensors.HAL_ultrasound_SI.HAL_list_echo_p.number_of_echoes@ */ /end MEASUREMENT
/begin MEASUREMENT sensor_inport.HALSensors.HAL_vbat_SI.vbat_V "" FLOAT32_IEEE flightControlSystem_CM_single 0 0 -3.4E+38 3.4E+38 ECU_ADDRESS 0x0000 /* @ECU_Address@sensor_inport.HALSensors.HAL_vbat_SI.vbat_V@ */ /end MEASUREMENT
/begin MEASUREMENT sensor_inport.HALSensors.HAL_vbat_SI.vbat_percentage "" ULONG flightControlSystem_CM_uint32 0 0 0 4294967295 ECU_ADDRESS 0x0000 /* @ECU_Address@sensor_inport.HALSensors.HAL_vbat_SI.vbat_percentage@ */ /end MEASUREMENT
/begin COMPU_METHOD flightControlSystem_CM_single "Q = V" RAT_FUNC "%8.6" "" COEFFS 0 1 0 0 0 1 /end COMPU_METHOD
/begin COMPU_METHOD flightControlSystem_CM_uint32 "Q = V" RAT_FUNC "%10.0" "" COEFFS 0 1 0 0 0 1 /end COMPU_METHOD
/begin COMPU_METHOD flightControlSystem_CM_int32 "Q = V" RAT_FUNC "%10.0" "" COEFFS 0 1 0 0 0 1 /end COMPU_METHOD
/begin COMPU_METHOD flightControlSystem_CM_uint16 "Q = V" RAT_FUNC "%5.0" "" COEFFS 0 1 0 0 0 1 /end COMPU_METHOD
/begin COMPU_METHOD flightControlSystem_CM_uint8 "Q = V" RAT_FUNC "%3.0" "" COEFFS 0 1 0 0 0 1 /end COMPU_METHOD
/begin COMPU_METHOD flightControlSystem_CM_int16 "Q = V" RAT_FUNC "%5.0" "" COEFFS 0 1 0 0 0 1 /end COMPU_METHOD
/begin GROUP sensor_inport.HALSensors.HAL_ultrasound_SI.HAL_list_echo.tab_echo[24] ""
 /begin REF_MEASUREMENT sensor_inport.HALSensors.HAL_ultrasound_SI.HAL_list_echo.tab_echo[24].begin_echo_index sensor_inport.HALSensors.HAL_ultrasound_SI.HAL_list_echo.tab_echo[24].d_echo sensor_inport.HALSensors.HAL_ultrasound_SI.HAL_list_echo.tab_echo[24].end_echo_index sensor_inport.HALSensors.HAL_ultrasound_SI.HAL_list_echo.tab_echo[24].max_value sensor_inport.HALSensors.HAL_ultrasound_SI.HAL_list_echo.tab_echo[24].max_value_index sensor_inport.HALSensors.HAL_ultrasound_SI.HAL_list_echo.tab_echo[24].pre_max_index sensor_inport.HALSensors.HAL_ultrasound_SI.HAL_list_echo.tab_echo[24].precedent /end REF_MEASUREMENT
/end GROUP
/begin GROUP sensor_inport.HALSensors.HAL_ultrasound_SI.HAL_list_echo.tab_echo[25] ""
 /begin REF_MEASUREMENT sensor_inport.HALSensors.HAL_ultrasound_SI.HAL_list_echo.tab_echo[25].begin_echo_index sensor_inport.HALSensors.HAL_ultrasound_SI.HAL_list_echo.tab_echo[25].d_echo sensor_inport.HALSensors.HAL_ultrasound_SI.HAL_list_echo.tab_echo[25].end_echo_index sensor_inport.HALSensors.HAL_ultrasound_SI.HAL_list_echo.tab_echo[25].max_value sensor_inport.HALSensors.HAL_ultrasound_SI.HAL_list_echo.tab_echo[25].max_value_index sensor_inport.HALSensors.HAL_ultrasound_SI.HAL_list_echo.tab_echo[25].pre_max_index sensor_inport.HALSensors.HAL_ultrasound_SI.HAL_list_echo.tab_echo[25].precedent /end REF_MEASUREMENT
/end GROUP
/begin GROUP sensor_inport.HALSensors.HAL_ultrasound_SI.HAL_list_echo.tab_echo[26] ""
 /begin REF_MEASUREMENT sensor_inport.HALSensors.HAL_ultrasound_SI.HAL_list_echo.tab_echo[26].begin_echo_index sensor_inport.HALSensors.HAL_ultrasound_SI.HAL_list_echo.tab_echo[26].d_echo sensor_inport.HALSensors.HAL_ultrasound_SI.HAL_list_echo.tab_echo[26].end_echo_index sensor_inport.HALSensors.HAL_ultrasound_SI.HAL_list_echo.tab_echo[26].max_value sensor_inport.HALSensors.HAL_ultrasound_SI.HAL_list_echo.tab_echo[26].max_value_index sensor_inport.HALSensors.HAL_ultrasound_SI.HAL_list_echo.tab_echo[26].pre_max_index sensor_inport.HALSensors.HAL_ultrasound_SI.HAL_list_echo.tab_echo[26].precedent /end REF_MEASUREMENT
/end GROUP
/begin GROUP sensor_inport.HALSensors.HAL_ultrasound_SI.HAL_list_echo.tab_echo[27] ""
 /begin REF_MEASUREMENT sensor_inport.HALSensors.HAL_ultrasound_SI.HAL_list_echo.tab_echo[27].begin_echo_index sensor_inport.HALSensors.HAL_ultrasound_SI.HAL_list_echo.tab_echo[27].d_echo sensor_inport.HALSensors.HAL_ultrasound_SI.HAL_list_echo.tab_echo[27].end_echo_index sensor_inport.HALSensors.HAL_ultrasound_SI.HAL_list_echo.tab_echo[27].max_value sensor_inport.HALSensors.HAL_ultrasound_SI.HAL_list_echo.tab_echo[27].max_value_index sensor_inport.HALSensors.HAL_ultrasound_SI.HAL_list_echo.tab_echo[27].pre_max_index sensor_inport.HALSensors.HAL_ultrasound_SI.HAL_list_echo.tab_echo[27].precedent /end REF_MEASUREMENT
/end GROUP
/begin GROUP sensor_inport.HALSensors.HAL_ultrasound_SI.HAL_list_echo.tab_echo[28] ""
 /begin REF_MEASUREMENT sensor_inport.HALSensors.HAL_ultrasound_SI.HAL_list_echo.tab_echo[28].begin_echo_index sensor_inport.HALSensors.HAL_ultrasound_SI.HAL_list_echo.tab_echo[28].d_echo sensor_inport.HALSensors.HAL_ultrasound_SI.HAL_list_echo.tab_echo[28].end_echo_index sensor_inport.HALSensors.HAL_ultrasound_SI.HAL_list_echo.tab_echo[28].max_value sensor_inport.HALSensors.HAL_ultrasound_SI.HAL_list_echo.tab_echo[28].max_value_index sensor_inport.HALSensors.HAL_ultrasound_SI.HAL_list_echo.tab_echo[28].pre_max_index sensor_inport.HALSensors.HAL_ultrasound_SI.HAL_list_echo.tab_echo[28].precedent /end REF_MEASUREMENT
/end GROUP
/begin GROUP sensor_inport.HALSensors.HAL_ultrasound_SI.HAL_list_echo.tab_echo[29] ""
 /begin REF_MEASUREMENT sensor_inport.HALSensors.HAL_ultrasound_SI.HAL_list_echo.tab_echo[29].begin_echo_index sensor_inport.HALSensors.HAL_ultrasound_SI.HAL_list_echo.tab_echo[29].d_echo sensor_inport.HALSensors.HAL_ultrasound_SI.HAL_list_echo.tab_echo[29].end_echo_index sensor_inport.HALSensors.HAL_ultrasound_SI.HAL_list_echo.tab_echo[29].max_value sensor_inport.HALSensors.HAL_ultrasound_SI.HAL_list_echo.tab_echo[29].max_value_index sensor_inport.HALSensors.HAL_ultrasound_SI.HAL_list_echo.tab_echo[29].pre_max_index sensor_inport.HALSensors.HAL_ultrasound_SI.HAL_list_echo.tab_echo[29].precedent /end REF_MEASUREMENT
/end GROUP
/begin GROUP sensor_inport.HALSensors.HAL_ultrasound_SI.HAL_list_echo_p ""
 /begin SUB_GROUP sensor_inport.HALSensors.HAL_ultrasound_SI.HAL_list_echo_p.tab_echo[0] sensor_inport.HALSensors.HAL_ultrasound_SI.HAL_list_echo_p.tab_echo[10] sensor_inport.HALSensors.HAL_ultrasound_SI.HAL_list_echo_p.tab_echo[11] sensor_inport.HALSensors.HAL_ultrasound_SI.HAL_list_echo_p.tab_echo[12] sensor_inport.HALSensors.HAL_ultrasound_SI.HAL_list_echo_p.tab_echo[13] sensor_inport.HALSensors.HAL_ultrasound_SI.HAL_list_echo_p.tab_echo[14] sensor_inport.HALSensors.HAL_ultrasound_SI.HAL_list_echo_p.tab_echo[15] sensor_inport.HALSensors.HAL_ultrasound_SI.HAL_list_echo_p.tab_echo[16] sensor_inport.HALSensors.HAL_ultrasound_SI.HAL_list_echo_p.tab_echo[17] sensor_inport.HALSensors.HAL_ultrasound_SI.HAL_list_echo_p.tab_echo[18] sensor_inport.HALSensors.HAL_ultrasound_SI.HAL_list_echo_p.tab_echo[19] sensor_inport.HALSensors.HAL_ultrasound_SI.HAL_list_echo_p.tab_echo[1] sensor_inport.HALSensors.HAL_ultrasound_SI.HAL_list_echo_p.tab_echo[20] sensor_inport.HALSensors.HAL_ultrasound_SI.HAL_list_echo_p.tab_echo[21] sensor_inport.HALSensors.HAL_ultrasound_SI.HAL_list_echo_p.tab_echo[22] sensor_inport.HALSensors.HAL_ultrasound_SI.HAL_list_echo_p.tab_echo[23] sensor_inport.HALSensors.HAL_ultrasound_SI.HAL_list_echo_p.tab_echo[24] sensor_inport.HALSensors.HAL_ultrasound_SI.HAL_list_echo_p.tab_echo[25] sensor_inport.HALSensors.HAL_ultrasound_SI.HAL_list_echo_p.tab_echo[26] sensor_inport.HALSensors.HAL_ultrasound_SI.HAL_list_echo_p.tab_echo[27] sensor_inport.HALSensors.HAL_ultrasound_SI.HAL_list_echo_p.tab_echo[28] sensor_inport.HALSensors.HAL_ultrasound_SI.HAL_list_echo_p.tab_echo[29] sensor_inport.HALSensors.HAL_ultrasound_SI.HAL_list_echo_p.tab_echo[2] sensor_inport.HALSensors.HAL_ultrasound_SI.HAL_list_echo_p.tab_echo[3] sensor_inport.HALSensors.HAL_ultrasound_SI.HAL_list_echo_p.tab_echo[4] sensor_inport.HALSensors.HAL_ultrasound_SI.HAL_list_echo_p.tab_echo[5] sensor_inport.HALSensors.HAL_ultrasound_SI.HAL_list_echo_p.tab_echo[6] sensor_inport.HALSensors.HAL_ultrasound_SI.HAL_list_echo_p.tab_echo[7] sensor_inport.HALSensors.HAL_ultrasound_SI.HAL_list_echo_p.tab_echo[8] sensor_inport.HALSensors.HAL_ultrasound_SI.HAL_list_echo_p.tab_echo[9] /end SUB_GROUP
 /begin REF_MEASUREMENT sensor_inport.HALSensors.HAL_ultrasound_SI.HAL_list_echo_p.number_of_echoes /end REF_MEASUREMENT
/end GROUP
/begin GROUP sensor_inport.HALSensors.HAL_ultrasound_SI.HAL_list_echo_p.tab_echo[0] ""
 /begin REF_MEASUREMENT sensor_inport.HALSensors.HAL_ultrasound_SI.HAL_list_echo_p.tab_echo[0].begin_echo_index sensor_inport.HALSensors.HAL_ultrasound_SI.HAL_list_echo_p.tab_echo[0].d_echo sensor_inport.HALSensors.HAL_ultrasound_SI.HAL_list_echo_p.tab_echo[0].end_echo_index sensor_inport.HALSensors.HAL_ultrasound_SI.HAL_list_echo_p.tab_echo[0].max_value sensor_inport.HALSensors.HAL_ultrasound_SI.HAL_list_echo_p.tab_echo[0].max_value_index sensor_inport.HALSensors.HAL_ultrasound_SI.HAL_list_echo_p.tab_echo[0].pre_max_index sensor_inport.HALSensors.HAL_ultrasound_SI.HAL_list_echo_p.tab_echo[0].precedent /end REF_MEASUREMENT
/end GROUP
/begin GROUP sensor_inport.HALSensors.HAL_ultrasound_SI.HAL_list_echo_p.tab_echo[1] ""
 /begin REF_MEASUREMENT sensor_inport.HALSensors.HAL_ultrasound_SI.HAL_list_echo_p.tab_echo[1].begin_echo_index sensor_inport.HALSensors.HAL_ultrasound_SI.HAL_list_echo_p.tab_echo[1].d_echo sensor_inport.HALSensors.HAL_ultrasound_SI.HAL_list_echo_p.tab_echo[1].end_echo_index sensor_inport.HALSensors.HAL_ultrasound_SI.HAL_list_echo_p.tab_echo[1].max_value sensor_inport.HALSensors.HAL_ultrasound_SI.HAL_list_echo_p.tab_echo[1].max_value_index sensor_inport.HALSensors.HAL_ultrasound_SI.HAL_list_echo_p.tab_echo[1].pre_max_index sensor_inport.HALSensors.HAL_ultrasound_SI.HAL_list_echo_p.tab_echo[1].precedent /end REF_MEASUREMENT
/end GROUP
/begin GROUP sensor_inport.HALSensors.HAL_ultrasound_SI.HAL_list_echo_p.tab_echo[2] ""
 /begin REF_MEASUREMENT sensor_inport.HALSensors.HAL_ultrasound_SI.HAL_list_echo_p.tab_echo[2].begin_echo_index sensor_inport.HALSensors.HAL_ultrasound_SI.HAL_list_echo_p.tab_echo[2].d_echo sensor_inport.HALSensors.HAL_ultrasound_SI.HAL_list_echo_p.tab_echo[2].end_echo_index sensor_inport.HALSensors.HAL_ultrasound_SI.HAL_list_echo_p.tab_echo[2].max_value sensor_inport.HALSensors.HAL_ultrasound_SI.HAL_list_echo_p.tab_echo[2].max_value_index sensor_inport.HALSensors.HAL_ultrasound_SI.HAL_list_echo_p.tab_echo[2].pre_max_index sensor_inport.HALSensors.HAL_ultrasound_SI.HAL_list_echo_p.tab_echo[2].precedent /end REF_MEASUREMENT
/end GROUP
/begin GROUP sensor_inport.HALSensors.HAL_ultrasound_SI.HAL_list_echo_p.tab_echo[3] ""
 /begin REF_MEASUREMENT sensor_inport.HALSensors.HAL_ultrasound_SI.HAL_list_echo_p.tab_echo[3].begin_echo_index sensor_inport.HALSensors.HAL_ultrasound_SI.HAL_list_echo_p.tab_echo[3].d_echo sensor_inport.HALSensors.HAL_ultrasound_SI.HAL_list_echo_p.tab_echo[3].end_echo_index sensor_inport.HALSensors.HAL_ultrasound_SI.HAL_list_echo_p.tab_echo[3].max_value sensor_inport.HALSensors.HAL_ultrasound_SI.HAL_list_echo_p.tab_echo[3].max_value_index sensor_inport.HALSensors.HAL_ultrasound_SI.HAL_list_echo_p.tab_echo[3].pre_max_index sensor_inport.HALSensors.HAL_ultrasound_SI.HAL_list_echo_p.tab_echo[3].precedent /end REF_MEASUREMENT
/end GROUP
/begin GROUP sensor_inport.HALSensors.HAL_ultrasound_SI.HAL_list_echo_p.tab_echo[4] ""
 /begin REF_MEASUREMENT sensor_inport.HALSensors.HAL_ultrasound_SI.HAL_list_echo_p.tab_echo[4].begin_echo_index sensor_inport.HALSensors.HAL_ultrasound_SI.HAL_list_echo_p.tab_echo[4].d_echo sensor_inport.HALSensors.HAL_ultrasound_SI.HAL_list_echo_p.tab_echo[4].end_echo_index sensor_inport.HALSensors.HAL_ultrasound_SI.HAL_list_echo_p.tab_echo[4].max_value sensor_inport.HALSensors.HAL_ultrasound_SI.HAL_list_echo_p.tab_echo[4].max_value_index sensor_inport.HALSensors.HAL_ultrasound_SI.HAL_list_echo_p.tab_echo[4].pre_max_index sensor_inport.HALSensors.HAL_ultrasound_SI.HAL_list_echo_p.tab_echo[4].precedent /end REF_MEASUREMENT
/end GROUP
/begin GROUP sensor_inport.HALSensors.HAL_ultrasound_SI.HAL_list_echo_p.tab_echo[5] ""
 /begin REF_MEASUREMENT sensor_inport.HALSensors.HAL_ultrasound_SI.HAL_list_echo_p.tab_echo[5].begin_echo_index sensor_inport.HALSensors.HAL_ultrasound_SI.HAL_list_echo_p.tab_echo[5].d_echo sensor_inport.HALSensors.HAL_ultrasound_SI.HAL_list_echo_p.tab_echo[5].end_echo_index sensor_inport.HALSensors.HAL_ultrasound_SI.HAL_list_echo_p.tab_echo[5].max_value sensor_inport.HALSensors.HAL_ultrasound_SI.HAL_list_echo_p.tab_echo[5].max_value_index sensor_inport.HALSensors.HAL_ultrasound_SI.HAL_list_echo_p.tab_echo[5].pre_max_index sensor_inport.HALSensors.HAL_ultrasound_SI.HAL_list_echo_p.tab_echo[5].precedent /end REF_MEASUREMENT
/end GROUP
/begin GROUP sensor_inport.HALSensors.HAL_ultrasound_SI.HAL_list_echo_p.tab_echo[6] ""
 /begin REF_MEASUREMENT sensor_inport.HALSensors.HAL_ultrasound_SI.HAL_list_echo_p.tab_echo[6].begin_echo_index sensor_inport.HALSensors.HAL_ultrasound_SI.HAL_list_echo_p.tab_echo[6].d_echo sensor_inport.HALSensors.HAL_ultrasound_SI.HAL_list_echo_p.tab_echo[6].end_echo_index sensor_inport.HALSensors.HAL_ultrasound_SI.HAL_list_echo_p.tab_echo[6].max_value sensor_inport.HALSensors.HAL_ultrasound_SI.HAL_list_echo_p.tab_echo[6].max_value_index sensor_inport.HALSensors.HAL_ultrasound_SI.HAL_list_echo_p.tab_echo[6].pre_max_index sensor_inport.HALSensors.HAL_ultrasound_SI.HAL_list_echo_p.tab_echo[6].precedent /end REF_MEASUREMENT
/end GROUP
/begin GROUP sensor_inport.HALSensors.HAL_ultrasound_SI.HAL_list_echo_p.tab_echo[7] ""
 /begin REF_MEASUREMENT sensor_inport.HALSensors.HAL_ultrasound_SI.HAL_list_echo_p.tab_echo[7].begin_echo_index sensor_inport.HALSensors.HAL_ultrasound_SI.HAL_list_echo_p.tab_echo[7].d_echo sensor_inport.HALSensors.HAL_ultrasound_SI.HAL_list_echo_p.tab_echo[7].end_echo_index sensor_inport.HALSensors.HAL_ultrasound_SI.HAL_list_echo_p.tab_echo[7].max_value sensor_inport.HALSensors.HAL_ultrasound_SI.HAL_list_echo_p.tab_echo[7].max_value_index sensor_inport.HALSensors.HAL_ultrasound_SI.HAL_list_echo_p.tab_echo[7].pre_max_index sensor_inport.HALSensors.HAL_ultrasound_SI.HAL_list_echo_p.tab_echo[7].precedent /end REF_MEASUREMENT
/end GROUP
/begin GROUP sensor_inport.HALSensors.HAL_ultrasound_SI.HAL_list_echo_p.tab_echo[8] ""
 /begin REF_MEASUREMENT sensor_inport.HALSensors.HAL_ultrasound_SI.HAL_list_echo_p.tab_echo[8].begin_echo_index sensor_inport.HALSensors.HAL_ultrasound_SI.HAL_list_echo_p.tab_echo[8].d_echo sensor_inport.HALSensors.HAL_ultrasound_SI.HAL_list_echo_p.tab_echo[8].end_echo_index sensor_inport.HALSensors.HAL_ultrasound_SI.HAL_list_echo_p.tab_echo[8].max_value sensor_inport.HALSensors.HAL_ultrasound_SI.HAL_list_echo_p.tab_echo[8].max_value_index sensor_inport.HALSensors.HAL_ultrasound_SI.HAL_list_echo_p.tab_echo[8].pre_max_index sensor_inport.HALSensors.HAL_ultrasound_SI.HAL_list_echo_p.tab_echo[8].precedent /end REF_MEASUREMENT
/end GROUP
/begin GROUP sensor_inport.HALSensors.HAL_ultrasound_SI.HAL_list_echo_p.tab_echo[9] ""
 /begin REF_MEASUREMENT sensor_inport.HALSensors.HAL_ultrasound_SI.HAL_list_echo_p.tab_echo[9].begin_echo_index sensor_inport.HALSensors.HAL_ultrasound_SI.HAL_list_echo_p.tab_echo[9].d_echo sensor_inport.HALSensors.HAL_ultrasound_SI.HAL_list_echo_p.tab_echo[9].end_echo_index sensor_inport.HALSensors.HAL_ultrasound_SI.HAL_list_echo_p.tab_echo[9].max_value sensor_inport.HALSensors.HAL_ultrasound_SI.HAL_list_echo_p.tab_echo[9].max_value_index sensor_inport.HALSensors.HAL_ultrasound_SI.HAL_list_echo_p.tab_echo[9].pre_max_index sensor_inport.HALSensors.HAL_ultrasound_SI.HAL_list_echo_p.tab_echo[9].precedent /end REF_MEASUREMENT
/end GROUP
/begin GROUP sensor_inport.HALSensors.HAL_ultrasound_SI.HAL_list_echo_p.tab_echo[10] ""
 /begin REF_MEASUREMENT sensor_inport.HALSensors.HAL_ultrasound_SI.HAL_list_echo_p.tab_echo[10].begin_echo_index sensor_inport.HALSensors.HAL_ultrasound_SI.HAL_list_echo_p.tab_echo[10].d_echo sensor_inport.HALSensors.HAL_ultrasound_SI.HAL_list_echo_p.tab_echo[10].end_echo_index sensor_inport.HALSensors.HAL_ultrasound_SI.HAL_list_echo_p.tab_echo[10].max_value sensor_inport.HALSensors.HAL_ultrasound_SI.HAL_list_echo_p.tab_echo[10].max_value_index sensor_inport.HALSensors.HAL_ultrasound_SI.HAL_list_echo_p.tab_echo[10].pre_max_index sensor_inport.HALSensors.HAL_ultrasound_SI.HAL_list_echo_p.tab_echo[10].precedent /end REF_MEASUREMENT
/end GROUP
/begin GROUP sensor_inport.HALSensors.HAL_ultrasound_SI.HAL_list_echo_p.tab_echo[11] ""
 /begin REF_MEASUREMENT sensor_inport.HALSensors.HAL_ultrasound_SI.HAL_list_echo_p.tab_echo[11].begin_echo_index sensor_inport.HALSensors.HAL_ultrasound_SI.HAL_list_echo_p.tab_echo[11].d_echo sensor_inport.HALSensors.HAL_ultrasound_SI.HAL_list_echo_p.tab_echo[11].end_echo_index sensor_inport.HALSensors.HAL_ultrasound_SI.HAL_list_echo_p.tab_echo[11].max_value sensor_inport.HALSensors.HAL_ultrasound_SI.HAL_list_echo_p.tab_echo[11].max_value_index sensor_inport.HALSensors.HAL_ultrasound_SI.HAL_list_echo_p.tab_echo[11].pre_max_index sensor_inport.HALSensors.HAL_ultrasound_SI.HAL_list_echo_p.tab_echo[11].precedent /end REF_MEASUREMENT
/end GROUP
/begin GROUP sensor_inport.HALSensors.HAL_ultrasound_SI.HAL_list_echo_p.tab_echo[12] ""
 /begin REF_MEASUREMENT sensor_inport.HALSensors.HAL_ultrasound_SI.HAL_list_echo_p.tab_echo[12].begin_echo_index sensor_inport.HALSensors.HAL_ultrasound_SI.HAL_list_echo_p.tab_echo[12].d_echo sensor_inport.HALSensors.HAL_ultrasound_SI.HAL_list_echo_p.tab_echo[12].end_echo_index sensor_inport.HALSensors.HAL_ultrasound_SI.HAL_list_echo_p.tab_echo[12].max_value sensor_inport.HALSensors.HAL_ultrasound_SI.HAL_list_echo_p.tab_echo[12].max_value_index sensor_inport.HALSensors.HAL_ultrasound_SI.HAL_list_echo_p.tab_echo[12].pre_max_index sensor_inport.HALSensors.HAL_ultrasound_SI.HAL_list_echo_p.tab_echo[12].precedent /end REF_MEASUREMENT
/end GROUP
/begin GROUP sensor_inport.HALSensors.HAL_ultrasound_SI.HAL_list_echo_p.tab_echo[13] ""
 /begin REF_MEASUREMENT sensor_inport.HALSensors.HAL_ultrasound_SI.HAL_list_echo_p.tab_echo[13].begin_echo_index sensor_inport.HALSensors.HAL_ultrasound_SI.HAL_list_echo_p.tab_echo[13].d_echo sensor_inport.HALSensors.HAL_ultrasound_SI.HAL_list_echo_p.tab_echo[13].end_echo_index sensor_inport.HALSensors.HAL_ultrasound_SI.HAL_list_echo_p.tab_echo[13].max_value sensor_inport.HALSensors.HAL_ultrasound_SI.HAL_list_echo_p.tab_echo[13].max_value_index sensor_inport.HALSensors.HAL_ultrasound_SI.HAL_list_echo_p.tab_echo[13].pre_max_index sensor_inport.HALSensors.HAL_ultrasound_SI.HAL_list_echo_p.tab_echo[13].precedent /end REF_MEASUREMENT
/end GROUP
/begin GROUP sensor_inport.HALSensors.HAL_ultrasound_SI.HAL_list_echo_p.tab_echo[14] ""
 /begin REF_MEASUREMENT sensor_inport.HALSensors.HAL_ultrasound_SI.HAL_list_echo_p.tab_echo[14].begin_echo_index sensor_inport.HALSensors.HAL_ultrasound_SI.HAL_list_echo_p.tab_echo[14].d_echo sensor_inport.HALSensors.HAL_ultrasound_SI.HAL_list_echo_p.tab_echo[14].end_echo_index sensor_inport.HALSensors.HAL_ultrasound_SI.HAL_list_echo_p.tab_echo[14].max_value sensor_inport.HALSensors.HAL_ultrasound_SI.HAL_list_echo_p.tab_echo[14].max_value_index sensor_inport.HALSensors.HAL_ultrasound_SI.HAL_list_echo_p.tab_echo[14].pre_max_index sensor_inport.HALSensors.HAL_ultrasound_SI.HAL_list_echo_p.tab_echo[14].precedent /end REF_MEASUREMENT
/end GROUP
/begin GROUP sensor_inport.HALSensors.HAL_ultrasound_SI.HAL_list_echo_p.tab_echo[15] ""
 /begin REF_MEASUREMENT sensor_inport.HALSensors.HAL_ultrasound_SI.HAL_list_echo_p.tab_echo[15].begin_echo_index sensor_inport.HALSensors.HAL_ultrasound_SI.HAL_list_echo_p.tab_echo[15].d_echo sensor_inport.HALSensors.HAL_ultrasound_SI.HAL_list_echo_p.tab_echo[15].end_echo_index sensor_inport.HALSensors.HAL_ultrasound_SI.HAL_list_echo_p.tab_echo[15].max_value sensor_inport.HALSensors.HAL_ultrasound_SI.HAL_list_echo_p.tab_echo[15].max_value_index sensor_inport.HALSensors.HAL_ultrasound_SI.HAL_list_echo_p.tab_echo[15].pre_max_index sensor_inport.HALSensors.HAL_ultrasound_SI.HAL_list_echo_p.tab_echo[15].precedent /end REF_MEASUREMENT
/end GROUP
/begin GROUP sensor_inport.HALSensors.HAL_ultrasound_SI.HAL_list_echo_p.tab_echo[16] ""
 /begin REF_MEASUREMENT sensor_inport.HALSensors.HAL_ultrasound_SI.HAL_list_echo_p.tab_echo[16].begin_echo_index sensor_inport.HALSensors.HAL_ultrasound_SI.HAL_list_echo_p.tab_echo[16].d_echo sensor_inport.HALSensors.HAL_ultrasound_SI.HAL_list_echo_p.tab_echo[16].end_echo_index sensor_inport.HALSensors.HAL_ultrasound_SI.HAL_list_echo_p.tab_echo[16].max_value sensor_inport.HALSensors.HAL_ultrasound_SI.HAL_list_echo_p.tab_echo[16].max_value_index sensor_inport.HALSensors.HAL_ultrasound_SI.HAL_list_echo_p.tab_echo[16].pre_max_index sensor_inport.HALSensors.HAL_ultrasound_SI.HAL_list_echo_p.tab_echo[16].precedent /end REF_MEASUREMENT
/end GROUP
/begin GROUP sensor_inport.HALSensors.HAL_ultrasound_SI.HAL_list_echo_p.tab_echo[17] ""
 /begin REF_MEASUREMENT sensor_inport.HALSensors.HAL_ultrasound_SI.HAL_list_echo_p.tab_echo[17].begin_echo_index sensor_inport.HALSensors.HAL_ultrasound_SI.HAL_list_echo_p.tab_echo[17].d_echo sensor_inport.HALSensors.HAL_ultrasound_SI.HAL_list_echo_p.tab_echo[17].end_echo_index sensor_inport.HALSensors.HAL_ultrasound_SI.HAL_list_echo_p.tab_echo[17].max_value sensor_inport.HALSensors.HAL_ultrasound_SI.HAL_list_echo_p.tab_echo[17].max_value_index sensor_inport.HALSensors.HAL_ultrasound_SI.HAL_list_echo_p.tab_echo[17].pre_max_index sensor_inport.HALSensors.HAL_ultrasound_SI.HAL_list_echo_p.tab_echo[17].precedent /end REF_MEASUREMENT
/end GROUP
/begin GROUP sensor_inport.HALSensors.HAL_ultrasound_SI.HAL_list_echo_p.tab_echo[18] ""
 /begin REF_MEASUREMENT sensor_inport.HALSensors.HAL_ultrasound_SI.HAL_list_echo_p.tab_echo[18].begin_echo_index sensor_inport.HALSensors.HAL_ultrasound_SI.HAL_list_echo_p.tab_echo[18].d_echo sensor_inport.HALSensors.HAL_ultrasound_SI.HAL_list_echo_p.tab_echo[18].end_echo_index sensor_inport.HALSensors.HAL_ultrasound_SI.HAL_list_echo_p.tab_echo[18].max_value sensor_inport.HALSensors.HAL_ultrasound_SI.HAL_list_echo_p.tab_echo[18].max_value_index sensor_inport.HALSensors.HAL_ultrasound_SI.HAL_list_echo_p.tab_echo[18].pre_max_index sensor_inport.HALSensors.HAL_ultrasound_SI.HAL_list_echo_p.tab_echo[18].precedent /end REF_MEASUREMENT
/end GROUP
/begin GROUP sensor_inport.HALSensors.HAL_ultrasound_SI.HAL_list_echo_p.tab_echo[19] ""
 /begin REF_MEASUREMENT sensor_inport.HALSensors.HAL_ultrasound_SI.HAL_list_echo_p.tab_echo[19].begin_echo_index sensor_inport.HALSensors.HAL_ultrasound_SI.HAL_list_echo_p.tab_echo[19].d_echo sensor_inport.HALSensors.HAL_ultrasound_SI.HAL_list_echo_p.tab_echo[19].end_echo_index sensor_inport.HALSensors.HAL_ultrasound_SI.HAL_list_echo_p.tab_echo[19].max_value sensor_inport.HALSensors.HAL_ultrasound_SI.HAL_list_echo_p.tab_echo[19].max_value_index sensor_inport.HALSensors.HAL_ultrasound_SI.HAL_list_echo_p.tab_echo[19].pre_max_index sensor_inport.HALSensors.HAL_ultrasound_SI.HAL_list_echo_p.tab_echo[19].precedent /end REF_MEASUREMENT
/end GROUP
/begin GROUP sensor_inport.HALSensors.HAL_ultrasound_SI.HAL_list_echo_p.tab_echo[20] ""
 /begin REF_MEASUREMENT sensor_inport.HALSensors.HAL_ultrasound_SI.HAL_list_echo_p.tab_echo[20].begin_echo_index sensor_inport.HALSensors.HAL_ultrasound_SI.HAL_list_echo_p.tab_echo[20].d_echo sensor_inport.HALSensors.HAL_ultrasound_SI.HAL_list_echo_p.tab_echo[20].end_echo_index sensor_inport.HALSensors.HAL_ultrasound_SI.HAL_list_echo_p.tab_echo[20].max_value sensor_inport.HALSensors.HAL_ultrasound_SI.HAL_list_echo_p.tab_echo[20].max_value_index sensor_inport.HALSensors.HAL_ultrasound_SI.HAL_list_echo_p.tab_echo[20].pre_max_index sensor_inport.HALSensors.HAL_ultrasound_SI.HAL_list_echo_p.tab_echo[20].precedent /end REF_MEASUREMENT
/end GROUP
/begin GROUP sensor_inport.HALSensors.HAL_ultrasound_SI.HAL_list_echo_p.tab_echo[21] ""
 /begin REF_MEASUREMENT sensor_inport.HALSensors.HAL_ultrasound_SI.HAL_list_echo_p.tab_echo[21].begin_echo_index sensor_inport.HALSensors.HAL_ultrasound_SI.HAL_list_echo_p.tab_echo[21].d_echo sensor_inport.HALSensors.HAL_ultrasound_SI.HAL_list_echo_p.tab_echo[21].end_echo_index sensor_inport.HALSensors.HAL_ultrasound_SI.HAL_list_echo_p.tab_echo[21].max_value sensor_inport.HALSensors.HAL_ultrasound_SI.HAL_list_echo_p.tab_echo[21].max_value_index sensor_inport.HALSensors.HAL_ultrasound_SI.HAL_list_echo_p.tab_echo[21].pre_max_index sensor_inport.HALSensors.HAL_ultrasound_SI.HAL_list_echo_p.tab_echo[21].precedent /end REF_MEASUREMENT
/end GROUP
/begin GROUP sensor_inport.HALSensors.HAL_ultrasound_SI.HAL_list_echo_p.tab_echo[22] ""
 /begin REF_MEASUREMENT sensor_inport.HALSensors.HAL_ultrasound_SI.HAL_list_echo_p.tab_echo[22].begin_echo_index sensor_inport.HALSensors.HAL_ultrasound_SI.HAL_list_echo_p.tab_echo[22].d_echo sensor_inport.HALSensors.HAL_ultrasound_SI.HAL_list_echo_p.tab_echo[22].end_echo_index sensor_inport.HALSensors.HAL_ultrasound_SI.HAL_list_echo_p.tab_echo[22].max_value sensor_inport.HALSensors.HAL_ultrasound_SI.HAL_list_echo_p.tab_echo[22].max_value_index sensor_inport.HALSensors.HAL_ultrasound_SI.HAL_list_echo_p.tab_echo[22].pre_max_index sensor_inport.HALSensors.HAL_ultrasound_SI.HAL_list_echo_p.tab_echo[22].precedent /end REF_MEASUREMENT
/end GROUP
/begin GROUP sensor_inport.HALSensors.HAL_ultrasound_SI.HAL_list_echo_p.tab_echo[23] ""
 /begin REF_MEASUREMENT sensor_inport.HALSensors.HAL_ultrasound_SI.HAL_list_echo_p.tab_echo[23].begin_echo_index sensor_inport.HALSensors.HAL_ultrasound_SI.HAL_list_echo_p.tab_echo[23].d_echo sensor_inport.HALSensors.HAL_ultrasound_SI.HAL_list_echo_p.tab_echo[23].end_echo_index sensor_inport.HALSensors.HAL_ultrasound_SI.HAL_list_echo_p.tab_echo[23].max_value sensor_inport.HALSensors.HAL_ultrasound_SI.HAL_list_echo_p.tab_echo[23].max_value_index sensor_inport.HALSensors.HAL_ultrasound_SI.HAL_list_echo_p.tab_echo[23].pre_max_index sensor_inport.HALSensors.HAL_ultrasound_SI.HAL_list_echo_p.tab_echo[23].precedent /end REF_MEASUREMENT
/end GROUP
/begin GROUP sensor_inport.HALSensors.HAL_ultrasound_SI.HAL_list_echo_p.tab_echo[24] ""
 /begin REF_MEASUREMENT sensor_inport.HALSensors.HAL_ultrasound_SI.HAL_list_echo_p.tab_echo[24].begin_echo_index sensor_inport.HALSensors.HAL_ultrasound_SI.HAL_list_echo_p.tab_echo[24].d_echo sensor_inport.HALSensors.HAL_ultrasound_SI.HAL_list_echo_p.tab_echo[24].end_echo_index sensor_inport.HALSensors.HAL_ultrasound_SI.HAL_list_echo_p.tab_echo[24].max_value sensor_inport.HALSensors.HAL_ultrasound_SI.HAL_list_echo_p.tab_echo[24].max_value_index sensor_inport.HALSensors.HAL_ultrasound_SI.HAL_list_echo_p.tab_echo[24].pre_max_index sensor_inport.HALSensors.HAL_ultrasound_SI.HAL_list_echo_p.tab_echo[24].precedent /end REF_MEASUREMENT
/end GROUP
/begin GROUP sensor_inport.HALSensors.HAL_ultrasound_SI.HAL_list_echo_p.tab_echo[25] ""
 /begin REF_MEASUREMENT sensor_inport.HALSensors.HAL_ultrasound_SI.HAL_list_echo_p.tab_echo[25].begin_echo_index sensor_inport.HALSensors.HAL_ultrasound_SI.HAL_list_echo_p.tab_echo[25].d_echo sensor_inport.HALSensors.HAL_ultrasound_SI.HAL_list_echo_p.tab_echo[25].end_echo_index sensor_inport.HALSensors.HAL_ultrasound_SI.HAL_list_echo_p.tab_echo[25].max_value sensor_inport.HALSensors.HAL_ultrasound_SI.HAL_list_echo_p.tab_echo[25].max_value_index sensor_inport.HALSensors.HAL_ultrasound_SI.HAL_list_echo_p.tab_echo[25].pre_max_index sensor_inport.HALSensors.HAL_ultrasound_SI.HAL_list_echo_p.tab_echo[25].precedent /end REF_MEASUREMENT
/end GROUP
/begin GROUP sensor_inport.HALSensors.HAL_ultrasound_SI.HAL_list_echo_p.tab_echo[26] ""
 /begin REF_MEASUREMENT sensor_inport.HALSensors.HAL_ultrasound_SI.HAL_list_echo_p.tab_echo[26].begin_echo_index sensor_inport.HALSensors.HAL_ultrasound_SI.HAL_list_echo_p.tab_echo[26].d_echo sensor_inport.HALSensors.HAL_ultrasound_SI.HAL_list_echo_p.tab_echo[26].end_echo_index sensor_inport.HALSensors.HAL_ultrasound_SI.HAL_list_echo_p.tab_echo[26].max_value sensor_inport.HALSensors.HAL_ultrasound_SI.HAL_list_echo_p.tab_echo[26].max_value_index sensor_inport.HALSensors.HAL_ultrasound_SI.HAL_list_echo_p.tab_echo[26].pre_max_index sensor_inport.HALSensors.HAL_ultrasound_SI.HAL_list_echo_p.tab_echo[26].precedent /end REF_MEASUREMENT
/end GROUP
/begin GROUP sensor_inport.HALSensors.HAL_ultrasound_SI.HAL_list_echo_p.tab_echo[27] ""
 /begin REF_MEASUREMENT sensor_inport.HALSensors.HAL_ultrasound_SI.HAL_list_echo_p.tab_echo[27].begin_echo_index sensor_inport.HALSensors.HAL_ultrasound_SI.HAL_list_echo_p.tab_echo[27].d_echo sensor_inport.HALSensors.HAL_ultrasound_SI.HAL_list_echo_p.tab_echo[27].end_echo_index sensor_inport.HALSensors.HAL_ultrasound_SI.HAL_list_echo_p.tab_echo[27].max_value sensor_inport.HALSensors.HAL_ultrasound_SI.HAL_list_echo_p.tab_echo[27].max_value_index sensor_inport.HALSensors.HAL_ultrasound_SI.HAL_list_echo_p.tab_echo[27].pre_max_index sensor_inport.HALSensors.HAL_ultrasound_SI.HAL_list_echo_p.tab_echo[27].precedent /end REF_MEASUREMENT
/end GROUP
/begin GROUP sensor_inport.HALSensors.HAL_ultrasound_SI.HAL_list_echo_p.tab_echo[28] ""
 /begin REF_MEASUREMENT sensor_inport.HALSensors.HAL_ultrasound_SI.HAL_list_echo_p.tab_echo[28].begin_echo_index sensor_inport.HALSensors.HAL_ultrasound_SI.HAL_list_echo_p.tab_echo[28].d_echo sensor_inport.HALSensors.HAL_ultrasound_SI.HAL_list_echo_p.tab_echo[28].end_echo_index sensor_inport.HALSensors.HAL_ultrasound_SI.HAL_list_echo_p.tab_echo[28].max_value sensor_inport.HALSensors.HAL_ultrasound_SI.HAL_list_echo_p.tab_echo[28].max_value_index sensor_inport.HALSensors.HAL_ultrasound_SI.HAL_list_echo_p.tab_echo[28].pre_max_index sensor_inport.HALSensors.HAL_ultrasound_SI.HAL_list_echo_p.tab_echo[28].precedent /end REF_MEASUREMENT
/end GROUP
/begin GROUP sensor_inport.HALSensors.HAL_ultrasound_SI.HAL_list_echo_p.tab_echo[29] ""
 /begin REF_MEASUREMENT sensor_inport.HALSensors.HAL_ultrasound_SI.HAL_list_echo_p.tab_echo[29].begin_echo_index sensor_inport.HALSensors.HAL_ultrasound_SI.HAL_list_echo_p.tab_echo[29].d_echo sensor_inport.HALSensors.HAL_ultrasound_SI.HAL_list_echo_p.tab_echo[29].end_echo_index sensor_inport.HALSensors.HAL_ultrasound_SI.HAL_list_echo_p.tab_echo[29].max_value sensor_inport.HALSensors.HAL_ultrasound_SI.HAL_list_echo_p.tab_echo[29].max_value_index sensor_inport.HALSensors.HAL_ultrasound_SI.HAL_list_echo_p.tab_echo[29].pre_max_index sensor_inport.HALSensors.HAL_ultrasound_SI.HAL_list_echo_p.tab_echo[29].precedent /end REF_MEASUREMENT
/end GROUP
/begin GROUP sensor_inport.HALSensors.HAL_vbat_SI ""
 /begin REF_MEASUREMENT sensor_inport.HALSensors.HAL_vbat_SI.vbat_V sensor_inport.HALSensors.HAL_vbat_SI.vbat_percentage /end REF_MEASUREMENT
/end GROUP
/end MODULE
/end PROJECT
