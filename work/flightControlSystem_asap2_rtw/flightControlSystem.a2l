/******************************************************************************
* ASAP2 file: flightControlSystem.a2l
* Academic License - for use in teaching, academic research, and meeting
* course requirements at degree granting institutions only. Not for
* government, commercial, or other organizational use.
* Code generation for model "flightControlSystem".
* Model version : 1.799
* Simulink Coder version : 9.1 (R2019a) 23-Nov-2018
* C source code generated on : Thu Nov 14 09:41:30 2019
* Target selection: asap2.tlc
* Note: GRT includes extra infrastructure and instrumentation for prototyping
* Embedded hardware selection: Atmel->AVR
* Emulation hardware selection:
* Differs from embedded hardware (MATLAB Host)
* Code generation objectives: Unspecified
* Validation result: Not run
* (add additional file header information here)
******************************************************************************/
/* Version 1.31 */
ASAP2_VERSION 1 31
/begin PROJECT ProjectName "Project Comment Goes Here"
/begin HEADER "Header Comments go here" /end HEADER
/begin MODULE ModuleName "Module Comment Goes Here"
/begin MOD_PAR "MOD PAR Comment Goes Here" /end MOD_PAR
/begin MOD_COMMON "Mod Common Comment Here" BYTE_ORDER MSB_LAST /end MOD_COMMON
/begin RECORD_LAYOUT Scalar_BOOLEAN FNC_VALUES 1 UBYTE COLUMN_DIR DIRECT /end RECORD_LAYOUT
/begin RECORD_LAYOUT Scalar_UBYTE FNC_VALUES 1 UBYTE COLUMN_DIR DIRECT /end RECORD_LAYOUT
/begin RECORD_LAYOUT Scalar_BYTE FNC_VALUES 1 SBYTE COLUMN_DIR DIRECT /end RECORD_LAYOUT
/begin RECORD_LAYOUT Scalar_UWORD FNC_VALUES 1 UWORD COLUMN_DIR DIRECT /end RECORD_LAYOUT
/begin RECORD_LAYOUT Scalar_SWORD FNC_VALUES 1 SWORD COLUMN_DIR DIRECT /end RECORD_LAYOUT
/begin RECORD_LAYOUT Scalar_ULONG FNC_VALUES 1 ULONG COLUMN_DIR DIRECT /end RECORD_LAYOUT
/begin RECORD_LAYOUT Scalar_LONG FNC_VALUES 1 SLONG COLUMN_DIR DIRECT /end RECORD_LAYOUT
/begin RECORD_LAYOUT Scalar_FLOAT32_IEEE FNC_VALUES 1 FLOAT32_IEEE COLUMN_DIR DIRECT /end RECORD_LAYOUT
/begin RECORD_LAYOUT Scalar_FLOAT64_IEEE FNC_VALUES 1 FLOAT64_IEEE COLUMN_DIR DIRECT /end RECORD_LAYOUT
/begin RECORD_LAYOUT Lookup1D_BOOLEAN FNC_VALUES 1 UBYTE COLUMN_DIR DIRECT /end RECORD_LAYOUT
/begin RECORD_LAYOUT Lookup1D_X_BOOLEAN AXIS_PTS_X 1 UBYTE INDEX_INCR DIRECT /end RECORD_LAYOUT
/begin RECORD_LAYOUT Lookup1D_BYTE FNC_VALUES 1 SBYTE COLUMN_DIR DIRECT /end RECORD_LAYOUT
/begin RECORD_LAYOUT Lookup1D_X_BYTE AXIS_PTS_X 1 SBYTE INDEX_INCR DIRECT /end RECORD_LAYOUT
/begin RECORD_LAYOUT Lookup1D_UBYTE FNC_VALUES 1 UBYTE COLUMN_DIR DIRECT /end RECORD_LAYOUT
/begin RECORD_LAYOUT Lookup1D_X_UBYTE AXIS_PTS_X 1 UBYTE INDEX_INCR DIRECT /end RECORD_LAYOUT
/begin RECORD_LAYOUT Lookup1D_UWORD FNC_VALUES 1 UWORD COLUMN_DIR DIRECT /end RECORD_LAYOUT
/begin RECORD_LAYOUT Lookup1D_X_UWORD AXIS_PTS_X 1 UWORD INDEX_INCR DIRECT /end RECORD_LAYOUT
/begin RECORD_LAYOUT Lookup1D_WORD FNC_VALUES 1 SWORD COLUMN_DIR DIRECT /end RECORD_LAYOUT
/begin RECORD_LAYOUT Lookup1D_X_WORD AXIS_PTS_X 1 SWORD INDEX_INCR DIRECT /end RECORD_LAYOUT
/begin RECORD_LAYOUT Lookup1D_ULONG FNC_VALUES 1 ULONG COLUMN_DIR DIRECT /end RECORD_LAYOUT
/begin RECORD_LAYOUT Lookup1D_X_ULONG AXIS_PTS_X 1 ULONG INDEX_INCR DIRECT /end RECORD_LAYOUT
/begin RECORD_LAYOUT Lookup1D_SLONG FNC_VALUES 1 SLONG COLUMN_DIR DIRECT /end RECORD_LAYOUT
/begin RECORD_LAYOUT Lookup1D_X_LONG AXIS_PTS_X 1 SLONG INDEX_INCR DIRECT /end RECORD_LAYOUT
/begin RECORD_LAYOUT Lookup1D_FLOAT32_IEEE FNC_VALUES 1 FLOAT32_IEEE COLUMN_DIR DIRECT /end RECORD_LAYOUT
/begin RECORD_LAYOUT Lookup1D_X_FLOAT32_IEEE AXIS_PTS_X 1 FLOAT32_IEEE INDEX_INCR DIRECT /end RECORD_LAYOUT
/begin RECORD_LAYOUT Lookup1D_FLOAT64_IEEE FNC_VALUES 1 FLOAT64_IEEE COLUMN_DIR DIRECT /end RECORD_LAYOUT
/begin MEASUREMENT cmd_inport.controlModePosVSOrient "" UBYTE flightControlSystem_CM_boolean 0 0 0 1 ECU_ADDRESS 0x0000 /* @ECU_Address@cmd_inport.controlModePosVSOrient@ */ /end MEASUREMENT
/begin MEASUREMENT cmd_inport.pos_ref "" FLOAT32_IEEE flightControlSystem_CM_single 0 0 -3.4E+38 3.4E+38 ARRAY_SIZE 3 ECU_ADDRESS 0x0000 /* @ECU_Address@cmd_inport.pos_ref@ */ /end MEASUREMENT
/begin MEASUREMENT cmd_inport.takeoff_flag "" UBYTE flightControlSystem_CM_boolean 0 0 0 1 ECU_ADDRESS 0x0000 /* @ECU_Address@cmd_inport.takeoff_flag@ */ /end MEASUREMENT
/begin MEASUREMENT cmd_inport.orient_ref "" FLOAT32_IEEE flightControlSystem_CM_single 0 0 -3.4E+38 3.4E+38 ARRAY_SIZE 3 ECU_ADDRESS 0x0000 /* @ECU_Address@cmd_inport.orient_ref@ */ /end MEASUREMENT
/begin MEASUREMENT cmd_inport.live_time_ticks "" ULONG flightControlSystem_CM_uint32 0 0 0 4294967295 ECU_ADDRESS 0x0000 /* @ECU_Address@cmd_inport.live_time_ticks@ */ /end MEASUREMENT
/begin MEASUREMENT sensor_inport.VisionSensors.opticalFlow_data "" FLOAT32_IEEE flightControlSystem_CM_single 0 0 -3.4E+38 3.4E+38 ARRAY_SIZE 3 ECU_ADDRESS 0x0000 /* @ECU_Address@sensor_inport.VisionSensors.opticalFlow_data@ */ /end MEASUREMENT
/begin MEASUREMENT sensor_inport.VisionSensors.posVIS_data "" FLOAT32_IEEE flightControlSystem_CM_single 0 0 -3.4E+38 3.4E+38 ARRAY_SIZE 4 ECU_ADDRESS 0x0000 /* @ECU_Address@sensor_inport.VisionSensors.posVIS_data@ */ /end MEASUREMENT
/begin MEASUREMENT sensor_inport.VisionSensors.usePosVIS_flag "" FLOAT32_IEEE flightControlSystem_CM_single 0 0 -3.4E+38 3.4E+38 ECU_ADDRESS 0x0000 /* @ECU_Address@sensor_inport.VisionSensors.usePosVIS_flag@ */ /end MEASUREMENT
/begin MEASUREMENT sensor_inport.HALSensors.number_HAL_read_call "" SLONG flightControlSystem_CM_int32 0 0 -2147483648 2147483647 ECU_ADDRESS 0x0000 /* @ECU_Address@sensor_inport.HALSensors.number_HAL_read_call@ */ /end MEASUREMENT
/begin MEASUREMENT sensor_inport.HALSensors.timestamp "" ULONG flightControlSystem_CM_uint32 0 0 0 4294967295 ECU_ADDRESS 0x0000 /* @ECU_Address@sensor_inport.HALSensors.timestamp@ */ /end MEASUREMENT
/begin MEASUREMENT sensor_inport.HALSensors.status "" UWORD flightControlSystem_CM_uint16 0 0 0 65535 ECU_ADDRESS 0x0000 /* @ECU_Address@sensor_inport.HALSensors.status@ */ /end MEASUREMENT
/begin MEASUREMENT sensor_inport.HALSensors.used "" UBYTE flightControlSystem_CM_uint8 0 0 0 255 ECU_ADDRESS 0x0000 /* @ECU_Address@sensor_inport.HALSensors.used@ */ /end MEASUREMENT
/begin MEASUREMENT sensor_inport.HALSensors.count_user "" UBYTE flightControlSystem_CM_uint8 0 0 0 255 ECU_ADDRESS 0x0000 /* @ECU_Address@sensor_inport.HALSensors.count_user@ */ /end MEASUREMENT
/begin MEASUREMENT sensor_inport.HALSensors.HAL_acc_SI.x "" FLOAT32_IEEE flightControlSystem_CM_single 0 0 -3.4E+38 3.4E+38 ECU_ADDRESS 0x0000 /* @ECU_Address@sensor_inport.HALSensors.HAL_acc_SI.x@ */ /end MEASUREMENT
/begin MEASUREMENT sensor_inport.HALSensors.HAL_acc_SI.y "" FLOAT32_IEEE flightControlSystem_CM_single 0 0 -3.4E+38 3.4E+38 ECU_ADDRESS 0x0000 /* @ECU_Address@sensor_inport.HALSensors.HAL_acc_SI.y@ */ /end MEASUREMENT
/begin MEASUREMENT sensor_inport.HALSensors.HAL_acc_SI.z "" FLOAT32_IEEE flightControlSystem_CM_single 0 0 -3.4E+38 3.4E+38 ECU_ADDRESS 0x0000 /* @ECU_Address@sensor_inport.HALSensors.HAL_acc_SI.z@ */ /end MEASUREMENT
/begin MEASUREMENT sensor_inport.HALSensors.HAL_acc_SI.temperature "" FLOAT32_IEEE flightControlSystem_CM_single 0 0 -3.4E+38 3.4E+38 ECU_ADDRESS 0x0000 /* @ECU_Address@sensor_inport.HALSensors.HAL_acc_SI.temperature@ */ /end MEASUREMENT
/begin MEASUREMENT sensor_inport.HALSensors.HAL_gyro_SI.x "" FLOAT32_IEEE flightControlSystem_CM_single 0 0 -3.4E+38 3.4E+38 ECU_ADDRESS 0x0000 /* @ECU_Address@sensor_inport.HALSensors.HAL_gyro_SI.x@ */ /end MEASUREMENT
/begin MEASUREMENT sensor_inport.HALSensors.HAL_gyro_SI.y "" FLOAT32_IEEE flightControlSystem_CM_single 0 0 -3.4E+38 3.4E+38 ECU_ADDRESS 0x0000 /* @ECU_Address@sensor_inport.HALSensors.HAL_gyro_SI.y@ */ /end MEASUREMENT
/begin MEASUREMENT sensor_inport.HALSensors.HAL_gyro_SI.z "" FLOAT32_IEEE flightControlSystem_CM_single 0 0 -3.4E+38 3.4E+38 ECU_ADDRESS 0x0000 /* @ECU_Address@sensor_inport.HALSensors.HAL_gyro_SI.z@ */ /end MEASUREMENT
/begin MEASUREMENT sensor_inport.HALSensors.HAL_gyro_SI.temperature "" FLOAT32_IEEE flightControlSystem_CM_single 0 0 -3.4E+38 3.4E+38 ECU_ADDRESS 0x0000 /* @ECU_Address@sensor_inport.HALSensors.HAL_gyro_SI.temperature@ */ /end MEASUREMENT
/begin MEASUREMENT sensor_inport.HALSensors.HAL_gyro_SI.temperature_lsb "" SLONG flightControlSystem_CM_int32 0 0 -2147483648 2147483647 ECU_ADDRESS 0x0000 /* @ECU_Address@sensor_inport.HALSensors.HAL_gyro_SI.temperature_lsb@ */ /end MEASUREMENT
/begin MEASUREMENT sensor_inport.HALSensors.HAL_fifo_count "" UWORD flightControlSystem_CM_uint16 0 0 0 65535 ECU_ADDRESS 0x0000 /* @ECU_Address@sensor_inport.HALSensors.HAL_fifo_count@ */ /end MEASUREMENT
/begin MEASUREMENT sensor_inport.HALSensors.fifo_timestamp "" ULONG flightControlSystem_CM_uint32 0 0 0 4294967295 ECU_ADDRESS 0x0000 /* @ECU_Address@sensor_inport.HALSensors.fifo_timestamp@ */ /end MEASUREMENT
/begin MEASUREMENT sensor_inport.HALSensors.HAL_fifo_gyro_SI_TempCorr[0].x "" FLOAT32_IEEE flightControlSystem_CM_single 0 0 -3.4E+38 3.4E+38 ECU_ADDRESS 0x0000 /* @ECU_Address@sensor_inport.HALSensors.HAL_fifo_gyro_SI_TempCorr[0].x@ */ /end MEASUREMENT
/begin MEASUREMENT sensor_inport.HALSensors.HAL_fifo_gyro_SI_TempCorr[0].y "" FLOAT32_IEEE flightControlSystem_CM_single 0 0 -3.4E+38 3.4E+38 ECU_ADDRESS 0x0000 /* @ECU_Address@sensor_inport.HALSensors.HAL_fifo_gyro_SI_TempCorr[0].y@ */ /end MEASUREMENT
/begin MEASUREMENT sensor_inport.HALSensors.HAL_fifo_gyro_SI_TempCorr[0].z "" FLOAT32_IEEE flightControlSystem_CM_single 0 0 -3.4E+38 3.4E+38 ECU_ADDRESS 0x0000 /* @ECU_Address@sensor_inport.HALSensors.HAL_fifo_gyro_SI_TempCorr[0].z@ */ /end MEASUREMENT
/begin MEASUREMENT sensor_inport.HALSensors.HAL_fifo_gyro_SI_TempCorr[1].x "" FLOAT32_IEEE flightControlSystem_CM_single 0 0 -3.4E+38 3.4E+38 ECU_ADDRESS 0x0000 /* @ECU_Address@sensor_inport.HALSensors.HAL_fifo_gyro_SI_TempCorr[1].x@ */ /end MEASUREMENT
/begin MEASUREMENT sensor_inport.HALSensors.HAL_fifo_gyro_SI_TempCorr[1].y "" FLOAT32_IEEE flightControlSystem_CM_single 0 0 -3.4E+38 3.4E+38 ECU_ADDRESS 0x0000 /* @ECU_Address@sensor_inport.HALSensors.HAL_fifo_gyro_SI_TempCorr[1].y@ */ /end MEASUREMENT
/begin MEASUREMENT sensor_inport.HALSensors.HAL_fifo_gyro_SI_TempCorr[1].z "" FLOAT32_IEEE flightControlSystem_CM_single 0 0 -3.4E+38 3.4E+38 ECU_ADDRESS 0x0000 /* @ECU_Address@sensor_inport.HALSensors.HAL_fifo_gyro_SI_TempCorr[1].z@ */ /end MEASUREMENT
/begin MEASUREMENT sensor_inport.HALSensors.HAL_fifo_gyro_SI_TempCorr[2].x "" FLOAT32_IEEE flightControlSystem_CM_single 0 0 -3.4E+38 3.4E+38 ECU_ADDRESS 0x0000 /* @ECU_Address@sensor_inport.HALSensors.HAL_fifo_gyro_SI_TempCorr[2].x@ */ /end MEASUREMENT
/begin MEASUREMENT sensor_inport.HALSensors.HAL_fifo_gyro_SI_TempCorr[2].y "" FLOAT32_IEEE flightControlSystem_CM_single 0 0 -3.4E+38 3.4E+38 ECU_ADDRESS 0x0000 /* @ECU_Address@sensor_inport.HALSensors.HAL_fifo_gyro_SI_TempCorr[2].y@ */ /end MEASUREMENT
/begin MEASUREMENT sensor_inport.HALSensors.HAL_fifo_gyro_SI_TempCorr[2].z "" FLOAT32_IEEE flightControlSystem_CM_single 0 0 -3.4E+38 3.4E+38 ECU_ADDRESS 0x0000 /* @ECU_Address@sensor_inport.HALSensors.HAL_fifo_gyro_SI_TempCorr[2].z@ */ /end MEASUREMENT
/begin MEASUREMENT sensor_inport.HALSensors.HAL_fifo_gyro_SI_TempCorr[3].x "" FLOAT32_IEEE flightControlSystem_CM_single 0 0 -3.4E+38 3.4E+38 ECU_ADDRESS 0x0000 /* @ECU_Address@sensor_inport.HALSensors.HAL_fifo_gyro_SI_TempCorr[3].x@ */ /end MEASUREMENT
/begin MEASUREMENT sensor_inport.HALSensors.HAL_fifo_gyro_SI_TempCorr[3].y "" FLOAT32_IEEE flightControlSystem_CM_single 0 0 -3.4E+38 3.4E+38 ECU_ADDRESS 0x0000 /* @ECU_Address@sensor_inport.HALSensors.HAL_fifo_gyro_SI_TempCorr[3].y@ */ /end MEASUREMENT
/begin MEASUREMENT sensor_inport.HALSensors.HAL_fifo_gyro_SI_TempCorr[3].z "" FLOAT32_IEEE flightControlSystem_CM_single 0 0 -3.4E+38 3.4E+38 ECU_ADDRESS 0x0000 /* @ECU_Address@sensor_inport.HALSensors.HAL_fifo_gyro_SI_TempCorr[3].z@ */ /end MEASUREMENT
/begin MEASUREMENT sensor_inport.HALSensors.HAL_fifo_gyro_SI_TempCorr[4].x "" FLOAT32_IEEE flightControlSystem_CM_single 0 0 -3.4E+38 3.4E+38 ECU_ADDRESS 0x0000 /* @ECU_Address@sensor_inport.HALSensors.HAL_fifo_gyro_SI_TempCorr[4].x@ */ /end MEASUREMENT
/begin MEASUREMENT sensor_inport.HALSensors.HAL_fifo_gyro_SI_TempCorr[4].y "" FLOAT32_IEEE flightControlSystem_CM_single 0 0 -3.4E+38 3.4E+38 ECU_ADDRESS 0x0000 /* @ECU_Address@sensor_inport.HALSensors.HAL_fifo_gyro_SI_TempCorr[4].y@ */ /end MEASUREMENT
/begin MEASUREMENT sensor_inport.HALSensors.HAL_fifo_gyro_SI_TempCorr[4].z "" FLOAT32_IEEE flightControlSystem_CM_single 0 0 -3.4E+38 3.4E+38 ECU_ADDRESS 0x0000 /* @ECU_Address@sensor_inport.HALSensors.HAL_fifo_gyro_SI_TempCorr[4].z@ */ /end MEASUREMENT
/begin MEASUREMENT sensor_inport.HALSensors.HAL_fifo_acce_SI_TempCorr[0].x "" FLOAT32_IEEE flightControlSystem_CM_single 0 0 -3.4E+38 3.4E+38 ECU_ADDRESS 0x0000 /* @ECU_Address@sensor_inport.HALSensors.HAL_fifo_acce_SI_TempCorr[0].x@ */ /end MEASUREMENT
/begin MEASUREMENT sensor_inport.HALSensors.HAL_fifo_acce_SI_TempCorr[0].y "" FLOAT32_IEEE flightControlSystem_CM_single 0 0 -3.4E+38 3.4E+38 ECU_ADDRESS 0x0000 /* @ECU_Address@sensor_inport.HALSensors.HAL_fifo_acce_SI_TempCorr[0].y@ */ /end MEASUREMENT
/begin MEASUREMENT sensor_inport.HALSensors.HAL_fifo_acce_SI_TempCorr[0].z "" FLOAT32_IEEE flightControlSystem_CM_single 0 0 -3.4E+38 3.4E+38 ECU_ADDRESS 0x0000 /* @ECU_Address@sensor_inport.HALSensors.HAL_fifo_acce_SI_TempCorr[0].z@ */ /end MEASUREMENT
/begin MEASUREMENT sensor_inport.HALSensors.HAL_fifo_acce_SI_TempCorr[1].x "" FLOAT32_IEEE flightControlSystem_CM_single 0 0 -3.4E+38 3.4E+38 ECU_ADDRESS 0x0000 /* @ECU_Address@sensor_inport.HALSensors.HAL_fifo_acce_SI_TempCorr[1].x@ */ /end MEASUREMENT
/begin MEASUREMENT sensor_inport.HALSensors.HAL_fifo_acce_SI_TempCorr[1].y "" FLOAT32_IEEE flightControlSystem_CM_single 0 0 -3.4E+38 3.4E+38 ECU_ADDRESS 0x0000 /* @ECU_Address@sensor_inport.HALSensors.HAL_fifo_acce_SI_TempCorr[1].y@ */ /end MEASUREMENT
/begin MEASUREMENT sensor_inport.HALSensors.HAL_fifo_acce_SI_TempCorr[1].z "" FLOAT32_IEEE flightControlSystem_CM_single 0 0 -3.4E+38 3.4E+38 ECU_ADDRESS 0x0000 /* @ECU_Address@sensor_inport.HALSensors.HAL_fifo_acce_SI_TempCorr[1].z@ */ /end MEASUREMENT
/begin MEASUREMENT sensor_inport.HALSensors.HAL_fifo_acce_SI_TempCorr[2].x "" FLOAT32_IEEE flightControlSystem_CM_single 0 0 -3.4E+38 3.4E+38 ECU_ADDRESS 0x0000 /* @ECU_Address@sensor_inport.HALSensors.HAL_fifo_acce_SI_TempCorr[2].x@ */ /end MEASUREMENT
/begin MEASUREMENT sensor_inport.HALSensors.HAL_fifo_acce_SI_TempCorr[2].y "" FLOAT32_IEEE flightControlSystem_CM_single 0 0 -3.4E+38 3.4E+38 ECU_ADDRESS 0x0000 /* @ECU_Address@sensor_inport.HALSensors.HAL_fifo_acce_SI_TempCorr[2].y@ */ /end MEASUREMENT
/begin MEASUREMENT sensor_inport.HALSensors.HAL_fifo_acce_SI_TempCorr[2].z "" FLOAT32_IEEE flightControlSystem_CM_single 0 0 -3.4E+38 3.4E+38 ECU_ADDRESS 0x0000 /* @ECU_Address@sensor_inport.HALSensors.HAL_fifo_acce_SI_TempCorr[2].z@ */ /end MEASUREMENT
/begin MEASUREMENT sensor_inport.HALSensors.HAL_fifo_acce_SI_TempCorr[3].x "" FLOAT32_IEEE flightControlSystem_CM_single 0 0 -3.4E+38 3.4E+38 ECU_ADDRESS 0x0000 /* @ECU_Address@sensor_inport.HALSensors.HAL_fifo_acce_SI_TempCorr[3].x@ */ /end MEASUREMENT
/begin MEASUREMENT sensor_inport.HALSensors.HAL_fifo_acce_SI_TempCorr[3].y "" FLOAT32_IEEE flightControlSystem_CM_single 0 0 -3.4E+38 3.4E+38 ECU_ADDRESS 0x0000 /* @ECU_Address@sensor_inport.HALSensors.HAL_fifo_acce_SI_TempCorr[3].y@ */ /end MEASUREMENT
/begin MEASUREMENT sensor_inport.HALSensors.HAL_fifo_acce_SI_TempCorr[3].z "" FLOAT32_IEEE flightControlSystem_CM_single 0 0 -3.4E+38 3.4E+38 ECU_ADDRESS 0x0000 /* @ECU_Address@sensor_inport.HALSensors.HAL_fifo_acce_SI_TempCorr[3].z@ */ /end MEASUREMENT
/begin MEASUREMENT sensor_inport.HALSensors.HAL_fifo_acce_SI_TempCorr[4].x "" FLOAT32_IEEE flightControlSystem_CM_single 0 0 -3.4E+38 3.4E+38 ECU_ADDRESS 0x0000 /* @ECU_Address@sensor_inport.HALSensors.HAL_fifo_acce_SI_TempCorr[4].x@ */ /end MEASUREMENT
/begin MEASUREMENT sensor_inport.HALSensors.HAL_fifo_acce_SI_TempCorr[4].y "" FLOAT32_IEEE flightControlSystem_CM_single 0 0 -3.4E+38 3.4E+38 ECU_ADDRESS 0x0000 /* @ECU_Address@sensor_inport.HALSensors.HAL_fifo_acce_SI_TempCorr[4].y@ */ /end MEASUREMENT
/begin MEASUREMENT sensor_inport.HALSensors.HAL_fifo_acce_SI_TempCorr[4].z "" FLOAT32_IEEE flightControlSystem_CM_single 0 0 -3.4E+38 3.4E+38 ECU_ADDRESS 0x0000 /* @ECU_Address@sensor_inport.HALSensors.HAL_fifo_acce_SI_TempCorr[4].z@ */ /end MEASUREMENT
/begin MEASUREMENT sensor_inport.HALSensors.HAL_fifo_gyro_SI[0].x "" FLOAT32_IEEE flightControlSystem_CM_single 0 0 -3.4E+38 3.4E+38 ECU_ADDRESS 0x0000 /* @ECU_Address@sensor_inport.HALSensors.HAL_fifo_gyro_SI[0].x@ */ /end MEASUREMENT
/begin MEASUREMENT sensor_inport.HALSensors.HAL_fifo_gyro_SI[0].y "" FLOAT32_IEEE flightControlSystem_CM_single 0 0 -3.4E+38 3.4E+38 ECU_ADDRESS 0x0000 /* @ECU_Address@sensor_inport.HALSensors.HAL_fifo_gyro_SI[0].y@ */ /end MEASUREMENT
/begin MEASUREMENT sensor_inport.HALSensors.HAL_fifo_gyro_SI[0].z "" FLOAT32_IEEE flightControlSystem_CM_single 0 0 -3.4E+38 3.4E+38 ECU_ADDRESS 0x0000 /* @ECU_Address@sensor_inport.HALSensors.HAL_fifo_gyro_SI[0].z@ */ /end MEASUREMENT
/begin MEASUREMENT sensor_inport.HALSensors.HAL_fifo_gyro_SI[1].x "" FLOAT32_IEEE flightControlSystem_CM_single 0 0 -3.4E+38 3.4E+38 ECU_ADDRESS 0x0000 /* @ECU_Address@sensor_inport.HALSensors.HAL_fifo_gyro_SI[1].x@ */ /end MEASUREMENT
/begin MEASUREMENT sensor_inport.HALSensors.HAL_fifo_gyro_SI[1].y "" FLOAT32_IEEE flightControlSystem_CM_single 0 0 -3.4E+38 3.4E+38 ECU_ADDRESS 0x0000 /* @ECU_Address@sensor_inport.HALSensors.HAL_fifo_gyro_SI[1].y@ */ /end MEASUREMENT
/begin MEASUREMENT sensor_inport.HALSensors.HAL_fifo_gyro_SI[1].z "" FLOAT32_IEEE flightControlSystem_CM_single 0 0 -3.4E+38 3.4E+38 ECU_ADDRESS 0x0000 /* @ECU_Address@sensor_inport.HALSensors.HAL_fifo_gyro_SI[1].z@ */ /end MEASUREMENT
/begin MEASUREMENT sensor_inport.HALSensors.HAL_fifo_gyro_SI[2].x "" FLOAT32_IEEE flightControlSystem_CM_single 0 0 -3.4E+38 3.4E+38 ECU_ADDRESS 0x0000 /* @ECU_Address@sensor_inport.HALSensors.HAL_fifo_gyro_SI[2].x@ */ /end MEASUREMENT
/begin MEASUREMENT sensor_inport.HALSensors.HAL_fifo_gyro_SI[2].y "" FLOAT32_IEEE flightControlSystem_CM_single 0 0 -3.4E+38 3.4E+38 ECU_ADDRESS 0x0000 /* @ECU_Address@sensor_inport.HALSensors.HAL_fifo_gyro_SI[2].y@ */ /end MEASUREMENT
/begin MEASUREMENT sensor_inport.HALSensors.HAL_fifo_gyro_SI[2].z "" FLOAT32_IEEE flightControlSystem_CM_single 0 0 -3.4E+38 3.4E+38 ECU_ADDRESS 0x0000 /* @ECU_Address@sensor_inport.HALSensors.HAL_fifo_gyro_SI[2].z@ */ /end MEASUREMENT
/begin MEASUREMENT sensor_inport.HALSensors.HAL_fifo_gyro_SI[3].x "" FLOAT32_IEEE flightControlSystem_CM_single 0 0 -3.4E+38 3.4E+38 ECU_ADDRESS 0x0000 /* @ECU_Address@sensor_inport.HALSensors.HAL_fifo_gyro_SI[3].x@ */ /end MEASUREMENT
/begin MEASUREMENT sensor_inport.HALSensors.HAL_fifo_gyro_SI[3].y "" FLOAT32_IEEE flightControlSystem_CM_single 0 0 -3.4E+38 3.4E+38 ECU_ADDRESS 0x0000 /* @ECU_Address@sensor_inport.HALSensors.HAL_fifo_gyro_SI[3].y@ */ /end MEASUREMENT
/begin MEASUREMENT sensor_inport.HALSensors.HAL_fifo_gyro_SI[3].z "" FLOAT32_IEEE flightControlSystem_CM_single 0 0 -3.4E+38 3.4E+38 ECU_ADDRESS 0x0000 /* @ECU_Address@sensor_inport.HALSensors.HAL_fifo_gyro_SI[3].z@ */ /end MEASUREMENT
/begin MEASUREMENT sensor_inport.HALSensors.HAL_fifo_gyro_SI[4].x "" FLOAT32_IEEE flightControlSystem_CM_single 0 0 -3.4E+38 3.4E+38 ECU_ADDRESS 0x0000 /* @ECU_Address@sensor_inport.HALSensors.HAL_fifo_gyro_SI[4].x@ */ /end MEASUREMENT
/begin MEASUREMENT sensor_inport.HALSensors.HAL_fifo_gyro_SI[4].y "" FLOAT32_IEEE flightControlSystem_CM_single 0 0 -3.4E+38 3.4E+38 ECU_ADDRESS 0x0000 /* @ECU_Address@sensor_inport.HALSensors.HAL_fifo_gyro_SI[4].y@ */ /end MEASUREMENT
/begin MEASUREMENT sensor_inport.HALSensors.HAL_fifo_gyro_SI[4].z "" FLOAT32_IEEE flightControlSystem_CM_single 0 0 -3.4E+38 3.4E+38 ECU_ADDRESS 0x0000 /* @ECU_Address@sensor_inport.HALSensors.HAL_fifo_gyro_SI[4].z@ */ /end MEASUREMENT
/begin MEASUREMENT sensor_inport.HALSensors.HAL_fifo_acce_SI[0].x "" FLOAT32_IEEE flightControlSystem_CM_single 0 0 -3.4E+38 3.4E+38 ECU_ADDRESS 0x0000 /* @ECU_Address@sensor_inport.HALSensors.HAL_fifo_acce_SI[0].x@ */ /end MEASUREMENT
/begin MEASUREMENT sensor_inport.HALSensors.HAL_fifo_acce_SI[0].y "" FLOAT32_IEEE flightControlSystem_CM_single 0 0 -3.4E+38 3.4E+38 ECU_ADDRESS 0x0000 /* @ECU_Address@sensor_inport.HALSensors.HAL_fifo_acce_SI[0].y@ */ /end MEASUREMENT
/begin MEASUREMENT sensor_inport.HALSensors.HAL_fifo_acce_SI[0].z "" FLOAT32_IEEE flightControlSystem_CM_single 0 0 -3.4E+38 3.4E+38 ECU_ADDRESS 0x0000 /* @ECU_Address@sensor_inport.HALSensors.HAL_fifo_acce_SI[0].z@ */ /end MEASUREMENT
/begin MEASUREMENT sensor_inport.HALSensors.HAL_fifo_acce_SI[1].x "" FLOAT32_IEEE flightControlSystem_CM_single 0 0 -3.4E+38 3.4E+38 ECU_ADDRESS 0x0000 /* @ECU_Address@sensor_inport.HALSensors.HAL_fifo_acce_SI[1].x@ */ /end MEASUREMENT
/begin MEASUREMENT sensor_inport.HALSensors.HAL_fifo_acce_SI[1].y "" FLOAT32_IEEE flightControlSystem_CM_single 0 0 -3.4E+38 3.4E+38 ECU_ADDRESS 0x0000 /* @ECU_Address@sensor_inport.HALSensors.HAL_fifo_acce_SI[1].y@ */ /end MEASUREMENT
/begin MEASUREMENT sensor_inport.HALSensors.HAL_fifo_acce_SI[1].z "" FLOAT32_IEEE flightControlSystem_CM_single 0 0 -3.4E+38 3.4E+38 ECU_ADDRESS 0x0000 /* @ECU_Address@sensor_inport.HALSensors.HAL_fifo_acce_SI[1].z@ */ /end MEASUREMENT
/begin MEASUREMENT sensor_inport.HALSensors.HAL_fifo_acce_SI[2].x "" FLOAT32_IEEE flightControlSystem_CM_single 0 0 -3.4E+38 3.4E+38 ECU_ADDRESS 0x0000 /* @ECU_Address@sensor_inport.HALSensors.HAL_fifo_acce_SI[2].x@ */ /end MEASUREMENT
/begin MEASUREMENT sensor_inport.HALSensors.HAL_fifo_acce_SI[2].y "" FLOAT32_IEEE flightControlSystem_CM_single 0 0 -3.4E+38 3.4E+38 ECU_ADDRESS 0x0000 /* @ECU_Address@sensor_inport.HALSensors.HAL_fifo_acce_SI[2].y@ */ /end MEASUREMENT
/begin MEASUREMENT sensor_inport.HALSensors.HAL_fifo_acce_SI[2].z "" FLOAT32_IEEE flightControlSystem_CM_single 0 0 -3.4E+38 3.4E+38 ECU_ADDRESS 0x0000 /* @ECU_Address@sensor_inport.HALSensors.HAL_fifo_acce_SI[2].z@ */ /end MEASUREMENT
/begin MEASUREMENT sensor_inport.HALSensors.HAL_fifo_acce_SI[3].x "" FLOAT32_IEEE flightControlSystem_CM_single 0 0 -3.4E+38 3.4E+38 ECU_ADDRESS 0x0000 /* @ECU_Address@sensor_inport.HALSensors.HAL_fifo_acce_SI[3].x@ */ /end MEASUREMENT
/begin MEASUREMENT sensor_inport.HALSensors.HAL_fifo_acce_SI[3].y "" FLOAT32_IEEE flightControlSystem_CM_single 0 0 -3.4E+38 3.4E+38 ECU_ADDRESS 0x0000 /* @ECU_Address@sensor_inport.HALSensors.HAL_fifo_acce_SI[3].y@ */ /end MEASUREMENT
/begin MEASUREMENT sensor_inport.HALSensors.HAL_fifo_acce_SI[3].z "" FLOAT32_IEEE flightControlSystem_CM_single 0 0 -3.4E+38 3.4E+38 ECU_ADDRESS 0x0000 /* @ECU_Address@sensor_inport.HALSensors.HAL_fifo_acce_SI[3].z@ */ /end MEASUREMENT
/begin MEASUREMENT sensor_inport.HALSensors.HAL_fifo_acce_SI[4].x "" FLOAT32_IEEE flightControlSystem_CM_single 0 0 -3.4E+38 3.4E+38 ECU_ADDRESS 0x0000 /* @ECU_Address@sensor_inport.HALSensors.HAL_fifo_acce_SI[4].x@ */ /end MEASUREMENT
/begin MEASUREMENT sensor_inport.HALSensors.HAL_fifo_acce_SI[4].y "" FLOAT32_IEEE flightControlSystem_CM_single 0 0 -3.4E+38 3.4E+38 ECU_ADDRESS 0x0000 /* @ECU_Address@sensor_inport.HALSensors.HAL_fifo_acce_SI[4].y@ */ /end MEASUREMENT
/begin MEASUREMENT sensor_inport.HALSensors.HAL_fifo_acce_SI[4].z "" FLOAT32_IEEE flightControlSystem_CM_single 0 0 -3.4E+38 3.4E+38 ECU_ADDRESS 0x0000 /* @ECU_Address@sensor_inport.HALSensors.HAL_fifo_acce_SI[4].z@ */ /end MEASUREMENT
/begin MEASUREMENT sensor_inport.HALSensors.HAL_ref_IMU_temp "" FLOAT32_IEEE flightControlSystem_CM_single 0 0 -3.4E+38 3.4E+38 ECU_ADDRESS 0x0000 /* @ECU_Address@sensor_inport.HALSensors.HAL_ref_IMU_temp@ */ /end MEASUREMENT
/begin MEASUREMENT sensor_inport.HALSensors.HAL_fifo_fsync "" UBYTE flightControlSystem_CM_uint8 0 0 0 255 ARRAY_SIZE 5 ECU_ADDRESS 0x0000 /* @ECU_Address@sensor_inport.HALSensors.HAL_fifo_fsync@ */ /end MEASUREMENT
/begin MEASUREMENT sensor_inport.HALSensors.HAL_fifo_size "" SLONG flightControlSystem_CM_int32 0 0 -2147483648 2147483647 ECU_ADDRESS 0x0000 /* @ECU_Address@sensor_inport.HALSensors.HAL_fifo_size@ */ /end MEASUREMENT
/begin MEASUREMENT sensor_inport.HALSensors.HAL_magn_mG.x "" FLOAT32_IEEE flightControlSystem_CM_single 0 0 -3.4E+38 3.4E+38 ECU_ADDRESS 0x0000 /* @ECU_Address@sensor_inport.HALSensors.HAL_magn_mG.x@ */ /end MEASUREMENT
/begin MEASUREMENT sensor_inport.HALSensors.HAL_magn_mG.y "" FLOAT32_IEEE flightControlSystem_CM_single 0 0 -3.4E+38 3.4E+38 ECU_ADDRESS 0x0000 /* @ECU_Address@sensor_inport.HALSensors.HAL_magn_mG.y@ */ /end MEASUREMENT
/begin MEASUREMENT sensor_inport.HALSensors.HAL_magn_mG.z "" FLOAT32_IEEE flightControlSystem_CM_single 0 0 -3.4E+38 3.4E+38 ECU_ADDRESS 0x0000 /* @ECU_Address@sensor_inport.HALSensors.HAL_magn_mG.z@ */ /end MEASUREMENT
/begin MEASUREMENT sensor_inport.HALSensors.HAL_pressure_SI.temperature "" FLOAT64_IEEE flightControlSystem_CM_double 0 0 -1.7E+308 1.7E+308 ECU_ADDRESS 0x0000 /* @ECU_Address@sensor_inport.HALSensors.HAL_pressure_SI.temperature@ */ /end MEASUREMENT
/begin MEASUREMENT sensor_inport.HALSensors.HAL_pressure_SI.pressure "" FLOAT32_IEEE flightControlSystem_CM_single 0 0 -3.4E+38 3.4E+38 ECU_ADDRESS 0x0000 /* @ECU_Address@sensor_inport.HALSensors.HAL_pressure_SI.pressure@ */ /end MEASUREMENT
/begin MEASUREMENT sensor_inport.HALSensors.HAL_ultrasound_SI.altitude "" FLOAT32_IEEE flightControlSystem_CM_single 0 0 -3.4E+38 3.4E+38 ECU_ADDRESS 0x0000 /* @ECU_Address@sensor_inport.HALSensors.HAL_ultrasound_SI.altitude@ */ /end MEASUREMENT
/begin MEASUREMENT sensor_inport.HALSensors.HAL_ultrasound_SI.raw_altitude "" FLOAT32_IEEE flightControlSystem_CM_single 0 0 -3.4E+38 3.4E+38 ECU_ADDRESS 0x0000 /* @ECU_Address@sensor_inport.HALSensors.HAL_ultrasound_SI.raw_altitude@ */ /end MEASUREMENT
/begin MEASUREMENT sensor_inport.HALSensors.HAL_ultrasound_SI.nb_echo "" UWORD flightControlSystem_CM_uint16 0 0 0 65535 ECU_ADDRESS 0x0000 /* @ECU_Address@sensor_inport.HALSensors.HAL_ultrasound_SI.nb_echo@ */ /end MEASUREMENT
/begin MEASUREMENT sensor_inport.HALSensors.HAL_ultrasound_SI.measure_ref "" SLONG flightControlSystem_CM_int32 0 0 -2147483648 2147483647 ECU_ADDRESS 0x0000 /* @ECU_Address@sensor_inport.HALSensors.HAL_ultrasound_SI.measure_ref@ */ /end MEASUREMENT
/begin MEASUREMENT sensor_inport.HALSensors.HAL_ultrasound_SI.measure_status "" SLONG flightControlSystem_CM_int32 0 0 -2147483648 2147483647 ECU_ADDRESS 0x0000 /* @ECU_Address@sensor_inport.HALSensors.HAL_ultrasound_SI.measure_status@ */ /end MEASUREMENT
/begin MEASUREMENT sensor_inport.HALSensors.HAL_ultrasound_SI.new_data "" UBYTE flightControlSystem_CM_uint8 0 0 0 255 ECU_ADDRESS 0x0000 /* @ECU_Address@sensor_inport.HALSensors.HAL_ultrasound_SI.new_data@ */ /end MEASUREMENT
/begin MEASUREMENT sensor_inport.HALSensors.HAL_ultrasound_SI.HAL_list_echo.tab_echo[0].begin_echo_index "" UWORD flightControlSystem_CM_uint16 0 0 0 65535 ECU_ADDRESS 0x0000 /* @ECU_Address@sensor_inport.HALSensors.HAL_ultrasound_SI.HAL_list_echo.tab_echo[0].begin_echo_index@ */ /end MEASUREMENT
/begin MEASUREMENT sensor_inport.HALSensors.HAL_ultrasound_SI.HAL_list_echo.tab_echo[0].end_echo_index "" UWORD flightControlSystem_CM_uint16 0 0 0 65535 ECU_ADDRESS 0x0000 /* @ECU_Address@sensor_inport.HALSensors.HAL_ultrasound_SI.HAL_list_echo.tab_echo[0].end_echo_index@ */ /end MEASUREMENT
/begin MEASUREMENT sensor_inport.HALSensors.HAL_ultrasound_SI.HAL_list_echo.tab_echo[0].max_value_index "" SWORD flightControlSystem_CM_int16 0 0 -32768 32767 ECU_ADDRESS 0x0000 /* @ECU_Address@sensor_inport.HALSensors.HAL_ultrasound_SI.HAL_list_echo.tab_echo[0].max_value_index@ */ /end MEASUREMENT
/begin MEASUREMENT sensor_inport.HALSensors.HAL_ultrasound_SI.HAL_list_echo.tab_echo[0].max_value "" SLONG flightControlSystem_CM_int32 0 0 -2147483648 2147483647 ECU_ADDRESS 0x0000 /* @ECU_Address@sensor_inport.HALSensors.HAL_ultrasound_SI.HAL_list_echo.tab_echo[0].max_value@ */ /end MEASUREMENT
/begin MEASUREMENT sensor_inport.HALSensors.HAL_ultrasound_SI.HAL_list_echo.tab_echo[0].precedent "" UWORD flightControlSystem_CM_uint16 0 0 0 65535 ECU_ADDRESS 0x0000 /* @ECU_Address@sensor_inport.HALSensors.HAL_ultrasound_SI.HAL_list_echo.tab_echo[0].precedent@ */ /end MEASUREMENT
/begin MEASUREMENT sensor_inport.HALSensors.HAL_ultrasound_SI.HAL_list_echo.tab_echo[0].d_echo "" SWORD flightControlSystem_CM_int16 0 0 -32768 32767 ECU_ADDRESS 0x0000 /* @ECU_Address@sensor_inport.HALSensors.HAL_ultrasound_SI.HAL_list_echo.tab_echo[0].d_echo@ */ /end MEASUREMENT
/begin MEASUREMENT sensor_inport.HALSensors.HAL_ultrasound_SI.HAL_list_echo.tab_echo[0].pre_max_index "" UWORD flightControlSystem_CM_uint16 0 0 0 65535 ECU_ADDRESS 0x0000 /* @ECU_Address@sensor_inport.HALSensors.HAL_ultrasound_SI.HAL_list_echo.tab_echo[0].pre_max_index@ */ /end MEASUREMENT
/begin MEASUREMENT sensor_inport.HALSensors.HAL_ultrasound_SI.HAL_list_echo.tab_echo[1].begin_echo_index "" UWORD flightControlSystem_CM_uint16 0 0 0 65535 ECU_ADDRESS 0x0000 /* @ECU_Address@sensor_inport.HALSensors.HAL_ultrasound_SI.HAL_list_echo.tab_echo[1].begin_echo_index@ */ /end MEASUREMENT
/begin MEASUREMENT sensor_inport.HALSensors.HAL_ultrasound_SI.HAL_list_echo.tab_echo[1].end_echo_index "" UWORD flightControlSystem_CM_uint16 0 0 0 65535 ECU_ADDRESS 0x0000 /* @ECU_Address@sensor_inport.HALSensors.HAL_ultrasound_SI.HAL_list_echo.tab_echo[1].end_echo_index@ */ /end MEASUREMENT
/begin MEASUREMENT sensor_inport.HALSensors.HAL_ultrasound_SI.HAL_list_echo.tab_echo[1].max_value_index "" SWORD flightControlSystem_CM_int16 0 0 -32768 32767 ECU_ADDRESS 0x0000 /* @ECU_Address@sensor_inport.HALSensors.HAL_ultrasound_SI.HAL_list_echo.tab_echo[1].max_value_index@ */ /end MEASUREMENT
/begin MEASUREMENT sensor_inport.HALSensors.HAL_ultrasound_SI.HAL_list_echo.tab_echo[1].max_value "" SLONG flightControlSystem_CM_int32 0 0 -2147483648 2147483647 ECU_ADDRESS 0x0000 /* @ECU_Address@sensor_inport.HALSensors.HAL_ultrasound_SI.HAL_list_echo.tab_echo[1].max_value@ */ /end MEASUREMENT
/begin MEASUREMENT sensor_inport.HALSensors.HAL_ultrasound_SI.HAL_list_echo.tab_echo[1].precedent "" UWORD flightControlSystem_CM_uint16 0 0 0 65535 ECU_ADDRESS 0x0000 /* @ECU_Address@sensor_inport.HALSensors.HAL_ultrasound_SI.HAL_list_echo.tab_echo[1].precedent@ */ /end MEASUREMENT
/begin MEASUREMENT sensor_inport.HALSensors.HAL_ultrasound_SI.HAL_list_echo.tab_echo[1].d_echo "" SWORD flightControlSystem_CM_int16 0 0 -32768 32767 ECU_ADDRESS 0x0000 /* @ECU_Address@sensor_inport.HALSensors.HAL_ultrasound_SI.HAL_list_echo.tab_echo[1].d_echo@ */ /end MEASUREMENT
/begin MEASUREMENT sensor_inport.HALSensors.HAL_ultrasound_SI.HAL_list_echo.tab_echo[1].pre_max_index "" UWORD flightControlSystem_CM_uint16 0 0 0 65535 ECU_ADDRESS 0x0000 /* @ECU_Address@sensor_inport.HALSensors.HAL_ultrasound_SI.HAL_list_echo.tab_echo[1].pre_max_index@ */ /end MEASUREMENT
/begin MEASUREMENT sensor_inport.HALSensors.HAL_ultrasound_SI.HAL_list_echo.tab_echo[2].begin_echo_index "" UWORD flightControlSystem_CM_uint16 0 0 0 65535 ECU_ADDRESS 0x0000 /* @ECU_Address@sensor_inport.HALSensors.HAL_ultrasound_SI.HAL_list_echo.tab_echo[2].begin_echo_index@ */ /end MEASUREMENT
/begin MEASUREMENT sensor_inport.HALSensors.HAL_ultrasound_SI.HAL_list_echo.tab_echo[2].end_echo_index "" UWORD flightControlSystem_CM_uint16 0 0 0 65535 ECU_ADDRESS 0x0000 /* @ECU_Address@sensor_inport.HALSensors.HAL_ultrasound_SI.HAL_list_echo.tab_echo[2].end_echo_index@ */ /end MEASUREMENT
/begin MEASUREMENT sensor_inport.HALSensors.HAL_ultrasound_SI.HAL_list_echo.tab_echo[2].max_value_index "" SWORD flightControlSystem_CM_int16 0 0 -32768 32767 ECU_ADDRESS 0x0000 /* @ECU_Address@sensor_inport.HALSensors.HAL_ultrasound_SI.HAL_list_echo.tab_echo[2].max_value_index@ */ /end MEASUREMENT
/begin MEASUREMENT sensor_inport.HALSensors.HAL_ultrasound_SI.HAL_list_echo.tab_echo[2].max_value "" SLONG flightControlSystem_CM_int32 0 0 -2147483648 2147483647 ECU_ADDRESS 0x0000 /* @ECU_Address@sensor_inport.HALSensors.HAL_ultrasound_SI.HAL_list_echo.tab_echo[2].max_value@ */ /end MEASUREMENT
/begin MEASUREMENT sensor_inport.HALSensors.HAL_ultrasound_SI.HAL_list_echo.tab_echo[2].precedent "" UWORD flightControlSystem_CM_uint16 0 0 0 65535 ECU_ADDRESS 0x0000 /* @ECU_Address@sensor_inport.HALSensors.HAL_ultrasound_SI.HAL_list_echo.tab_echo[2].precedent@ */ /end MEASUREMENT
/begin MEASUREMENT sensor_inport.HALSensors.HAL_ultrasound_SI.HAL_list_echo.tab_echo[2].d_echo "" SWORD flightControlSystem_CM_int16 0 0 -32768 32767 ECU_ADDRESS 0x0000 /* @ECU_Address@sensor_inport.HALSensors.HAL_ultrasound_SI.HAL_list_echo.tab_echo[2].d_echo@ */ /end MEASUREMENT
/begin MEASUREMENT sensor_inport.HALSensors.HAL_ultrasound_SI.HAL_list_echo.tab_echo[2].pre_max_index "" UWORD flightControlSystem_CM_uint16 0 0 0 65535 ECU_ADDRESS 0x0000 /* @ECU_Address@sensor_inport.HALSensors.HAL_ultrasound_SI.HAL_list_echo.tab_echo[2].pre_max_index@ */ /end MEASUREMENT
/begin MEASUREMENT sensor_inport.HALSensors.HAL_ultrasound_SI.HAL_list_echo.tab_echo[3].begin_echo_index "" UWORD flightControlSystem_CM_uint16 0 0 0 65535 ECU_ADDRESS 0x0000 /* @ECU_Address@sensor_inport.HALSensors.HAL_ultrasound_SI.HAL_list_echo.tab_echo[3].begin_echo_index@ */ /end MEASUREMENT
/begin MEASUREMENT sensor_inport.HALSensors.HAL_ultrasound_SI.HAL_list_echo.tab_echo[3].end_echo_index "" UWORD flightControlSystem_CM_uint16 0 0 0 65535 ECU_ADDRESS 0x0000 /* @ECU_Address@sensor_inport.HALSensors.HAL_ultrasound_SI.HAL_list_echo.tab_echo[3].end_echo_index@ */ /end MEASUREMENT
/begin MEASUREMENT sensor_inport.HALSensors.HAL_ultrasound_SI.HAL_list_echo.tab_echo[3].max_value_index "" SWORD flightControlSystem_CM_int16 0 0 -32768 32767 ECU_ADDRESS 0x0000 /* @ECU_Address@sensor_inport.HALSensors.HAL_ultrasound_SI.HAL_list_echo.tab_echo[3].max_value_index@ */ /end MEASUREMENT
/begin MEASUREMENT sensor_inport.HALSensors.HAL_ultrasound_SI.HAL_list_echo.tab_echo[3].max_value "" SLONG flightControlSystem_CM_int32 0 0 -2147483648 2147483647 ECU_ADDRESS 0x0000 /* @ECU_Address@sensor_inport.HALSensors.HAL_ultrasound_SI.HAL_list_echo.tab_echo[3].max_value@ */ /end MEASUREMENT
/begin MEASUREMENT sensor_inport.HALSensors.HAL_ultrasound_SI.HAL_list_echo.tab_echo[3].precedent "" UWORD flightControlSystem_CM_uint16 0 0 0 65535 ECU_ADDRESS 0x0000 /* @ECU_Address@sensor_inport.HALSensors.HAL_ultrasound_SI.HAL_list_echo.tab_echo[3].precedent@ */ /end MEASUREMENT
/begin MEASUREMENT sensor_inport.HALSensors.HAL_ultrasound_SI.HAL_list_echo.tab_echo[3].d_echo "" SWORD flightControlSystem_CM_int16 0 0 -32768 32767 ECU_ADDRESS 0x0000 /* @ECU_Address@sensor_inport.HALSensors.HAL_ultrasound_SI.HAL_list_echo.tab_echo[3].d_echo@ */ /end MEASUREMENT
/begin MEASUREMENT sensor_inport.HALSensors.HAL_ultrasound_SI.HAL_list_echo.tab_echo[3].pre_max_index "" UWORD flightControlSystem_CM_uint16 0 0 0 65535 ECU_ADDRESS 0x0000 /* @ECU_Address@sensor_inport.HALSensors.HAL_ultrasound_SI.HAL_list_echo.tab_echo[3].pre_max_index@ */ /end MEASUREMENT
/begin MEASUREMENT sensor_inport.HALSensors.HAL_ultrasound_SI.HAL_list_echo.tab_echo[4].begin_echo_index "" UWORD flightControlSystem_CM_uint16 0 0 0 65535 ECU_ADDRESS 0x0000 /* @ECU_Address@sensor_inport.HALSensors.HAL_ultrasound_SI.HAL_list_echo.tab_echo[4].begin_echo_index@ */ /end MEASUREMENT
/begin MEASUREMENT sensor_inport.HALSensors.HAL_ultrasound_SI.HAL_list_echo.tab_echo[4].end_echo_index "" UWORD flightControlSystem_CM_uint16 0 0 0 65535 ECU_ADDRESS 0x0000 /* @ECU_Address@sensor_inport.HALSensors.HAL_ultrasound_SI.HAL_list_echo.tab_echo[4].end_echo_index@ */ /end MEASUREMENT
/begin MEASUREMENT sensor_inport.HALSensors.HAL_ultrasound_SI.HAL_list_echo.tab_echo[4].max_value_index "" SWORD flightControlSystem_CM_int16 0 0 -32768 32767 ECU_ADDRESS 0x0000 /* @ECU_Address@sensor_inport.HALSensors.HAL_ultrasound_SI.HAL_list_echo.tab_echo[4].max_value_index@ */ /end MEASUREMENT
/begin MEASUREMENT sensor_inport.HALSensors.HAL_ultrasound_SI.HAL_list_echo.tab_echo[4].max_value "" SLONG flightControlSystem_CM_int32 0 0 -2147483648 2147483647 ECU_ADDRESS 0x0000 /* @ECU_Address@sensor_inport.HALSensors.HAL_ultrasound_SI.HAL_list_echo.tab_echo[4].max_value@ */ /end MEASUREMENT
/begin MEASUREMENT sensor_inport.HALSensors.HAL_ultrasound_SI.HAL_list_echo.tab_echo[4].precedent "" UWORD flightControlSystem_CM_uint16 0 0 0 65535 ECU_ADDRESS 0x0000 /* @ECU_Address@sensor_inport.HALSensors.HAL_ultrasound_SI.HAL_list_echo.tab_echo[4].precedent@ */ /end MEASUREMENT
/begin MEASUREMENT sensor_inport.HALSensors.HAL_ultrasound_SI.HAL_list_echo.tab_echo[4].d_echo "" SWORD flightControlSystem_CM_int16 0 0 -32768 32767 ECU_ADDRESS 0x0000 /* @ECU_Address@sensor_inport.HALSensors.HAL_ultrasound_SI.HAL_list_echo.tab_echo[4].d_echo@ */ /end MEASUREMENT
/begin MEASUREMENT sensor_inport.HALSensors.HAL_ultrasound_SI.HAL_list_echo.tab_echo[4].pre_max_index "" UWORD flightControlSystem_CM_uint16 0 0 0 65535 ECU_ADDRESS 0x0000 /* @ECU_Address@sensor_inport.HALSensors.HAL_ultrasound_SI.HAL_list_echo.tab_echo[4].pre_max_index@ */ /end MEASUREMENT
/begin MEASUREMENT sensor_inport.HALSensors.HAL_ultrasound_SI.HAL_list_echo.tab_echo[5].begin_echo_index "" UWORD flightControlSystem_CM_uint16 0 0 0 65535 ECU_ADDRESS 0x0000 /* @ECU_Address@sensor_inport.HALSensors.HAL_ultrasound_SI.HAL_list_echo.tab_echo[5].begin_echo_index@ */ /end MEASUREMENT
/begin MEASUREMENT sensor_inport.HALSensors.HAL_ultrasound_SI.HAL_list_echo.tab_echo[5].end_echo_index "" UWORD flightControlSystem_CM_uint16 0 0 0 65535 ECU_ADDRESS 0x0000 /* @ECU_Address@sensor_inport.HALSensors.HAL_ultrasound_SI.HAL_list_echo.tab_echo[5].end_echo_index@ */ /end MEASUREMENT
/begin MEASUREMENT sensor_inport.HALSensors.HAL_ultrasound_SI.HAL_list_echo.tab_echo[5].max_value_index "" SWORD flightControlSystem_CM_int16 0 0 -32768 32767 ECU_ADDRESS 0x0000 /* @ECU_Address@sensor_inport.HALSensors.HAL_ultrasound_SI.HAL_list_echo.tab_echo[5].max_value_index@ */ /end MEASUREMENT
/begin MEASUREMENT sensor_inport.HALSensors.HAL_ultrasound_SI.HAL_list_echo.tab_echo[5].max_value "" SLONG flightControlSystem_CM_int32 0 0 -2147483648 2147483647 ECU_ADDRESS 0x0000 /* @ECU_Address@sensor_inport.HALSensors.HAL_ultrasound_SI.HAL_list_echo.tab_echo[5].max_value@ */ /end MEASUREMENT
/begin MEASUREMENT sensor_inport.HALSensors.HAL_ultrasound_SI.HAL_list_echo.tab_echo[5].precedent "" UWORD flightControlSystem_CM_uint16 0 0 0 65535 ECU_ADDRESS 0x0000 /* @ECU_Address@sensor_inport.HALSensors.HAL_ultrasound_SI.HAL_list_echo.tab_echo[5].precedent@ */ /end MEASUREMENT
/begin MEASUREMENT sensor_inport.HALSensors.HAL_ultrasound_SI.HAL_list_echo.tab_echo[5].d_echo "" SWORD flightControlSystem_CM_int16 0 0 -32768 32767 ECU_ADDRESS 0x0000 /* @ECU_Address@sensor_inport.HALSensors.HAL_ultrasound_SI.HAL_list_echo.tab_echo[5].d_echo@ */ /end MEASUREMENT
/begin MEASUREMENT sensor_inport.HALSensors.HAL_ultrasound_SI.HAL_list_echo.tab_echo[5].pre_max_index "" UWORD flightControlSystem_CM_uint16 0 0 0 65535 ECU_ADDRESS 0x0000 /* @ECU_Address@sensor_inport.HALSensors.HAL_ultrasound_SI.HAL_list_echo.tab_echo[5].pre_max_index@ */ /end MEASUREMENT
/begin MEASUREMENT sensor_inport.HALSensors.HAL_ultrasound_SI.HAL_list_echo.tab_echo[6].begin_echo_index "" UWORD flightControlSystem_CM_uint16 0 0 0 65535 ECU_ADDRESS 0x0000 /* @ECU_Address@sensor_inport.HALSensors.HAL_ultrasound_SI.HAL_list_echo.tab_echo[6].begin_echo_index@ */ /end MEASUREMENT
/begin MEASUREMENT sensor_inport.HALSensors.HAL_ultrasound_SI.HAL_list_echo.tab_echo[6].end_echo_index "" UWORD flightControlSystem_CM_uint16 0 0 0 65535 ECU_ADDRESS 0x0000 /* @ECU_Address@sensor_inport.HALSensors.HAL_ultrasound_SI.HAL_list_echo.tab_echo[6].end_echo_index@ */ /end MEASUREMENT
/begin MEASUREMENT sensor_inport.HALSensors.HAL_ultrasound_SI.HAL_list_echo.tab_echo[6].max_value_index "" SWORD flightControlSystem_CM_int16 0 0 -32768 32767 ECU_ADDRESS 0x0000 /* @ECU_Address@sensor_inport.HALSensors.HAL_ultrasound_SI.HAL_list_echo.tab_echo[6].max_value_index@ */ /end MEASUREMENT
/begin MEASUREMENT sensor_inport.HALSensors.HAL_ultrasound_SI.HAL_list_echo.tab_echo[6].max_value "" SLONG flightControlSystem_CM_int32 0 0 -2147483648 2147483647 ECU_ADDRESS 0x0000 /* @ECU_Address@sensor_inport.HALSensors.HAL_ultrasound_SI.HAL_list_echo.tab_echo[6].max_value@ */ /end MEASUREMENT
/begin MEASUREMENT sensor_inport.HALSensors.HAL_ultrasound_SI.HAL_list_echo.tab_echo[6].precedent "" UWORD flightControlSystem_CM_uint16 0 0 0 65535 ECU_ADDRESS 0x0000 /* @ECU_Address@sensor_inport.HALSensors.HAL_ultrasound_SI.HAL_list_echo.tab_echo[6].precedent@ */ /end MEASUREMENT
/begin MEASUREMENT sensor_inport.HALSensors.HAL_ultrasound_SI.HAL_list_echo.tab_echo[6].d_echo "" SWORD flightControlSystem_CM_int16 0 0 -32768 32767 ECU_ADDRESS 0x0000 /* @ECU_Address@sensor_inport.HALSensors.HAL_ultrasound_SI.HAL_list_echo.tab_echo[6].d_echo@ */ /end MEASUREMENT
/begin MEASUREMENT sensor_inport.HALSensors.HAL_ultrasound_SI.HAL_list_echo.tab_echo[6].pre_max_index "" UWORD flightControlSystem_CM_uint16 0 0 0 65535 ECU_ADDRESS 0x0000 /* @ECU_Address@sensor_inport.HALSensors.HAL_ultrasound_SI.HAL_list_echo.tab_echo[6].pre_max_index@ */ /end MEASUREMENT
/begin MEASUREMENT sensor_inport.HALSensors.HAL_ultrasound_SI.HAL_list_echo.tab_echo[7].begin_echo_index "" UWORD flightControlSystem_CM_uint16 0 0 0 65535 ECU_ADDRESS 0x0000 /* @ECU_Address@sensor_inport.HALSensors.HAL_ultrasound_SI.HAL_list_echo.tab_echo[7].begin_echo_index@ */ /end MEASUREMENT
/begin MEASUREMENT sensor_inport.HALSensors.HAL_ultrasound_SI.HAL_list_echo.tab_echo[7].end_echo_index "" UWORD flightControlSystem_CM_uint16 0 0 0 65535 ECU_ADDRESS 0x0000 /* @ECU_Address@sensor_inport.HALSensors.HAL_ultrasound_SI.HAL_list_echo.tab_echo[7].end_echo_index@ */ /end MEASUREMENT
/begin MEASUREMENT sensor_inport.HALSensors.HAL_ultrasound_SI.HAL_list_echo.tab_echo[7].max_value_index "" SWORD flightControlSystem_CM_int16 0 0 -32768 32767 ECU_ADDRESS 0x0000 /* @ECU_Address@sensor_inport.HALSensors.HAL_ultrasound_SI.HAL_list_echo.tab_echo[7].max_value_index@ */ /end MEASUREMENT
/begin MEASUREMENT sensor_inport.HALSensors.HAL_ultrasound_SI.HAL_list_echo.tab_echo[7].max_value "" SLONG flightControlSystem_CM_int32 0 0 -2147483648 2147483647 ECU_ADDRESS 0x0000 /* @ECU_Address@sensor_inport.HALSensors.HAL_ultrasound_SI.HAL_list_echo.tab_echo[7].max_value@ */ /end MEASUREMENT
/begin MEASUREMENT sensor_inport.HALSensors.HAL_ultrasound_SI.HAL_list_echo.tab_echo[7].precedent "" UWORD flightControlSystem_CM_uint16 0 0 0 65535 ECU_ADDRESS 0x0000 /* @ECU_Address@sensor_inport.HALSensors.HAL_ultrasound_SI.HAL_list_echo.tab_echo[7].precedent@ */ /end MEASUREMENT
/begin MEASUREMENT sensor_inport.HALSensors.HAL_ultrasound_SI.HAL_list_echo.tab_echo[7].d_echo "" SWORD flightControlSystem_CM_int16 0 0 -32768 32767 ECU_ADDRESS 0x0000 /* @ECU_Address@sensor_inport.HALSensors.HAL_ultrasound_SI.HAL_list_echo.tab_echo[7].d_echo@ */ /end MEASUREMENT
/begin MEASUREMENT sensor_inport.HALSensors.HAL_ultrasound_SI.HAL_list_echo.tab_echo[7].pre_max_index "" UWORD flightControlSystem_CM_uint16 0 0 0 65535 ECU_ADDRESS 0x0000 /* @ECU_Address@sensor_inport.HALSensors.HAL_ultrasound_SI.HAL_list_echo.tab_echo[7].pre_max_index@ */ /end MEASUREMENT
/begin MEASUREMENT sensor_inport.HALSensors.HAL_ultrasound_SI.HAL_list_echo.tab_echo[8].begin_echo_index "" UWORD flightControlSystem_CM_uint16 0 0 0 65535 ECU_ADDRESS 0x0000 /* @ECU_Address@sensor_inport.HALSensors.HAL_ultrasound_SI.HAL_list_echo.tab_echo[8].begin_echo_index@ */ /end MEASUREMENT
/begin MEASUREMENT sensor_inport.HALSensors.HAL_ultrasound_SI.HAL_list_echo.tab_echo[8].end_echo_index "" UWORD flightControlSystem_CM_uint16 0 0 0 65535 ECU_ADDRESS 0x0000 /* @ECU_Address@sensor_inport.HALSensors.HAL_ultrasound_SI.HAL_list_echo.tab_echo[8].end_echo_index@ */ /end MEASUREMENT
/begin MEASUREMENT sensor_inport.HALSensors.HAL_ultrasound_SI.HAL_list_echo.tab_echo[8].max_value_index "" SWORD flightControlSystem_CM_int16 0 0 -32768 32767 ECU_ADDRESS 0x0000 /* @ECU_Address@sensor_inport.HALSensors.HAL_ultrasound_SI.HAL_list_echo.tab_echo[8].max_value_index@ */ /end MEASUREMENT
/begin MEASUREMENT sensor_inport.HALSensors.HAL_ultrasound_SI.HAL_list_echo.tab_echo[8].max_value "" SLONG flightControlSystem_CM_int32 0 0 -2147483648 2147483647 ECU_ADDRESS 0x0000 /* @ECU_Address@sensor_inport.HALSensors.HAL_ultrasound_SI.HAL_list_echo.tab_echo[8].max_value@ */ /end MEASUREMENT
/begin MEASUREMENT sensor_inport.HALSensors.HAL_ultrasound_SI.HAL_list_echo.tab_echo[8].precedent "" UWORD flightControlSystem_CM_uint16 0 0 0 65535 ECU_ADDRESS 0x0000 /* @ECU_Address@sensor_inport.HALSensors.HAL_ultrasound_SI.HAL_list_echo.tab_echo[8].precedent@ */ /end MEASUREMENT
/begin MEASUREMENT sensor_inport.HALSensors.HAL_ultrasound_SI.HAL_list_echo.tab_echo[8].d_echo "" SWORD flightControlSystem_CM_int16 0 0 -32768 32767 ECU_ADDRESS 0x0000 /* @ECU_Address@sensor_inport.HALSensors.HAL_ultrasound_SI.HAL_list_echo.tab_echo[8].d_echo@ */ /end MEASUREMENT
/begin MEASUREMENT sensor_inport.HALSensors.HAL_ultrasound_SI.HAL_list_echo.tab_echo[8].pre_max_index "" UWORD flightControlSystem_CM_uint16 0 0 0 65535 ECU_ADDRESS 0x0000 /* @ECU_Address@sensor_inport.HALSensors.HAL_ultrasound_SI.HAL_list_echo.tab_echo[8].pre_max_index@ */ /end MEASUREMENT
/begin MEASUREMENT sensor_inport.HALSensors.HAL_ultrasound_SI.HAL_list_echo.tab_echo[9].begin_echo_index "" UWORD flightControlSystem_CM_uint16 0 0 0 65535 ECU_ADDRESS 0x0000 /* @ECU_Address@sensor_inport.HALSensors.HAL_ultrasound_SI.HAL_list_echo.tab_echo[9].begin_echo_index@ */ /end MEASUREMENT
/begin MEASUREMENT sensor_inport.HALSensors.HAL_ultrasound_SI.HAL_list_echo.tab_echo[9].end_echo_index "" UWORD flightControlSystem_CM_uint16 0 0 0 65535 ECU_ADDRESS 0x0000 /* @ECU_Address@sensor_inport.HALSensors.HAL_ultrasound_SI.HAL_list_echo.tab_echo[9].end_echo_index@ */ /end MEASUREMENT
/begin MEASUREMENT sensor_inport.HALSensors.HAL_ultrasound_SI.HAL_list_echo.tab_echo[9].max_value_index "" SWORD flightControlSystem_CM_int16 0 0 -32768 32767 ECU_ADDRESS 0x0000 /* @ECU_Address@sensor_inport.HALSensors.HAL_ultrasound_SI.HAL_list_echo.tab_echo[9].max_value_index@ */ /end MEASUREMENT
/begin MEASUREMENT sensor_inport.HALSensors.HAL_ultrasound_SI.HAL_list_echo.tab_echo[9].max_value "" SLONG flightControlSystem_CM_int32 0 0 -2147483648 2147483647 ECU_ADDRESS 0x0000 /* @ECU_Address@sensor_inport.HALSensors.HAL_ultrasound_SI.HAL_list_echo.tab_echo[9].max_value@ */ /end MEASUREMENT
/begin MEASUREMENT sensor_inport.HALSensors.HAL_ultrasound_SI.HAL_list_echo.tab_echo[9].precedent "" UWORD flightControlSystem_CM_uint16 0 0 0 65535 ECU_ADDRESS 0x0000 /* @ECU_Address@sensor_inport.HALSensors.HAL_ultrasound_SI.HAL_list_echo.tab_echo[9].precedent@ */ /end MEASUREMENT
/begin MEASUREMENT sensor_inport.HALSensors.HAL_ultrasound_SI.HAL_list_echo.tab_echo[9].d_echo "" SWORD flightControlSystem_CM_int16 0 0 -32768 32767 ECU_ADDRESS 0x0000 /* @ECU_Address@sensor_inport.HALSensors.HAL_ultrasound_SI.HAL_list_echo.tab_echo[9].d_echo@ */ /end MEASUREMENT
/begin MEASUREMENT sensor_inport.HALSensors.HAL_ultrasound_SI.HAL_list_echo.tab_echo[9].pre_max_index "" UWORD flightControlSystem_CM_uint16 0 0 0 65535 ECU_ADDRESS 0x0000 /* @ECU_Address@sensor_inport.HALSensors.HAL_ultrasound_SI.HAL_list_echo.tab_echo[9].pre_max_index@ */ /end MEASUREMENT
/begin MEASUREMENT sensor_inport.HALSensors.HAL_ultrasound_SI.HAL_list_echo.tab_echo[10].begin_echo_index "" UWORD flightControlSystem_CM_uint16 0 0 0 65535 ECU_ADDRESS 0x0000 /* @ECU_Address@sensor_inport.HALSensors.HAL_ultrasound_SI.HAL_list_echo.tab_echo[10].begin_echo_index@ */ /end MEASUREMENT
/begin MEASUREMENT sensor_inport.HALSensors.HAL_ultrasound_SI.HAL_list_echo.tab_echo[10].end_echo_index "" UWORD flightControlSystem_CM_uint16 0 0 0 65535 ECU_ADDRESS 0x0000 /* @ECU_Address@sensor_inport.HALSensors.HAL_ultrasound_SI.HAL_list_echo.tab_echo[10].end_echo_index@ */ /end MEASUREMENT
/begin MEASUREMENT sensor_inport.HALSensors.HAL_ultrasound_SI.HAL_list_echo.tab_echo[10].max_value_index "" SWORD flightControlSystem_CM_int16 0 0 -32768 32767 ECU_ADDRESS 0x0000 /* @ECU_Address@sensor_inport.HALSensors.HAL_ultrasound_SI.HAL_list_echo.tab_echo[10].max_value_index@ */ /end MEASUREMENT
/begin MEASUREMENT sensor_inport.HALSensors.HAL_ultrasound_SI.HAL_list_echo.tab_echo[10].max_value "" SLONG flightControlSystem_CM_int32 0 0 -2147483648 2147483647 ECU_ADDRESS 0x0000 /* @ECU_Address@sensor_inport.HALSensors.HAL_ultrasound_SI.HAL_list_echo.tab_echo[10].max_value@ */ /end MEASUREMENT
/begin MEASUREMENT sensor_inport.HALSensors.HAL_ultrasound_SI.HAL_list_echo.tab_echo[10].precedent "" UWORD flightControlSystem_CM_uint16 0 0 0 65535 ECU_ADDRESS 0x0000 /* @ECU_Address@sensor_inport.HALSensors.HAL_ultrasound_SI.HAL_list_echo.tab_echo[10].precedent@ */ /end MEASUREMENT
/begin MEASUREMENT sensor_inport.HALSensors.HAL_ultrasound_SI.HAL_list_echo.tab_echo[10].d_echo "" SWORD flightControlSystem_CM_int16 0 0 -32768 32767 ECU_ADDRESS 0x0000 /* @ECU_Address@sensor_inport.HALSensors.HAL_ultrasound_SI.HAL_list_echo.tab_echo[10].d_echo@ */ /end MEASUREMENT
/begin MEASUREMENT sensor_inport.HALSensors.HAL_ultrasound_SI.HAL_list_echo.tab_echo[10].pre_max_index "" UWORD flightControlSystem_CM_uint16 0 0 0 65535 ECU_ADDRESS 0x0000 /* @ECU_Address@sensor_inport.HALSensors.HAL_ultrasound_SI.HAL_list_echo.tab_echo[10].pre_max_index@ */ /end MEASUREMENT
/begin MEASUREMENT sensor_inport.HALSensors.HAL_ultrasound_SI.HAL_list_echo.tab_echo[11].begin_echo_index "" UWORD flightControlSystem_CM_uint16 0 0 0 65535 ECU_ADDRESS 0x0000 /* @ECU_Address@sensor_inport.HALSensors.HAL_ultrasound_SI.HAL_list_echo.tab_echo[11].begin_echo_index@ */ /end MEASUREMENT
/begin MEASUREMENT sensor_inport.HALSensors.HAL_ultrasound_SI.HAL_list_echo.tab_echo[11].end_echo_index "" UWORD flightControlSystem_CM_uint16 0 0 0 65535 ECU_ADDRESS 0x0000 /* @ECU_Address@sensor_inport.HALSensors.HAL_ultrasound_SI.HAL_list_echo.tab_echo[11].end_echo_index@ */ /end MEASUREMENT
/begin MEASUREMENT sensor_inport.HALSensors.HAL_ultrasound_SI.HAL_list_echo.tab_echo[11].max_value_index "" SWORD flightControlSystem_CM_int16 0 0 -32768 32767 ECU_ADDRESS 0x0000 /* @ECU_Address@sensor_inport.HALSensors.HAL_ultrasound_SI.HAL_list_echo.tab_echo[11].max_value_index@ */ /end MEASUREMENT
/begin MEASUREMENT sensor_inport.HALSensors.HAL_ultrasound_SI.HAL_list_echo.tab_echo[11].max_value "" SLONG flightControlSystem_CM_int32 0 0 -2147483648 2147483647 ECU_ADDRESS 0x0000 /* @ECU_Address@sensor_inport.HALSensors.HAL_ultrasound_SI.HAL_list_echo.tab_echo[11].max_value@ */ /end MEASUREMENT
/begin MEASUREMENT sensor_inport.HALSensors.HAL_ultrasound_SI.HAL_list_echo.tab_echo[11].precedent "" UWORD flightControlSystem_CM_uint16 0 0 0 65535 ECU_ADDRESS 0x0000 /* @ECU_Address@sensor_inport.HALSensors.HAL_ultrasound_SI.HAL_list_echo.tab_echo[11].precedent@ */ /end MEASUREMENT
/begin MEASUREMENT sensor_inport.HALSensors.HAL_ultrasound_SI.HAL_list_echo.tab_echo[11].d_echo "" SWORD flightControlSystem_CM_int16 0 0 -32768 32767 ECU_ADDRESS 0x0000 /* @ECU_Address@sensor_inport.HALSensors.HAL_ultrasound_SI.HAL_list_echo.tab_echo[11].d_echo@ */ /end MEASUREMENT
/begin MEASUREMENT sensor_inport.HALSensors.HAL_ultrasound_SI.HAL_list_echo.tab_echo[11].pre_max_index "" UWORD flightControlSystem_CM_uint16 0 0 0 65535 ECU_ADDRESS 0x0000 /* @ECU_Address@sensor_inport.HALSensors.HAL_ultrasound_SI.HAL_list_echo.tab_echo[11].pre_max_index@ */ /end MEASUREMENT
/begin MEASUREMENT sensor_inport.HALSensors.HAL_ultrasound_SI.HAL_list_echo.tab_echo[12].begin_echo_index "" UWORD flightControlSystem_CM_uint16 0 0 0 65535 ECU_ADDRESS 0x0000 /* @ECU_Address@sensor_inport.HALSensors.HAL_ultrasound_SI.HAL_list_echo.tab_echo[12].begin_echo_index@ */ /end MEASUREMENT
/begin MEASUREMENT sensor_inport.HALSensors.HAL_ultrasound_SI.HAL_list_echo.tab_echo[12].end_echo_index "" UWORD flightControlSystem_CM_uint16 0 0 0 65535 ECU_ADDRESS 0x0000 /* @ECU_Address@sensor_inport.HALSensors.HAL_ultrasound_SI.HAL_list_echo.tab_echo[12].end_echo_index@ */ /end MEASUREMENT
/begin MEASUREMENT sensor_inport.HALSensors.HAL_ultrasound_SI.HAL_list_echo.tab_echo[12].max_value_index "" SWORD flightControlSystem_CM_int16 0 0 -32768 32767 ECU_ADDRESS 0x0000 /* @ECU_Address@sensor_inport.HALSensors.HAL_ultrasound_SI.HAL_list_echo.tab_echo[12].max_value_index@ */ /end MEASUREMENT
/begin MEASUREMENT sensor_inport.HALSensors.HAL_ultrasound_SI.HAL_list_echo.tab_echo[12].max_value "" SLONG flightControlSystem_CM_int32 0 0 -2147483648 2147483647 ECU_ADDRESS 0x0000 /* @ECU_Address@sensor_inport.HALSensors.HAL_ultrasound_SI.HAL_list_echo.tab_echo[12].max_value@ */ /end MEASUREMENT
/begin MEASUREMENT sensor_inport.HALSensors.HAL_ultrasound_SI.HAL_list_echo.tab_echo[12].precedent "" UWORD flightControlSystem_CM_uint16 0 0 0 65535 ECU_ADDRESS 0x0000 /* @ECU_Address@sensor_inport.HALSensors.HAL_ultrasound_SI.HAL_list_echo.tab_echo[12].precedent@ */ /end MEASUREMENT
/begin MEASUREMENT sensor_inport.HALSensors.HAL_ultrasound_SI.HAL_list_echo.tab_echo[12].d_echo "" SWORD flightControlSystem_CM_int16 0 0 -32768 32767 ECU_ADDRESS 0x0000 /* @ECU_Address@sensor_inport.HALSensors.HAL_ultrasound_SI.HAL_list_echo.tab_echo[12].d_echo@ */ /end MEASUREMENT
/begin MEASUREMENT sensor_inport.HALSensors.HAL_ultrasound_SI.HAL_list_echo.tab_echo[12].pre_max_index "" UWORD flightControlSystem_CM_uint16 0 0 0 65535 ECU_ADDRESS 0x0000 /* @ECU_Address@sensor_inport.HALSensors.HAL_ultrasound_SI.HAL_list_echo.tab_echo[12].pre_max_index@ */ /end MEASUREMENT
/begin MEASUREMENT sensor_inport.HALSensors.HAL_ultrasound_SI.HAL_list_echo.tab_echo[13].begin_echo_index "" UWORD flightControlSystem_CM_uint16 0 0 0 65535 ECU_ADDRESS 0x0000 /* @ECU_Address@sensor_inport.HALSensors.HAL_ultrasound_SI.HAL_list_echo.tab_echo[13].begin_echo_index@ */ /end MEASUREMENT
/begin MEASUREMENT sensor_inport.HALSensors.HAL_ultrasound_SI.HAL_list_echo.tab_echo[13].end_echo_index "" UWORD flightControlSystem_CM_uint16 0 0 0 65535 ECU_ADDRESS 0x0000 /* @ECU_Address@sensor_inport.HALSensors.HAL_ultrasound_SI.HAL_list_echo.tab_echo[13].end_echo_index@ */ /end MEASUREMENT
/begin MEASUREMENT sensor_inport.HALSensors.HAL_ultrasound_SI.HAL_list_echo.tab_echo[13].max_value_index "" SWORD flightControlSystem_CM_int16 0 0 -32768 32767 ECU_ADDRESS 0x0000 /* @ECU_Address@sensor_inport.HALSensors.HAL_ultrasound_SI.HAL_list_echo.tab_echo[13].max_value_index@ */ /end MEASUREMENT
/begin MEASUREMENT sensor_inport.HALSensors.HAL_ultrasound_SI.HAL_list_echo.tab_echo[13].max_value "" SLONG flightControlSystem_CM_int32 0 0 -2147483648 2147483647 ECU_ADDRESS 0x0000 /* @ECU_Address@sensor_inport.HALSensors.HAL_ultrasound_SI.HAL_list_echo.tab_echo[13].max_value@ */ /end MEASUREMENT
/begin MEASUREMENT sensor_inport.HALSensors.HAL_ultrasound_SI.HAL_list_echo.tab_echo[13].precedent "" UWORD flightControlSystem_CM_uint16 0 0 0 65535 ECU_ADDRESS 0x0000 /* @ECU_Address@sensor_inport.HALSensors.HAL_ultrasound_SI.HAL_list_echo.tab_echo[13].precedent@ */ /end MEASUREMENT
/begin MEASUREMENT sensor_inport.HALSensors.HAL_ultrasound_SI.HAL_list_echo.tab_echo[13].d_echo "" SWORD flightControlSystem_CM_int16 0 0 -32768 32767 ECU_ADDRESS 0x0000 /* @ECU_Address@sensor_inport.HALSensors.HAL_ultrasound_SI.HAL_list_echo.tab_echo[13].d_echo@ */ /end MEASUREMENT
/begin MEASUREMENT sensor_inport.HALSensors.HAL_ultrasound_SI.HAL_list_echo.tab_echo[13].pre_max_index "" UWORD flightControlSystem_CM_uint16 0 0 0 65535 ECU_ADDRESS 0x0000 /* @ECU_Address@sensor_inport.HALSensors.HAL_ultrasound_SI.HAL_list_echo.tab_echo[13].pre_max_index@ */ /end MEASUREMENT
/begin MEASUREMENT sensor_inport.HALSensors.HAL_ultrasound_SI.HAL_list_echo.tab_echo[14].begin_echo_index "" UWORD flightControlSystem_CM_uint16 0 0 0 65535 ECU_ADDRESS 0x0000 /* @ECU_Address@sensor_inport.HALSensors.HAL_ultrasound_SI.HAL_list_echo.tab_echo[14].begin_echo_index@ */ /end MEASUREMENT
/begin MEASUREMENT sensor_inport.HALSensors.HAL_ultrasound_SI.HAL_list_echo.tab_echo[14].end_echo_index "" UWORD flightControlSystem_CM_uint16 0 0 0 65535 ECU_ADDRESS 0x0000 /* @ECU_Address@sensor_inport.HALSensors.HAL_ultrasound_SI.HAL_list_echo.tab_echo[14].end_echo_index@ */ /end MEASUREMENT
/begin MEASUREMENT sensor_inport.HALSensors.HAL_ultrasound_SI.HAL_list_echo.tab_echo[14].max_value_index "" SWORD flightControlSystem_CM_int16 0 0 -32768 32767 ECU_ADDRESS 0x0000 /* @ECU_Address@sensor_inport.HALSensors.HAL_ultrasound_SI.HAL_list_echo.tab_echo[14].max_value_index@ */ /end MEASUREMENT
/begin MEASUREMENT sensor_inport.HALSensors.HAL_ultrasound_SI.HAL_list_echo.tab_echo[14].max_value "" SLONG flightControlSystem_CM_int32 0 0 -2147483648 2147483647 ECU_ADDRESS 0x0000 /* @ECU_Address@sensor_inport.HALSensors.HAL_ultrasound_SI.HAL_list_echo.tab_echo[14].max_value@ */ /end MEASUREMENT
/begin MEASUREMENT sensor_inport.HALSensors.HAL_ultrasound_SI.HAL_list_echo.tab_echo[14].precedent "" UWORD flightControlSystem_CM_uint16 0 0 0 65535 ECU_ADDRESS 0x0000 /* @ECU_Address@sensor_inport.HALSensors.HAL_ultrasound_SI.HAL_list_echo.tab_echo[14].precedent@ */ /end MEASUREMENT
/begin MEASUREMENT sensor_inport.HALSensors.HAL_ultrasound_SI.HAL_list_echo.tab_echo[14].d_echo "" SWORD flightControlSystem_CM_int16 0 0 -32768 32767 ECU_ADDRESS 0x0000 /* @ECU_Address@sensor_inport.HALSensors.HAL_ultrasound_SI.HAL_list_echo.tab_echo[14].d_echo@ */ /end MEASUREMENT
/begin MEASUREMENT sensor_inport.HALSensors.HAL_ultrasound_SI.HAL_list_echo.tab_echo[14].pre_max_index "" UWORD flightControlSystem_CM_uint16 0 0 0 65535 ECU_ADDRESS 0x0000 /* @ECU_Address@sensor_inport.HALSensors.HAL_ultrasound_SI.HAL_list_echo.tab_echo[14].pre_max_index@ */ /end MEASUREMENT
/begin MEASUREMENT sensor_inport.HALSensors.HAL_ultrasound_SI.HAL_list_echo.tab_echo[15].begin_echo_index "" UWORD flightControlSystem_CM_uint16 0 0 0 65535 ECU_ADDRESS 0x0000 /* @ECU_Address@sensor_inport.HALSensors.HAL_ultrasound_SI.HAL_list_echo.tab_echo[15].begin_echo_index@ */ /end MEASUREMENT
/begin MEASUREMENT sensor_inport.HALSensors.HAL_ultrasound_SI.HAL_list_echo.tab_echo[15].end_echo_index "" UWORD flightControlSystem_CM_uint16 0 0 0 65535 ECU_ADDRESS 0x0000 /* @ECU_Address@sensor_inport.HALSensors.HAL_ultrasound_SI.HAL_list_echo.tab_echo[15].end_echo_index@ */ /end MEASUREMENT
/begin MEASUREMENT sensor_inport.HALSensors.HAL_ultrasound_SI.HAL_list_echo.tab_echo[15].max_value_index "" SWORD flightControlSystem_CM_int16 0 0 -32768 32767 ECU_ADDRESS 0x0000 /* @ECU_Address@sensor_inport.HALSensors.HAL_ultrasound_SI.HAL_list_echo.tab_echo[15].max_value_index@ */ /end MEASUREMENT
/begin MEASUREMENT sensor_inport.HALSensors.HAL_ultrasound_SI.HAL_list_echo.tab_echo[15].max_value "" SLONG flightControlSystem_CM_int32 0 0 -2147483648 2147483647 ECU_ADDRESS 0x0000 /* @ECU_Address@sensor_inport.HALSensors.HAL_ultrasound_SI.HAL_list_echo.tab_echo[15].max_value@ */ /end MEASUREMENT
/begin MEASUREMENT sensor_inport.HALSensors.HAL_ultrasound_SI.HAL_list_echo.tab_echo[15].precedent "" UWORD flightControlSystem_CM_uint16 0 0 0 65535 ECU_ADDRESS 0x0000 /* @ECU_Address@sensor_inport.HALSensors.HAL_ultrasound_SI.HAL_list_echo.tab_echo[15].precedent@ */ /end MEASUREMENT
/begin MEASUREMENT sensor_inport.HALSensors.HAL_ultrasound_SI.HAL_list_echo.tab_echo[15].d_echo "" SWORD flightControlSystem_CM_int16 0 0 -32768 32767 ECU_ADDRESS 0x0000 /* @ECU_Address@sensor_inport.HALSensors.HAL_ultrasound_SI.HAL_list_echo.tab_echo[15].d_echo@ */ /end MEASUREMENT
/begin MEASUREMENT sensor_inport.HALSensors.HAL_ultrasound_SI.HAL_list_echo.tab_echo[15].pre_max_index "" UWORD flightControlSystem_CM_uint16 0 0 0 65535 ECU_ADDRESS 0x0000 /* @ECU_Address@sensor_inport.HALSensors.HAL_ultrasound_SI.HAL_list_echo.tab_echo[15].pre_max_index@ */ /end MEASUREMENT
/begin MEASUREMENT sensor_inport.HALSensors.HAL_ultrasound_SI.HAL_list_echo.tab_echo[16].begin_echo_index "" UWORD flightControlSystem_CM_uint16 0 0 0 65535 ECU_ADDRESS 0x0000 /* @ECU_Address@sensor_inport.HALSensors.HAL_ultrasound_SI.HAL_list_echo.tab_echo[16].begin_echo_index@ */ /end MEASUREMENT
/begin MEASUREMENT sensor_inport.HALSensors.HAL_ultrasound_SI.HAL_list_echo.tab_echo[16].end_echo_index "" UWORD flightControlSystem_CM_uint16 0 0 0 65535 ECU_ADDRESS 0x0000 /* @ECU_Address@sensor_inport.HALSensors.HAL_ultrasound_SI.HAL_list_echo.tab_echo[16].end_echo_index@ */ /end MEASUREMENT
/begin MEASUREMENT sensor_inport.HALSensors.HAL_ultrasound_SI.HAL_list_echo.tab_echo[16].max_value_index "" SWORD flightControlSystem_CM_int16 0 0 -32768 32767 ECU_ADDRESS 0x0000 /* @ECU_Address@sensor_inport.HALSensors.HAL_ultrasound_SI.HAL_list_echo.tab_echo[16].max_value_index@ */ /end MEASUREMENT
/begin MEASUREMENT sensor_inport.HALSensors.HAL_ultrasound_SI.HAL_list_echo.tab_echo[16].max_value "" SLONG flightControlSystem_CM_int32 0 0 -2147483648 2147483647 ECU_ADDRESS 0x0000 /* @ECU_Address@sensor_inport.HALSensors.HAL_ultrasound_SI.HAL_list_echo.tab_echo[16].max_value@ */ /end MEASUREMENT
/begin MEASUREMENT sensor_inport.HALSensors.HAL_ultrasound_SI.HAL_list_echo.tab_echo[16].precedent "" UWORD flightControlSystem_CM_uint16 0 0 0 65535 ECU_ADDRESS 0x0000 /* @ECU_Address@sensor_inport.HALSensors.HAL_ultrasound_SI.HAL_list_echo.tab_echo[16].precedent@ */ /end MEASUREMENT
/begin MEASUREMENT sensor_inport.HALSensors.HAL_ultrasound_SI.HAL_list_echo.tab_echo[16].d_echo "" SWORD flightControlSystem_CM_int16 0 0 -32768 32767 ECU_ADDRESS 0x0000 /* @ECU_Address@sensor_inport.HALSensors.HAL_ultrasound_SI.HAL_list_echo.tab_echo[16].d_echo@ */ /end MEASUREMENT
/begin MEASUREMENT sensor_inport.HALSensors.HAL_ultrasound_SI.HAL_list_echo.tab_echo[16].pre_max_index "" UWORD flightControlSystem_CM_uint16 0 0 0 65535 ECU_ADDRESS 0x0000 /* @ECU_Address@sensor_inport.HALSensors.HAL_ultrasound_SI.HAL_list_echo.tab_echo[16].pre_max_index@ */ /end MEASUREMENT
/begin MEASUREMENT sensor_inport.HALSensors.HAL_ultrasound_SI.HAL_list_echo.tab_echo[17].begin_echo_index "" UWORD flightControlSystem_CM_uint16 0 0 0 65535 ECU_ADDRESS 0x0000 /* @ECU_Address@sensor_inport.HALSensors.HAL_ultrasound_SI.HAL_list_echo.tab_echo[17].begin_echo_index@ */ /end MEASUREMENT
/begin MEASUREMENT sensor_inport.HALSensors.HAL_ultrasound_SI.HAL_list_echo.tab_echo[17].end_echo_index "" UWORD flightControlSystem_CM_uint16 0 0 0 65535 ECU_ADDRESS 0x0000 /* @ECU_Address@sensor_inport.HALSensors.HAL_ultrasound_SI.HAL_list_echo.tab_echo[17].end_echo_index@ */ /end MEASUREMENT
/begin MEASUREMENT sensor_inport.HALSensors.HAL_ultrasound_SI.HAL_list_echo.tab_echo[17].max_value_index "" SWORD flightControlSystem_CM_int16 0 0 -32768 32767 ECU_ADDRESS 0x0000 /* @ECU_Address@sensor_inport.HALSensors.HAL_ultrasound_SI.HAL_list_echo.tab_echo[17].max_value_index@ */ /end MEASUREMENT
/begin MEASUREMENT sensor_inport.HALSensors.HAL_ultrasound_SI.HAL_list_echo.tab_echo[17].max_value "" SLONG flightControlSystem_CM_int32 0 0 -2147483648 2147483647 ECU_ADDRESS 0x0000 /* @ECU_Address@sensor_inport.HALSensors.HAL_ultrasound_SI.HAL_list_echo.tab_echo[17].max_value@ */ /end MEASUREMENT
/begin MEASUREMENT sensor_inport.HALSensors.HAL_ultrasound_SI.HAL_list_echo.tab_echo[17].precedent "" UWORD flightControlSystem_CM_uint16 0 0 0 65535 ECU_ADDRESS 0x0000 /* @ECU_Address@sensor_inport.HALSensors.HAL_ultrasound_SI.HAL_list_echo.tab_echo[17].precedent@ */ /end MEASUREMENT
/begin MEASUREMENT sensor_inport.HALSensors.HAL_ultrasound_SI.HAL_list_echo.tab_echo[17].d_echo "" SWORD flightControlSystem_CM_int16 0 0 -32768 32767 ECU_ADDRESS 0x0000 /* @ECU_Address@sensor_inport.HALSensors.HAL_ultrasound_SI.HAL_list_echo.tab_echo[17].d_echo@ */ /end MEASUREMENT
/begin MEASUREMENT sensor_inport.HALSensors.HAL_ultrasound_SI.HAL_list_echo.tab_echo[17].pre_max_index "" UWORD flightControlSystem_CM_uint16 0 0 0 65535 ECU_ADDRESS 0x0000 /* @ECU_Address@sensor_inport.HALSensors.HAL_ultrasound_SI.HAL_list_echo.tab_echo[17].pre_max_index@ */ /end MEASUREMENT
/begin MEASUREMENT sensor_inport.HALSensors.HAL_ultrasound_SI.HAL_list_echo.tab_echo[18].begin_echo_index "" UWORD flightControlSystem_CM_uint16 0 0 0 65535 ECU_ADDRESS 0x0000 /* @ECU_Address@sensor_inport.HALSensors.HAL_ultrasound_SI.HAL_list_echo.tab_echo[18].begin_echo_index@ */ /end MEASUREMENT
/begin MEASUREMENT sensor_inport.HALSensors.HAL_ultrasound_SI.HAL_list_echo.tab_echo[18].end_echo_index "" UWORD flightControlSystem_CM_uint16 0 0 0 65535 ECU_ADDRESS 0x0000 /* @ECU_Address@sensor_inport.HALSensors.HAL_ultrasound_SI.HAL_list_echo.tab_echo[18].end_echo_index@ */ /end MEASUREMENT
/begin MEASUREMENT sensor_inport.HALSensors.HAL_ultrasound_SI.HAL_list_echo.tab_echo[18].max_value_index "" SWORD flightControlSystem_CM_int16 0 0 -32768 32767 ECU_ADDRESS 0x0000 /* @ECU_Address@sensor_inport.HALSensors.HAL_ultrasound_SI.HAL_list_echo.tab_echo[18].max_value_index@ */ /end MEASUREMENT
/begin MEASUREMENT sensor_inport.HALSensors.HAL_ultrasound_SI.HAL_list_echo.tab_echo[18].max_value "" SLONG flightControlSystem_CM_int32 0 0 -2147483648 2147483647 ECU_ADDRESS 0x0000 /* @ECU_Address@sensor_inport.HALSensors.HAL_ultrasound_SI.HAL_list_echo.tab_echo[18].max_value@ */ /end MEASUREMENT
/begin MEASUREMENT sensor_inport.HALSensors.HAL_ultrasound_SI.HAL_list_echo.tab_echo[18].precedent "" UWORD flightControlSystem_CM_uint16 0 0 0 65535 ECU_ADDRESS 0x0000 /* @ECU_Address@sensor_inport.HALSensors.HAL_ultrasound_SI.HAL_list_echo.tab_echo[18].precedent@ */ /end MEASUREMENT
/begin MEASUREMENT sensor_inport.HALSensors.HAL_ultrasound_SI.HAL_list_echo.tab_echo[18].d_echo "" SWORD flightControlSystem_CM_int16 0 0 -32768 32767 ECU_ADDRESS 0x0000 /* @ECU_Address@sensor_inport.HALSensors.HAL_ultrasound_SI.HAL_list_echo.tab_echo[18].d_echo@ */ /end MEASUREMENT
/begin MEASUREMENT sensor_inport.HALSensors.HAL_ultrasound_SI.HAL_list_echo.tab_echo[18].pre_max_index "" UWORD flightControlSystem_CM_uint16 0 0 0 65535 ECU_ADDRESS 0x0000 /* @ECU_Address@sensor_inport.HALSensors.HAL_ultrasound_SI.HAL_list_echo.tab_echo[18].pre_max_index@ */ /end MEASUREMENT
/begin MEASUREMENT sensor_inport.HALSensors.HAL_ultrasound_SI.HAL_list_echo.tab_echo[19].begin_echo_index "" UWORD flightControlSystem_CM_uint16 0 0 0 65535 ECU_ADDRESS 0x0000 /* @ECU_Address@sensor_inport.HALSensors.HAL_ultrasound_SI.HAL_list_echo.tab_echo[19].begin_echo_index@ */ /end MEASUREMENT
/begin MEASUREMENT sensor_inport.HALSensors.HAL_ultrasound_SI.HAL_list_echo.tab_echo[19].end_echo_index "" UWORD flightControlSystem_CM_uint16 0 0 0 65535 ECU_ADDRESS 0x0000 /* @ECU_Address@sensor_inport.HALSensors.HAL_ultrasound_SI.HAL_list_echo.tab_echo[19].end_echo_index@ */ /end MEASUREMENT
/begin MEASUREMENT sensor_inport.HALSensors.HAL_ultrasound_SI.HAL_list_echo.tab_echo[19].max_value_index "" SWORD flightControlSystem_CM_int16 0 0 -32768 32767 ECU_ADDRESS 0x0000 /* @ECU_Address@sensor_inport.HALSensors.HAL_ultrasound_SI.HAL_list_echo.tab_echo[19].max_value_index@ */ /end MEASUREMENT
/begin MEASUREMENT sensor_inport.HALSensors.HAL_ultrasound_SI.HAL_list_echo.tab_echo[19].max_value "" SLONG flightControlSystem_CM_int32 0 0 -2147483648 2147483647 ECU_ADDRESS 0x0000 /* @ECU_Address@sensor_inport.HALSensors.HAL_ultrasound_SI.HAL_list_echo.tab_echo[19].max_value@ */ /end MEASUREMENT
/begin MEASUREMENT sensor_inport.HALSensors.HAL_ultrasound_SI.HAL_list_echo.tab_echo[19].precedent "" UWORD flightControlSystem_CM_uint16 0 0 0 65535 ECU_ADDRESS 0x0000 /* @ECU_Address@sensor_inport.HALSensors.HAL_ultrasound_SI.HAL_list_echo.tab_echo[19].precedent@ */ /end MEASUREMENT
/begin MEASUREMENT sensor_inport.HALSensors.HAL_ultrasound_SI.HAL_list_echo.tab_echo[19].d_echo "" SWORD flightControlSystem_CM_int16 0 0 -32768 32767 ECU_ADDRESS 0x0000 /* @ECU_Address@sensor_inport.HALSensors.HAL_ultrasound_SI.HAL_list_echo.tab_echo[19].d_echo@ */ /end MEASUREMENT
/begin MEASUREMENT sensor_inport.HALSensors.HAL_ultrasound_SI.HAL_list_echo.tab_echo[19].pre_max_index "" UWORD flightControlSystem_CM_uint16 0 0 0 65535 ECU_ADDRESS 0x0000 /* @ECU_Address@sensor_inport.HALSensors.HAL_ultrasound_SI.HAL_list_echo.tab_echo[19].pre_max_index@ */ /end MEASUREMENT
/begin MEASUREMENT sensor_inport.HALSensors.HAL_ultrasound_SI.HAL_list_echo.tab_echo[20].begin_echo_index "" UWORD flightControlSystem_CM_uint16 0 0 0 65535 ECU_ADDRESS 0x0000 /* @ECU_Address@sensor_inport.HALSensors.HAL_ultrasound_SI.HAL_list_echo.tab_echo[20].begin_echo_index@ */ /end MEASUREMENT
/begin MEASUREMENT sensor_inport.HALSensors.HAL_ultrasound_SI.HAL_list_echo.tab_echo[20].end_echo_index "" UWORD flightControlSystem_CM_uint16 0 0 0 65535 ECU_ADDRESS 0x0000 /* @ECU_Address@sensor_inport.HALSensors.HAL_ultrasound_SI.HAL_list_echo.tab_echo[20].end_echo_index@ */ /end MEASUREMENT
/begin MEASUREMENT sensor_inport.HALSensors.HAL_ultrasound_SI.HAL_list_echo.tab_echo[20].max_value_index "" SWORD flightControlSystem_CM_int16 0 0 -32768 32767 ECU_ADDRESS 0x0000 /* @ECU_Address@sensor_inport.HALSensors.HAL_ultrasound_SI.HAL_list_echo.tab_echo[20].max_value_index@ */ /end MEASUREMENT
/begin MEASUREMENT sensor_inport.HALSensors.HAL_ultrasound_SI.HAL_list_echo.tab_echo[20].max_value "" SLONG flightControlSystem_CM_int32 0 0 -2147483648 2147483647 ECU_ADDRESS 0x0000 /* @ECU_Address@sensor_inport.HALSensors.HAL_ultrasound_SI.HAL_list_echo.tab_echo[20].max_value@ */ /end MEASUREMENT
/begin MEASUREMENT sensor_inport.HALSensors.HAL_ultrasound_SI.HAL_list_echo.tab_echo[20].precedent "" UWORD flightControlSystem_CM_uint16 0 0 0 65535 ECU_ADDRESS 0x0000 /* @ECU_Address@sensor_inport.HALSensors.HAL_ultrasound_SI.HAL_list_echo.tab_echo[20].precedent@ */ /end MEASUREMENT
/begin MEASUREMENT sensor_inport.HALSensors.HAL_ultrasound_SI.HAL_list_echo.tab_echo[20].d_echo "" SWORD flightControlSystem_CM_int16 0 0 -32768 32767 ECU_ADDRESS 0x0000 /* @ECU_Address@sensor_inport.HALSensors.HAL_ultrasound_SI.HAL_list_echo.tab_echo[20].d_echo@ */ /end MEASUREMENT
/begin MEASUREMENT sensor_inport.HALSensors.HAL_ultrasound_SI.HAL_list_echo.tab_echo[20].pre_max_index "" UWORD flightControlSystem_CM_uint16 0 0 0 65535 ECU_ADDRESS 0x0000 /* @ECU_Address@sensor_inport.HALSensors.HAL_ultrasound_SI.HAL_list_echo.tab_echo[20].pre_max_index@ */ /end MEASUREMENT
/begin MEASUREMENT sensor_inport.HALSensors.HAL_ultrasound_SI.HAL_list_echo.tab_echo[21].begin_echo_index "" UWORD flightControlSystem_CM_uint16 0 0 0 65535 ECU_ADDRESS 0x0000 /* @ECU_Address@sensor_inport.HALSensors.HAL_ultrasound_SI.HAL_list_echo.tab_echo[21].begin_echo_index@ */ /end MEASUREMENT
/begin MEASUREMENT sensor_inport.HALSensors.HAL_ultrasound_SI.HAL_list_echo.tab_echo[21].end_echo_index "" UWORD flightControlSystem_CM_uint16 0 0 0 65535 ECU_ADDRESS 0x0000 /* @ECU_Address@sensor_inport.HALSensors.HAL_ultrasound_SI.HAL_list_echo.tab_echo[21].end_echo_index@ */ /end MEASUREMENT
/begin MEASUREMENT sensor_inport.HALSensors.HAL_ultrasound_SI.HAL_list_echo.tab_echo[21].max_value_index "" SWORD flightControlSystem_CM_int16 0 0 -32768 32767 ECU_ADDRESS 0x0000 /* @ECU_Address@sensor_inport.HALSensors.HAL_ultrasound_SI.HAL_list_echo.tab_echo[21].max_value_index@ */ /end MEASUREMENT
/begin MEASUREMENT sensor_inport.HALSensors.HAL_ultrasound_SI.HAL_list_echo.tab_echo[21].max_value "" SLONG flightControlSystem_CM_int32 0 0 -2147483648 2147483647 ECU_ADDRESS 0x0000 /* @ECU_Address@sensor_inport.HALSensors.HAL_ultrasound_SI.HAL_list_echo.tab_echo[21].max_value@ */ /end MEASUREMENT
/begin MEASUREMENT sensor_inport.HALSensors.HAL_ultrasound_SI.HAL_list_echo.tab_echo[21].precedent "" UWORD flightControlSystem_CM_uint16 0 0 0 65535 ECU_ADDRESS 0x0000 /* @ECU_Address@sensor_inport.HALSensors.HAL_ultrasound_SI.HAL_list_echo.tab_echo[21].precedent@ */ /end MEASUREMENT
/begin MEASUREMENT sensor_inport.HALSensors.HAL_ultrasound_SI.HAL_list_echo.tab_echo[21].d_echo "" SWORD flightControlSystem_CM_int16 0 0 -32768 32767 ECU_ADDRESS 0x0000 /* @ECU_Address@sensor_inport.HALSensors.HAL_ultrasound_SI.HAL_list_echo.tab_echo[21].d_echo@ */ /end MEASUREMENT
/begin MEASUREMENT sensor_inport.HALSensors.HAL_ultrasound_SI.HAL_list_echo.tab_echo[21].pre_max_index "" UWORD flightControlSystem_CM_uint16 0 0 0 65535 ECU_ADDRESS 0x0000 /* @ECU_Address@sensor_inport.HALSensors.HAL_ultrasound_SI.HAL_list_echo.tab_echo[21].pre_max_index@ */ /end MEASUREMENT
/begin MEASUREMENT sensor_inport.HALSensors.HAL_ultrasound_SI.HAL_list_echo.tab_echo[22].begin_echo_index "" UWORD flightControlSystem_CM_uint16 0 0 0 65535 ECU_ADDRESS 0x0000 /* @ECU_Address@sensor_inport.HALSensors.HAL_ultrasound_SI.HAL_list_echo.tab_echo[22].begin_echo_index@ */ /end MEASUREMENT
/begin MEASUREMENT sensor_inport.HALSensors.HAL_ultrasound_SI.HAL_list_echo.tab_echo[22].end_echo_index "" UWORD flightControlSystem_CM_uint16 0 0 0 65535 ECU_ADDRESS 0x0000 /* @ECU_Address@sensor_inport.HALSensors.HAL_ultrasound_SI.HAL_list_echo.tab_echo[22].end_echo_index@ */ /end MEASUREMENT
/begin MEASUREMENT sensor_inport.HALSensors.HAL_ultrasound_SI.HAL_list_echo.tab_echo[22].max_value_index "" SWORD flightControlSystem_CM_int16 0 0 -32768 32767 ECU_ADDRESS 0x0000 /* @ECU_Address@sensor_inport.HALSensors.HAL_ultrasound_SI.HAL_list_echo.tab_echo[22].max_value_index@ */ /end MEASUREMENT
/begin MEASUREMENT sensor_inport.HALSensors.HAL_ultrasound_SI.HAL_list_echo.tab_echo[22].max_value "" SLONG flightControlSystem_CM_int32 0 0 -2147483648 2147483647 ECU_ADDRESS 0x0000 /* @ECU_Address@sensor_inport.HALSensors.HAL_ultrasound_SI.HAL_list_echo.tab_echo[22].max_value@ */ /end MEASUREMENT
/begin MEASUREMENT sensor_inport.HALSensors.HAL_ultrasound_SI.HAL_list_echo.tab_echo[22].precedent "" UWORD flightControlSystem_CM_uint16 0 0 0 65535 ECU_ADDRESS 0x0000 /* @ECU_Address@sensor_inport.HALSensors.HAL_ultrasound_SI.HAL_list_echo.tab_echo[22].precedent@ */ /end MEASUREMENT
/begin MEASUREMENT sensor_inport.HALSensors.HAL_ultrasound_SI.HAL_list_echo.tab_echo[22].d_echo "" SWORD flightControlSystem_CM_int16 0 0 -32768 32767 ECU_ADDRESS 0x0000 /* @ECU_Address@sensor_inport.HALSensors.HAL_ultrasound_SI.HAL_list_echo.tab_echo[22].d_echo@ */ /end MEASUREMENT
/begin MEASUREMENT sensor_inport.HALSensors.HAL_ultrasound_SI.HAL_list_echo.tab_echo[22].pre_max_index "" UWORD flightControlSystem_CM_uint16 0 0 0 65535 ECU_ADDRESS 0x0000 /* @ECU_Address@sensor_inport.HALSensors.HAL_ultrasound_SI.HAL_list_echo.tab_echo[22].pre_max_index@ */ /end MEASUREMENT
/begin MEASUREMENT sensor_inport.HALSensors.HAL_ultrasound_SI.HAL_list_echo.tab_echo[23].begin_echo_index "" UWORD flightControlSystem_CM_uint16 0 0 0 65535 ECU_ADDRESS 0x0000 /* @ECU_Address@sensor_inport.HALSensors.HAL_ultrasound_SI.HAL_list_echo.tab_echo[23].begin_echo_index@ */ /end MEASUREMENT
/begin MEASUREMENT sensor_inport.HALSensors.HAL_ultrasound_SI.HAL_list_echo.tab_echo[23].end_echo_index "" UWORD flightControlSystem_CM_uint16 0 0 0 65535 ECU_ADDRESS 0x0000 /* @ECU_Address@sensor_inport.HALSensors.HAL_ultrasound_SI.HAL_list_echo.tab_echo[23].end_echo_index@ */ /end MEASUREMENT
/begin MEASUREMENT sensor_inport.HALSensors.HAL_ultrasound_SI.HAL_list_echo.tab_echo[23].max_value_index "" SWORD flightControlSystem_CM_int16 0 0 -32768 32767 ECU_ADDRESS 0x0000 /* @ECU_Address@sensor_inport.HALSensors.HAL_ultrasound_SI.HAL_list_echo.tab_echo[23].max_value_index@ */ /end MEASUREMENT
/begin MEASUREMENT sensor_inport.HALSensors.HAL_ultrasound_SI.HAL_list_echo.tab_echo[23].max_value "" SLONG flightControlSystem_CM_int32 0 0 -2147483648 2147483647 ECU_ADDRESS 0x0000 /* @ECU_Address@sensor_inport.HALSensors.HAL_ultrasound_SI.HAL_list_echo.tab_echo[23].max_value@ */ /end MEASUREMENT
/begin MEASUREMENT sensor_inport.HALSensors.HAL_ultrasound_SI.HAL_list_echo.tab_echo[23].precedent "" UWORD flightControlSystem_CM_uint16 0 0 0 65535 ECU_ADDRESS 0x0000 /* @ECU_Address@sensor_inport.HALSensors.HAL_ultrasound_SI.HAL_list_echo.tab_echo[23].precedent@ */ /end MEASUREMENT
/begin MEASUREMENT sensor_inport.HALSensors.HAL_ultrasound_SI.HAL_list_echo.tab_echo[23].d_echo "" SWORD flightControlSystem_CM_int16 0 0 -32768 32767 ECU_ADDRESS 0x0000 /* @ECU_Address@sensor_inport.HALSensors.HAL_ultrasound_SI.HAL_list_echo.tab_echo[23].d_echo@ */ /end MEASUREMENT
/begin MEASUREMENT sensor_inport.HALSensors.HAL_ultrasound_SI.HAL_list_echo.tab_echo[23].pre_max_index "" UWORD flightControlSystem_CM_uint16 0 0 0 65535 ECU_ADDRESS 0x0000 /* @ECU_Address@sensor_inport.HALSensors.HAL_ultrasound_SI.HAL_list_echo.tab_echo[23].pre_max_index@ */ /end MEASUREMENT
/begin MEASUREMENT sensor_inport.HALSensors.HAL_ultrasound_SI.HAL_list_echo.number_of_echoes "" UBYTE flightControlSystem_CM_uint8 0 0 0 255 ECU_ADDRESS 0x0000 /* @ECU_Address@sensor_inport.HALSensors.HAL_ultrasound_SI.HAL_list_echo.number_of_echoes@ */ /end MEASUREMENT
/begin MEASUREMENT sensor_inport.HALSensors.padding "" UBYTE flightControlSystem_CM_uint8 0 0 0 255 ARRAY_SIZE 196 ECU_ADDRESS 0x0000 /* @ECU_Address@sensor_inport.HALSensors.padding@ */ /end MEASUREMENT
/begin MEASUREMENT sensor_inport.SensorCalibration "" FLOAT32_IEEE flightControlSystem_CM_single 0 0 -3.4E+38 3.4E+38 ARRAY_SIZE 8 ECU_ADDRESS 0x0000 /* @ECU_Address@sensor_inport.SensorCalibration@ */ /end MEASUREMENT
/begin MEASUREMENT imRGB "" UBYTE flightControlSystem_CM_uint8 0 0 0 255 ARRAY_SIZE 38400 ECU_ADDRESS 0x0000 /* @ECU_Address@imRGB@ */ /end MEASUREMENT
/begin MEASUREMENT motors_outport "" FLOAT32_IEEE flightControlSystem_CM_single 0 0 -3.4E+38 3.4E+38 ARRAY_SIZE 4 ECU_ADDRESS 0x0000 /* @ECU_Address@motors_outport@ */ /end MEASUREMENT
/begin MEASUREMENT flag_outport "" UBYTE flightControlSystem_CM_uint8 0 0 0 255 ECU_ADDRESS 0x0000 /* @ECU_Address@flag_outport@ */ /end MEASUREMENT
/begin COMPU_METHOD flightControlSystem_CM_boolean "Q = V" RAT_FUNC "%1.0" "" COEFFS 0 1 0 0 0 1 /end COMPU_METHOD
/begin COMPU_METHOD flightControlSystem_CM_single "Q = V" RAT_FUNC "%8.6" "" COEFFS 0 1 0 0 0 1 /end COMPU_METHOD
/begin COMPU_METHOD flightControlSystem_CM_uint32 "Q = V" RAT_FUNC "%10.0" "" COEFFS 0 1 0 0 0 1 /end COMPU_METHOD
/begin COMPU_METHOD flightControlSystem_CM_int32 "Q = V" RAT_FUNC "%10.0" "" COEFFS 0 1 0 0 0 1 /end COMPU_METHOD
/begin COMPU_METHOD flightControlSystem_CM_uint16 "Q = V" RAT_FUNC "%5.0" "" COEFFS 0 1 0 0 0 1 /end COMPU_METHOD
/begin COMPU_METHOD flightControlSystem_CM_uint8 "Q = V" RAT_FUNC "%3.0" "" COEFFS 0 1 0 0 0 1 /end COMPU_METHOD
/begin COMPU_METHOD flightControlSystem_CM_double "Q = V" RAT_FUNC "%15.10" "" COEFFS 0 1 0 0 0 1 /end COMPU_METHOD
/begin COMPU_METHOD flightControlSystem_CM_int16 "Q = V" RAT_FUNC "%5.0" "" COEFFS 0 1 0 0 0 1 /end COMPU_METHOD
/begin GROUP flightControlSystem "flightControlSystem" /* Root */ ROOT /begin SUB_GROUP cmd_inport sensor_inport /end SUB_GROUP /begin REF_MEASUREMENT flag_outport imRGB motors_outport /end REF_MEASUREMENT /end GROUP
/begin GROUP cmd_inport ""
 /begin REF_MEASUREMENT cmd_inport.controlModePosVSOrient cmd_inport.live_time_ticks cmd_inport.orient_ref cmd_inport.pos_ref cmd_inport.takeoff_flag /end REF_MEASUREMENT
/end GROUP
/begin GROUP sensor_inport "" /begin SUB_GROUP sensor_inport.HALSensors sensor_inport.VisionSensors /end SUB_GROUP /begin REF_MEASUREMENT sensor_inport.SensorCalibration /end REF_MEASUREMENT /end GROUP
/begin GROUP sensor_inport.VisionSensors ""
 /begin REF_MEASUREMENT sensor_inport.VisionSensors.opticalFlow_data sensor_inport.VisionSensors.posVIS_data sensor_inport.VisionSensors.usePosVIS_flag /end REF_MEASUREMENT
/end GROUP
/begin GROUP sensor_inport.HALSensors ""
 /begin SUB_GROUP sensor_inport.HALSensors.HAL_acc_SI sensor_inport.HALSensors.HAL_fifo_acce_SI[0] sensor_inport.HALSensors.HAL_fifo_acce_SI[1] sensor_inport.HALSensors.HAL_fifo_acce_SI[2] sensor_inport.HALSensors.HAL_fifo_acce_SI[3] sensor_inport.HALSensors.HAL_fifo_acce_SI[4] sensor_inport.HALSensors.HAL_fifo_acce_SI_TempCorr[0] sensor_inport.HALSensors.HAL_fifo_acce_SI_TempCorr[1] sensor_inport.HALSensors.HAL_fifo_acce_SI_TempCorr[2] sensor_inport.HALSensors.HAL_fifo_acce_SI_TempCorr[3] sensor_inport.HALSensors.HAL_fifo_acce_SI_TempCorr[4] sensor_inport.HALSensors.HAL_fifo_gyro_SI[0] sensor_inport.HALSensors.HAL_fifo_gyro_SI[1] sensor_inport.HALSensors.HAL_fifo_gyro_SI[2] sensor_inport.HALSensors.HAL_fifo_gyro_SI[3] sensor_inport.HALSensors.HAL_fifo_gyro_SI[4] sensor_inport.HALSensors.HAL_fifo_gyro_SI_TempCorr[0] sensor_inport.HALSensors.HAL_fifo_gyro_SI_TempCorr[1] sensor_inport.HALSensors.HAL_fifo_gyro_SI_TempCorr[2] sensor_inport.HALSensors.HAL_fifo_gyro_SI_TempCorr[3] sensor_inport.HALSensors.HAL_fifo_gyro_SI_TempCorr[4] sensor_inport.HALSensors.HAL_gyro_SI sensor_inport.HALSensors.HAL_magn_mG sensor_inport.HALSensors.HAL_pressure_SI sensor_inport.HALSensors.HAL_ultrasound_SI sensor_inport.HALSensors.HAL_vbat_SI /end SUB_GROUP
 /begin REF_MEASUREMENT sensor_inport.HALSensors.HAL_fifo_count sensor_inport.HALSensors.HAL_fifo_fsync sensor_inport.HALSensors.HAL_fifo_size sensor_inport.HALSensors.HAL_ref_IMU_temp sensor_inport.HALSensors.count_user sensor_inport.HALSensors.fifo_timestamp sensor_inport.HALSensors.number_HAL_read_call sensor_inport.HALSensors.padding sensor_inport.HALSensors.status sensor_inport.HALSensors.timestamp sensor_inport.HALSensors.used /end REF_MEASUREMENT
/end GROUP
/begin GROUP sensor_inport.HALSensors.HAL_acc_SI ""
 /begin REF_MEASUREMENT sensor_inport.HALSensors.HAL_acc_SI.temperature sensor_inport.HALSensors.HAL_acc_SI.x sensor_inport.HALSensors.HAL_acc_SI.y sensor_inport.HALSensors.HAL_acc_SI.z /end REF_MEASUREMENT
/end GROUP
/begin GROUP sensor_inport.HALSensors.HAL_gyro_SI ""
 /begin REF_MEASUREMENT sensor_inport.HALSensors.HAL_gyro_SI.temperature sensor_inport.HALSensors.HAL_gyro_SI.temperature_lsb sensor_inport.HALSensors.HAL_gyro_SI.x sensor_inport.HALSensors.HAL_gyro_SI.y sensor_inport.HALSensors.HAL_gyro_SI.z /end REF_MEASUREMENT
/end GROUP
/begin GROUP sensor_inport.HALSensors.HAL_fifo_gyro_SI_TempCorr[0] ""
 /begin REF_MEASUREMENT sensor_inport.HALSensors.HAL_fifo_gyro_SI_TempCorr[0].x sensor_inport.HALSensors.HAL_fifo_gyro_SI_TempCorr[0].y sensor_inport.HALSensors.HAL_fifo_gyro_SI_TempCorr[0].z /end REF_MEASUREMENT
/end GROUP
/begin GROUP sensor_inport.HALSensors.HAL_fifo_gyro_SI_TempCorr[1] ""
 /begin REF_MEASUREMENT sensor_inport.HALSensors.HAL_fifo_gyro_SI_TempCorr[1].x sensor_inport.HALSensors.HAL_fifo_gyro_SI_TempCorr[1].y sensor_inport.HALSensors.HAL_fifo_gyro_SI_TempCorr[1].z /end REF_MEASUREMENT
/end GROUP
/begin GROUP sensor_inport.HALSensors.HAL_fifo_gyro_SI_TempCorr[2] ""
 /begin REF_MEASUREMENT sensor_inport.HALSensors.HAL_fifo_gyro_SI_TempCorr[2].x sensor_inport.HALSensors.HAL_fifo_gyro_SI_TempCorr[2].y sensor_inport.HALSensors.HAL_fifo_gyro_SI_TempCorr[2].z /end REF_MEASUREMENT
/end GROUP
/begin GROUP sensor_inport.HALSensors.HAL_fifo_gyro_SI_TempCorr[3] ""
 /begin REF_MEASUREMENT sensor_inport.HALSensors.HAL_fifo_gyro_SI_TempCorr[3].x sensor_inport.HALSensors.HAL_fifo_gyro_SI_TempCorr[3].y sensor_inport.HALSensors.HAL_fifo_gyro_SI_TempCorr[3].z /end REF_MEASUREMENT
/end GROUP
/begin GROUP sensor_inport.HALSensors.HAL_fifo_gyro_SI_TempCorr[4] ""
 /begin REF_MEASUREMENT sensor_inport.HALSensors.HAL_fifo_gyro_SI_TempCorr[4].x sensor_inport.HALSensors.HAL_fifo_gyro_SI_TempCorr[4].y sensor_inport.HALSensors.HAL_fifo_gyro_SI_TempCorr[4].z /end REF_MEASUREMENT
/end GROUP
/begin GROUP sensor_inport.HALSensors.HAL_fifo_acce_SI_TempCorr[0] ""
 /begin REF_MEASUREMENT sensor_inport.HALSensors.HAL_fifo_acce_SI_TempCorr[0].x sensor_inport.HALSensors.HAL_fifo_acce_SI_TempCorr[0].y sensor_inport.HALSensors.HAL_fifo_acce_SI_TempCorr[0].z /end REF_MEASUREMENT
/end GROUP
/begin GROUP sensor_inport.HALSensors.HAL_fifo_acce_SI_TempCorr[1] ""
 /begin REF_MEASUREMENT sensor_inport.HALSensors.HAL_fifo_acce_SI_TempCorr[1].x sensor_inport.HALSensors.HAL_fifo_acce_SI_TempCorr[1].y sensor_inport.HALSensors.HAL_fifo_acce_SI_TempCorr[1].z /end REF_MEASUREMENT
/end GROUP
/begin GROUP sensor_inport.HALSensors.HAL_fifo_acce_SI_TempCorr[2] ""
 /begin REF_MEASUREMENT sensor_inport.HALSensors.HAL_fifo_acce_SI_TempCorr[2].x sensor_inport.HALSensors.HAL_fifo_acce_SI_TempCorr[2].y sensor_inport.HALSensors.HAL_fifo_acce_SI_TempCorr[2].z /end REF_MEASUREMENT
/end GROUP
/begin GROUP sensor_inport.HALSensors.HAL_fifo_acce_SI_TempCorr[3] ""
 /begin REF_MEASUREMENT sensor_inport.HALSensors.HAL_fifo_acce_SI_TempCorr[3].x sensor_inport.HALSensors.HAL_fifo_acce_SI_TempCorr[3].y sensor_inport.HALSensors.HAL_fifo_acce_SI_TempCorr[3].z /end REF_MEASUREMENT
/end GROUP
/begin GROUP sensor_inport.HALSensors.HAL_fifo_acce_SI_TempCorr[4] ""
 /begin REF_MEASUREMENT sensor_inport.HALSensors.HAL_fifo_acce_SI_TempCorr[4].x sensor_inport.HALSensors.HAL_fifo_acce_SI_TempCorr[4].y sensor_inport.HALSensors.HAL_fifo_acce_SI_TempCorr[4].z /end REF_MEASUREMENT
/end GROUP
/begin GROUP sensor_inport.HALSensors.HAL_fifo_gyro_SI[0] ""
 /begin REF_MEASUREMENT sensor_inport.HALSensors.HAL_fifo_gyro_SI[0].x sensor_inport.HALSensors.HAL_fifo_gyro_SI[0].y sensor_inport.HALSensors.HAL_fifo_gyro_SI[0].z /end REF_MEASUREMENT
/end GROUP
/begin GROUP sensor_inport.HALSensors.HAL_fifo_gyro_SI[1] ""
 /begin REF_MEASUREMENT sensor_inport.HALSensors.HAL_fifo_gyro_SI[1].x sensor_inport.HALSensors.HAL_fifo_gyro_SI[1].y sensor_inport.HALSensors.HAL_fifo_gyro_SI[1].z /end REF_MEASUREMENT
/end GROUP
/begin GROUP sensor_inport.HALSensors.HAL_fifo_gyro_SI[2] ""
 /begin REF_MEASUREMENT sensor_inport.HALSensors.HAL_fifo_gyro_SI[2].x sensor_inport.HALSensors.HAL_fifo_gyro_SI[2].y sensor_inport.HALSensors.HAL_fifo_gyro_SI[2].z /end REF_MEASUREMENT
/end GROUP
/begin GROUP sensor_inport.HALSensors.HAL_fifo_gyro_SI[3] ""
 /begin REF_MEASUREMENT sensor_inport.HALSensors.HAL_fifo_gyro_SI[3].x sensor_inport.HALSensors.HAL_fifo_gyro_SI[3].y sensor_inport.HALSensors.HAL_fifo_gyro_SI[3].z /end REF_MEASUREMENT
/end GROUP
/begin GROUP sensor_inport.HALSensors.HAL_fifo_gyro_SI[4] ""
 /begin REF_MEASUREMENT sensor_inport.HALSensors.HAL_fifo_gyro_SI[4].x sensor_inport.HALSensors.HAL_fifo_gyro_SI[4].y sensor_inport.HALSensors.HAL_fifo_gyro_SI[4].z /end REF_MEASUREMENT
/end GROUP
/begin GROUP sensor_inport.HALSensors.HAL_fifo_acce_SI[0] ""
 /begin REF_MEASUREMENT sensor_inport.HALSensors.HAL_fifo_acce_SI[0].x sensor_inport.HALSensors.HAL_fifo_acce_SI[0].y sensor_inport.HALSensors.HAL_fifo_acce_SI[0].z /end REF_MEASUREMENT
/end GROUP
/begin GROUP sensor_inport.HALSensors.HAL_fifo_acce_SI[1] ""
 /begin REF_MEASUREMENT sensor_inport.HALSensors.HAL_fifo_acce_SI[1].x sensor_inport.HALSensors.HAL_fifo_acce_SI[1].y sensor_inport.HALSensors.HAL_fifo_acce_SI[1].z /end REF_MEASUREMENT
/end GROUP
/begin GROUP sensor_inport.HALSensors.HAL_fifo_acce_SI[2] ""
 /begin REF_MEASUREMENT sensor_inport.HALSensors.HAL_fifo_acce_SI[2].x sensor_inport.HALSensors.HAL_fifo_acce_SI[2].y sensor_inport.HALSensors.HAL_fifo_acce_SI[2].z /end REF_MEASUREMENT
/end GROUP
/begin GROUP sensor_inport.HALSensors.HAL_fifo_acce_SI[3] ""
 /begin REF_MEASUREMENT sensor_inport.HALSensors.HAL_fifo_acce_SI[3].x sensor_inport.HALSensors.HAL_fifo_acce_SI[3].y sensor_inport.HALSensors.HAL_fifo_acce_SI[3].z /end REF_MEASUREMENT
/end GROUP
/begin GROUP sensor_inport.HALSensors.HAL_fifo_acce_SI[4] ""
 /begin REF_MEASUREMENT sensor_inport.HALSensors.HAL_fifo_acce_SI[4].x sensor_inport.HALSensors.HAL_fifo_acce_SI[4].y sensor_inport.HALSensors.HAL_fifo_acce_SI[4].z /end REF_MEASUREMENT
/end GROUP
/begin GROUP sensor_inport.HALSensors.HAL_magn_mG ""
 /begin REF_MEASUREMENT sensor_inport.HALSensors.HAL_magn_mG.x sensor_inport.HALSensors.HAL_magn_mG.y sensor_inport.HALSensors.HAL_magn_mG.z /end REF_MEASUREMENT
/end GROUP
/begin GROUP sensor_inport.HALSensors.HAL_pressure_SI ""
 /begin REF_MEASUREMENT sensor_inport.HALSensors.HAL_pressure_SI.pressure sensor_inport.HALSensors.HAL_pressure_SI.temperature /end REF_MEASUREMENT
/end GROUP
/begin GROUP sensor_inport.HALSensors.HAL_ultrasound_SI ""
 /begin SUB_GROUP sensor_inport.HALSensors.HAL_ultrasound_SI.HAL_list_echo sensor_inport.HALSensors.HAL_ultrasound_SI.HAL_list_echo_p /end SUB_GROUP
 /begin REF_MEASUREMENT sensor_inport.HALSensors.HAL_ultrasound_SI.altitude sensor_inport.HALSensors.HAL_ultrasound_SI.measure_ref sensor_inport.HALSensors.HAL_ultrasound_SI.measure_status sensor_inport.HALSensors.HAL_ultrasound_SI.nb_echo sensor_inport.HALSensors.HAL_ultrasound_SI.new_data sensor_inport.HALSensors.HAL_ultrasound_SI.raw_altitude /end REF_MEASUREMENT
/end GROUP
/begin GROUP sensor_inport.HALSensors.HAL_ultrasound_SI.HAL_list_echo ""
 /begin SUB_GROUP sensor_inport.HALSensors.HAL_ultrasound_SI.HAL_list_echo.tab_echo[0] sensor_inport.HALSensors.HAL_ultrasound_SI.HAL_list_echo.tab_echo[10] sensor_inport.HALSensors.HAL_ultrasound_SI.HAL_list_echo.tab_echo[11] sensor_inport.HALSensors.HAL_ultrasound_SI.HAL_list_echo.tab_echo[12] sensor_inport.HALSensors.HAL_ultrasound_SI.HAL_list_echo.tab_echo[13] sensor_inport.HALSensors.HAL_ultrasound_SI.HAL_list_echo.tab_echo[14] sensor_inport.HALSensors.HAL_ultrasound_SI.HAL_list_echo.tab_echo[15] sensor_inport.HALSensors.HAL_ultrasound_SI.HAL_list_echo.tab_echo[16] sensor_inport.HALSensors.HAL_ultrasound_SI.HAL_list_echo.tab_echo[17] sensor_inport.HALSensors.HAL_ultrasound_SI.HAL_list_echo.tab_echo[18] sensor_inport.HALSensors.HAL_ultrasound_SI.HAL_list_echo.tab_echo[19] sensor_inport.HALSensors.HAL_ultrasound_SI.HAL_list_echo.tab_echo[1] sensor_inport.HALSensors.HAL_ultrasound_SI.HAL_list_echo.tab_echo[20] sensor_inport.HALSensors.HAL_ultrasound_SI.HAL_list_echo.tab_echo[21] sensor_inport.HALSensors.HAL_ultrasound_SI.HAL_list_echo.tab_echo[22] sensor_inport.HALSensors.HAL_ultrasound_SI.HAL_list_echo.tab_echo[23] sensor_inport.HALSensors.HAL_ultrasound_SI.HAL_list_echo.tab_echo[24] sensor_inport.HALSensors.HAL_ultrasound_SI.HAL_list_echo.tab_echo[25] sensor_inport.HALSensors.HAL_ultrasound_SI.HAL_list_echo.tab_echo[26] sensor_inport.HALSensors.HAL_ultrasound_SI.HAL_list_echo.tab_echo[27] sensor_inport.HALSensors.HAL_ultrasound_SI.HAL_list_echo.tab_echo[28] sensor_inport.HALSensors.HAL_ultrasound_SI.HAL_list_echo.tab_echo[29] sensor_inport.HALSensors.HAL_ultrasound_SI.HAL_list_echo.tab_echo[2] sensor_inport.HALSensors.HAL_ultrasound_SI.HAL_list_echo.tab_echo[3] sensor_inport.HALSensors.HAL_ultrasound_SI.HAL_list_echo.tab_echo[4] sensor_inport.HALSensors.HAL_ultrasound_SI.HAL_list_echo.tab_echo[5] sensor_inport.HALSensors.HAL_ultrasound_SI.HAL_list_echo.tab_echo[6] sensor_inport.HALSensors.HAL_ultrasound_SI.HAL_list_echo.tab_echo[7] sensor_inport.HALSensors.HAL_ultrasound_SI.HAL_list_echo.tab_echo[8] sensor_inport.HALSensors.HAL_ultrasound_SI.HAL_list_echo.tab_echo[9] /end SUB_GROUP
 /begin REF_MEASUREMENT sensor_inport.HALSensors.HAL_ultrasound_SI.HAL_list_echo.number_of_echoes /end REF_MEASUREMENT
/end GROUP
/begin GROUP sensor_inport.HALSensors.HAL_ultrasound_SI.HAL_list_echo.tab_echo[0] ""
 /begin REF_MEASUREMENT sensor_inport.HALSensors.HAL_ultrasound_SI.HAL_list_echo.tab_echo[0].begin_echo_index sensor_inport.HALSensors.HAL_ultrasound_SI.HAL_list_echo.tab_echo[0].d_echo sensor_inport.HALSensors.HAL_ultrasound_SI.HAL_list_echo.tab_echo[0].end_echo_index sensor_inport.HALSensors.HAL_ultrasound_SI.HAL_list_echo.tab_echo[0].max_value sensor_inport.HALSensors.HAL_ultrasound_SI.HAL_list_echo.tab_echo[0].max_value_index sensor_inport.HALSensors.HAL_ultrasound_SI.HAL_list_echo.tab_echo[0].pre_max_index sensor_inport.HALSensors.HAL_ultrasound_SI.HAL_list_echo.tab_echo[0].precedent /end REF_MEASUREMENT
/end GROUP
/begin GROUP sensor_inport.HALSensors.HAL_ultrasound_SI.HAL_list_echo.tab_echo[1] ""
 /begin REF_MEASUREMENT sensor_inport.HALSensors.HAL_ultrasound_SI.HAL_list_echo.tab_echo[1].begin_echo_index sensor_inport.HALSensors.HAL_ultrasound_SI.HAL_list_echo.tab_echo[1].d_echo sensor_inport.HALSensors.HAL_ultrasound_SI.HAL_list_echo.tab_echo[1].end_echo_index sensor_inport.HALSensors.HAL_ultrasound_SI.HAL_list_echo.tab_echo[1].max_value sensor_inport.HALSensors.HAL_ultrasound_SI.HAL_list_echo.tab_echo[1].max_value_index sensor_inport.HALSensors.HAL_ultrasound_SI.HAL_list_echo.tab_echo[1].pre_max_index sensor_inport.HALSensors.HAL_ultrasound_SI.HAL_list_echo.tab_echo[1].precedent /end REF_MEASUREMENT
/end GROUP
/begin GROUP sensor_inport.HALSensors.HAL_ultrasound_SI.HAL_list_echo.tab_echo[2] ""
 /begin REF_MEASUREMENT sensor_inport.HALSensors.HAL_ultrasound_SI.HAL_list_echo.tab_echo[2].begin_echo_index sensor_inport.HALSensors.HAL_ultrasound_SI.HAL_list_echo.tab_echo[2].d_echo sensor_inport.HALSensors.HAL_ultrasound_SI.HAL_list_echo.tab_echo[2].end_echo_index sensor_inport.HALSensors.HAL_ultrasound_SI.HAL_list_echo.tab_echo[2].max_value sensor_inport.HALSensors.HAL_ultrasound_SI.HAL_list_echo.tab_echo[2].max_value_index sensor_inport.HALSensors.HAL_ultrasound_SI.HAL_list_echo.tab_echo[2].pre_max_index sensor_inport.HALSensors.HAL_ultrasound_SI.HAL_list_echo.tab_echo[2].precedent /end REF_MEASUREMENT
/end GROUP
/begin GROUP sensor_inport.HALSensors.HAL_ultrasound_SI.HAL_list_echo.tab_echo[3] ""
 /begin REF_MEASUREMENT sensor_inport.HALSensors.HAL_ultrasound_SI.HAL_list_echo.tab_echo[3].begin_echo_index sensor_inport.HALSensors.HAL_ultrasound_SI.HAL_list_echo.tab_echo[3].d_echo sensor_inport.HALSensors.HAL_ultrasound_SI.HAL_list_echo.tab_echo[3].end_echo_index sensor_inport.HALSensors.HAL_ultrasound_SI.HAL_list_echo.tab_echo[3].max_value sensor_inport.HALSensors.HAL_ultrasound_SI.HAL_list_echo.tab_echo[3].max_value_index sensor_inport.HALSensors.HAL_ultrasound_SI.HAL_list_echo.tab_echo[3].pre_max_index sensor_inport.HALSensors.HAL_ultrasound_SI.HAL_list_echo.tab_echo[3].precedent /end REF_MEASUREMENT
/end GROUP
/begin GROUP sensor_inport.HALSensors.HAL_ultrasound_SI.HAL_list_echo.tab_echo[4] ""
 /begin REF_MEASUREMENT sensor_inport.HALSensors.HAL_ultrasound_SI.HAL_list_echo.tab_echo[4].begin_echo_index sensor_inport.HALSensors.HAL_ultrasound_SI.HAL_list_echo.tab_echo[4].d_echo sensor_inport.HALSensors.HAL_ultrasound_SI.HAL_list_echo.tab_echo[4].end_echo_index sensor_inport.HALSensors.HAL_ultrasound_SI.HAL_list_echo.tab_echo[4].max_value sensor_inport.HALSensors.HAL_ultrasound_SI.HAL_list_echo.tab_echo[4].max_value_index sensor_inport.HALSensors.HAL_ultrasound_SI.HAL_list_echo.tab_echo[4].pre_max_index sensor_inport.HALSensors.HAL_ultrasound_SI.HAL_list_echo.tab_echo[4].precedent /end REF_MEASUREMENT
/end GROUP
/begin GROUP sensor_inport.HALSensors.HAL_ultrasound_SI.HAL_list_echo.tab_echo[5] ""
 /begin REF_MEASUREMENT sensor_inport.HALSensors.HAL_ultrasound_SI.HAL_list_echo.tab_echo[5].begin_echo_index sensor_inport.HALSensors.HAL_ultrasound_SI.HAL_list_echo.tab_echo[5].d_echo sensor_inport.HALSensors.HAL_ultrasound_SI.HAL_list_echo.tab_echo[5].end_echo_index sensor_inport.HALSensors.HAL_ultrasound_SI.HAL_list_echo.tab_echo[5].max_value sensor_inport.HALSensors.HAL_ultrasound_SI.HAL_list_echo.tab_echo[5].max_value_index sensor_inport.HALSensors.HAL_ultrasound_SI.HAL_list_echo.tab_echo[5].pre_max_index sensor_inport.HALSensors.HAL_ultrasound_SI.HAL_list_echo.tab_echo[5].precedent /end REF_MEASUREMENT
/end GROUP
/begin GROUP sensor_inport.HALSensors.HAL_ultrasound_SI.HAL_list_echo.tab_echo[6] ""
 /begin REF_MEASUREMENT sensor_inport.HALSensors.HAL_ultrasound_SI.HAL_list_echo.tab_echo[6].begin_echo_index sensor_inport.HALSensors.HAL_ultrasound_SI.HAL_list_echo.tab_echo[6].d_echo sensor_inport.HALSensors.HAL_ultrasound_SI.HAL_list_echo.tab_echo[6].end_echo_index sensor_inport.HALSensors.HAL_ultrasound_SI.HAL_list_echo.tab_echo[6].max_value sensor_inport.HALSensors.HAL_ultrasound_SI.HAL_list_echo.tab_echo[6].max_value_index sensor_inport.HALSensors.HAL_ultrasound_SI.HAL_list_echo.tab_echo[6].pre_max_index sensor_inport.HALSensors.HAL_ultrasound_SI.HAL_list_echo.tab_echo[6].precedent /end REF_MEASUREMENT
/end GROUP
/begin GROUP sensor_inport.HALSensors.HAL_ultrasound_SI.HAL_list_echo.tab_echo[7] ""
 /begin REF_MEASUREMENT sensor_inport.HALSensors.HAL_ultrasound_SI.HAL_list_echo.tab_echo[7].begin_echo_index sensor_inport.HALSensors.HAL_ultrasound_SI.HAL_list_echo.tab_echo[7].d_echo sensor_inport.HALSensors.HAL_ultrasound_SI.HAL_list_echo.tab_echo[7].end_echo_index sensor_inport.HALSensors.HAL_ultrasound_SI.HAL_list_echo.tab_echo[7].max_value sensor_inport.HALSensors.HAL_ultrasound_SI.HAL_list_echo.tab_echo[7].max_value_index sensor_inport.HALSensors.HAL_ultrasound_SI.HAL_list_echo.tab_echo[7].pre_max_index sensor_inport.HALSensors.HAL_ultrasound_SI.HAL_list_echo.tab_echo[7].precedent /end REF_MEASUREMENT
/end GROUP
/begin GROUP sensor_inport.HALSensors.HAL_ultrasound_SI.HAL_list_echo.tab_echo[8] ""
 /begin REF_MEASUREMENT sensor_inport.HALSensors.HAL_ultrasound_SI.HAL_list_echo.tab_echo[8].begin_echo_index sensor_inport.HALSensors.HAL_ultrasound_SI.HAL_list_echo.tab_echo[8].d_echo sensor_inport.HALSensors.HAL_ultrasound_SI.HAL_list_echo.tab_echo[8].end_echo_index sensor_inport.HALSensors.HAL_ultrasound_SI.HAL_list_echo.tab_echo[8].max_value sensor_inport.HALSensors.HAL_ultrasound_SI.HAL_list_echo.tab_echo[8].max_value_index sensor_inport.HALSensors.HAL_ultrasound_SI.HAL_list_echo.tab_echo[8].pre_max_index sensor_inport.HALSensors.HAL_ultrasound_SI.HAL_list_echo.tab_echo[8].precedent /end REF_MEASUREMENT
/end GROUP
/begin GROUP sensor_inport.HALSensors.HAL_ultrasound_SI.HAL_list_echo.tab_echo[9] ""
 /begin REF_MEASUREMENT sensor_inport.HALSensors.HAL_ultrasound_SI.HAL_list_echo.tab_echo[9].begin_echo_index sensor_inport.HALSensors.HAL_ultrasound_SI.HAL_list_echo.tab_echo[9].d_echo sensor_inport.HALSensors.HAL_ultrasound_SI.HAL_list_echo.tab_echo[9].end_echo_index sensor_inport.HALSensors.HAL_ultrasound_SI.HAL_list_echo.tab_echo[9].max_value sensor_inport.HALSensors.HAL_ultrasound_SI.HAL_list_echo.tab_echo[9].max_value_index sensor_inport.HALSensors.HAL_ultrasound_SI.HAL_list_echo.tab_echo[9].pre_max_index sensor_inport.HALSensors.HAL_ultrasound_SI.HAL_list_echo.tab_echo[9].precedent /end REF_MEASUREMENT
/end GROUP
/begin GROUP sensor_inport.HALSensors.HAL_ultrasound_SI.HAL_list_echo.tab_echo[10] ""
 /begin REF_MEASUREMENT sensor_inport.HALSensors.HAL_ultrasound_SI.HAL_list_echo.tab_echo[10].begin_echo_index sensor_inport.HALSensors.HAL_ultrasound_SI.HAL_list_echo.tab_echo[10].d_echo sensor_inport.HALSensors.HAL_ultrasound_SI.HAL_list_echo.tab_echo[10].end_echo_index sensor_inport.HALSensors.HAL_ultrasound_SI.HAL_list_echo.tab_echo[10].max_value sensor_inport.HALSensors.HAL_ultrasound_SI.HAL_list_echo.tab_echo[10].max_value_index sensor_inport.HALSensors.HAL_ultrasound_SI.HAL_list_echo.tab_echo[10].pre_max_index sensor_inport.HALSensors.HAL_ultrasound_SI.HAL_list_echo.tab_echo[10].precedent /end REF_MEASUREMENT
/end GROUP
/begin GROUP sensor_inport.HALSensors.HAL_ultrasound_SI.HAL_list_echo.tab_echo[11] ""
 /begin REF_MEASUREMENT sensor_inport.HALSensors.HAL_ultrasound_SI.HAL_list_echo.tab_echo[11].begin_echo_index sensor_inport.HALSensors.HAL_ultrasound_SI.HAL_list_echo.tab_echo[11].d_echo sensor_inport.HALSensors.HAL_ultrasound_SI.HAL_list_echo.tab_echo[11].end_echo_index sensor_inport.HALSensors.HAL_ultrasound_SI.HAL_list_echo.tab_echo[11].max_value sensor_inport.HALSensors.HAL_ultrasound_SI.HAL_list_echo.tab_echo[11].max_value_index sensor_inport.HALSensors.HAL_ultrasound_SI.HAL_list_echo.tab_echo[11].pre_max_index sensor_inport.HALSensors.HAL_ultrasound_SI.HAL_list_echo.tab_echo[11].precedent /end REF_MEASUREMENT
/end GROUP
/begin GROUP sensor_inport.HALSensors.HAL_ultrasound_SI.HAL_list_echo.tab_echo[12] ""
 /begin REF_MEASUREMENT sensor_inport.HALSensors.HAL_ultrasound_SI.HAL_list_echo.tab_echo[12].begin_echo_index sensor_inport.HALSensors.HAL_ultrasound_SI.HAL_list_echo.tab_echo[12].d_echo sensor_inport.HALSensors.HAL_ultrasound_SI.HAL_list_echo.tab_echo[12].end_echo_index sensor_inport.HALSensors.HAL_ultrasound_SI.HAL_list_echo.tab_echo[12].max_value sensor_inport.HALSensors.HAL_ultrasound_SI.HAL_list_echo.tab_echo[12].max_value_index sensor_inport.HALSensors.HAL_ultrasound_SI.HAL_list_echo.tab_echo[12].pre_max_index sensor_inport.HALSensors.HAL_ultrasound_SI.HAL_list_echo.tab_echo[12].precedent /end REF_MEASUREMENT
/end GROUP
/begin GROUP sensor_inport.HALSensors.HAL_ultrasound_SI.HAL_list_echo.tab_echo[13] ""
 /begin REF_MEASUREMENT sensor_inport.HALSensors.HAL_ultrasound_SI.HAL_list_echo.tab_echo[13].begin_echo_index sensor_inport.HALSensors.HAL_ultrasound_SI.HAL_list_echo.tab_echo[13].d_echo sensor_inport.HALSensors.HAL_ultrasound_SI.HAL_list_echo.tab_echo[13].end_echo_index sensor_inport.HALSensors.HAL_ultrasound_SI.HAL_list_echo.tab_echo[13].max_value sensor_inport.HALSensors.HAL_ultrasound_SI.HAL_list_echo.tab_echo[13].max_value_index sensor_inport.HALSensors.HAL_ultrasound_SI.HAL_list_echo.tab_echo[13].pre_max_index sensor_inport.HALSensors.HAL_ultrasound_SI.HAL_list_echo.tab_echo[13].precedent /end REF_MEASUREMENT
/end GROUP
/begin GROUP sensor_inport.HALSensors.HAL_ultrasound_SI.HAL_list_echo.tab_echo[14] ""
 /begin REF_MEASUREMENT sensor_inport.HALSensors.HAL_ultrasound_SI.HAL_list_echo.tab_echo[14].begin_echo_index sensor_inport.HALSensors.HAL_ultrasound_SI.HAL_list_echo.tab_echo[14].d_echo sensor_inport.HALSensors.HAL_ultrasound_SI.HAL_list_echo.tab_echo[14].end_echo_index sensor_inport.HALSensors.HAL_ultrasound_SI.HAL_list_echo.tab_echo[14].max_value sensor_inport.HALSensors.HAL_ultrasound_SI.HAL_list_echo.tab_echo[14].max_value_index sensor_inport.HALSensors.HAL_ultrasound_SI.HAL_list_echo.tab_echo[14].pre_max_index sensor_inport.HALSensors.HAL_ultrasound_SI.HAL_list_echo.tab_echo[14].precedent /end REF_MEASUREMENT
/end GROUP
/begin GROUP sensor_inport.HALSensors.HAL_ultrasound_SI.HAL_list_echo.tab_echo[15] ""
 /begin REF_MEASUREMENT sensor_inport.HALSensors.HAL_ultrasound_SI.HAL_list_echo.tab_echo[15].begin_echo_index sensor_inport.HALSensors.HAL_ultrasound_SI.HAL_list_echo.tab_echo[15].d_echo sensor_inport.HALSensors.HAL_ultrasound_SI.HAL_list_echo.tab_echo[15].end_echo_index sensor_inport.HALSensors.HAL_ultrasound_SI.HAL_list_echo.tab_echo[15].max_value sensor_inport.HALSensors.HAL_ultrasound_SI.HAL_list_echo.tab_echo[15].max_value_index sensor_inport.HALSensors.HAL_ultrasound_SI.HAL_list_echo.tab_echo[15].pre_max_index sensor_inport.HALSensors.HAL_ultrasound_SI.HAL_list_echo.tab_echo[15].precedent /end REF_MEASUREMENT
/end GROUP
/begin GROUP sensor_inport.HALSensors.HAL_ultrasound_SI.HAL_list_echo.tab_echo[16] ""
 /begin REF_MEASUREMENT sensor_inport.HALSensors.HAL_ultrasound_SI.HAL_list_echo.tab_echo[16].begin_echo_index sensor_inport.HALSensors.HAL_ultrasound_SI.HAL_list_echo.tab_echo[16].d_echo sensor_inport.HALSensors.HAL_ultrasound_SI.HAL_list_echo.tab_echo[16].end_echo_index sensor_inport.HALSensors.HAL_ultrasound_SI.HAL_list_echo.tab_echo[16].max_value sensor_inport.HALSensors.HAL_ultrasound_SI.HAL_list_echo.tab_echo[16].max_value_index sensor_inport.HALSensors.HAL_ultrasound_SI.HAL_list_echo.tab_echo[16].pre_max_index sensor_inport.HALSensors.HAL_ultrasound_SI.HAL_list_echo.tab_echo[16].precedent /end REF_MEASUREMENT
/end GROUP
/begin GROUP sensor_inport.HALSensors.HAL_ultrasound_SI.HAL_list_echo.tab_echo[17] ""
 /begin REF_MEASUREMENT sensor_inport.HALSensors.HAL_ultrasound_SI.HAL_list_echo.tab_echo[17].begin_echo_index sensor_inport.HALSensors.HAL_ultrasound_SI.HAL_list_echo.tab_echo[17].d_echo sensor_inport.HALSensors.HAL_ultrasound_SI.HAL_list_echo.tab_echo[17].end_echo_index sensor_inport.HALSensors.HAL_ultrasound_SI.HAL_list_echo.tab_echo[17].max_value sensor_inport.HALSensors.HAL_ultrasound_SI.HAL_list_echo.tab_echo[17].max_value_index sensor_inport.HALSensors.HAL_ultrasound_SI.HAL_list_echo.tab_echo[17].pre_max_index sensor_inport.HALSensors.HAL_ultrasound_SI.HAL_list_echo.tab_echo[17].precedent /end REF_MEASUREMENT
/end GROUP
/begin GROUP sensor_inport.HALSensors.HAL_ultrasound_SI.HAL_list_echo.tab_echo[18] ""
 /begin REF_MEASUREMENT sensor_inport.HALSensors.HAL_ultrasound_SI.HAL_list_echo.tab_echo[18].begin_echo_index sensor_inport.HALSensors.HAL_ultrasound_SI.HAL_list_echo.tab_echo[18].d_echo sensor_inport.HALSensors.HAL_ultrasound_SI.HAL_list_echo.tab_echo[18].end_echo_index sensor_inport.HALSensors.HAL_ultrasound_SI.HAL_list_echo.tab_echo[18].max_value sensor_inport.HALSensors.HAL_ultrasound_SI.HAL_list_echo.tab_echo[18].max_value_index sensor_inport.HALSensors.HAL_ultrasound_SI.HAL_list_echo.tab_echo[18].pre_max_index sensor_inport.HALSensors.HAL_ultrasound_SI.HAL_list_echo.tab_echo[18].precedent /end REF_MEASUREMENT
/end GROUP
/begin GROUP sensor_inport.HALSensors.HAL_ultrasound_SI.HAL_list_echo.tab_echo[19] ""
 /begin REF_MEASUREMENT sensor_inport.HALSensors.HAL_ultrasound_SI.HAL_list_echo.tab_echo[19].begin_echo_index sensor_inport.HALSensors.HAL_ultrasound_SI.HAL_list_echo.tab_echo[19].d_echo sensor_inport.HALSensors.HAL_ultrasound_SI.HAL_list_echo.tab_echo[19].end_echo_index sensor_inport.HALSensors.HAL_ultrasound_SI.HAL_list_echo.tab_echo[19].max_value sensor_inport.HALSensors.HAL_ultrasound_SI.HAL_list_echo.tab_echo[19].max_value_index sensor_inport.HALSensors.HAL_ultrasound_SI.HAL_list_echo.tab_echo[19].pre_max_index sensor_inport.HALSensors.HAL_ultrasound_SI.HAL_list_echo.tab_echo[19].precedent /end REF_MEASUREMENT
/end GROUP
/begin GROUP sensor_inport.HALSensors.HAL_ultrasound_SI.HAL_list_echo.tab_echo[20] ""
 /begin REF_MEASUREMENT sensor_inport.HALSensors.HAL_ultrasound_SI.HAL_list_echo.tab_echo[20].begin_echo_index sensor_inport.HALSensors.HAL_ultrasound_SI.HAL_list_echo.tab_echo[20].d_echo sensor_inport.HALSensors.HAL_ultrasound_SI.HAL_list_echo.tab_echo[20].end_echo_index sensor_inport.HALSensors.HAL_ultrasound_SI.HAL_list_echo.tab_echo[20].max_value sensor_inport.HALSensors.HAL_ultrasound_SI.HAL_list_echo.tab_echo[20].max_value_index sensor_inport.HALSensors.HAL_ultrasound_SI.HAL_list_echo.tab_echo[20].pre_max_index sensor_inport.HALSensors.HAL_ultrasound_SI.HAL_list_echo.tab_echo[20].precedent /end REF_MEASUREMENT
/end GROUP
/begin GROUP sensor_inport.HALSensors.HAL_ultrasound_SI.HAL_list_echo.tab_echo[21] ""
 /begin REF_MEASUREMENT sensor_inport.HALSensors.HAL_ultrasound_SI.HAL_list_echo.tab_echo[21].begin_echo_index sensor_inport.HALSensors.HAL_ultrasound_SI.HAL_list_echo.tab_echo[21].d_echo sensor_inport.HALSensors.HAL_ultrasound_SI.HAL_list_echo.tab_echo[21].end_echo_index sensor_inport.HALSensors.HAL_ultrasound_SI.HAL_list_echo.tab_echo[21].max_value sensor_inport.HALSensors.HAL_ultrasound_SI.HAL_list_echo.tab_echo[21].max_value_index sensor_inport.HALSensors.HAL_ultrasound_SI.HAL_list_echo.tab_echo[21].pre_max_index sensor_inport.HALSensors.HAL_ultrasound_SI.HAL_list_echo.tab_echo[21].precedent /end REF_MEASUREMENT
/end GROUP
/begin GROUP sensor_inport.HALSensors.HAL_ultrasound_SI.HAL_list_echo.tab_echo[22] ""
 /begin REF_MEASUREMENT sensor_inport.HALSensors.HAL_ultrasound_SI.HAL_list_echo.tab_echo[22].begin_echo_index sensor_inport.HALSensors.HAL_ultrasound_SI.HAL_list_echo.tab_echo[22].d_echo sensor_inport.HALSensors.HAL_ultrasound_SI.HAL_list_echo.tab_echo[22].end_echo_index sensor_inport.HALSensors.HAL_ultrasound_SI.HAL_list_echo.tab_echo[22].max_value sensor_inport.HALSensors.HAL_ultrasound_SI.HAL_list_echo.tab_echo[22].max_value_index sensor_inport.HALSensors.HAL_ultrasound_SI.HAL_list_echo.tab_echo[22].pre_max_index sensor_inport.HALSensors.HAL_ultrasound_SI.HAL_list_echo.tab_echo[22].precedent /end REF_MEASUREMENT
/end GROUP
/begin GROUP sensor_inport.HALSensors.HAL_ultrasound_SI.HAL_list_echo.tab_echo[23] ""
 /begin REF_MEASUREMENT sensor_inport.HALSensors.HAL_ultrasound_SI.HAL_list_echo.tab_echo[23].begin_echo_index sensor_inport.HALSensors.HAL_ultrasound_SI.HAL_list_echo.tab_echo[23].d_echo sensor_inport.HALSensors.HAL_ultrasound_SI.HAL_list_echo.tab_echo[23].end_echo_index sensor_inport.HALSensors.HAL_ultrasound_SI.HAL_list_echo.tab_echo[23].max_value sensor_inport.HALSensors.HAL_ultrasound_SI.HAL_list_echo.tab_echo[23].max_value_index sensor_inport.HALSensors.HAL_ultrasound_SI.HAL_list_echo.tab_echo[23].pre_max_index sensor_inport.HALSensors.HAL_ultrasound_SI.HAL_list_echo.tab_echo[23].precedent /end REF_MEASUREMENT
/end GROUP
/end MODULE
/end PROJECT
/* (add any file trailer comments here) */ /* EOF flightControlSystem.a2l */
